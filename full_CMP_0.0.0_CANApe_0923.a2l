/* @@@@ File written by CANAPE_VERSION 17 0 42 @@@@ */
ASAP2_VERSION 1 70
/begin PROJECT ProjectName "CARIAD XCP On CAN"
/begin MODULE ZCU "this is a module for XCP A2l"
/begin MOD_COMMON "" BYTE_ORDER MSB_LAST ALIGNMENT_BYTE 1 ALIGNMENT_WORD 2 ALIGNMENT_LONG 4 ALIGNMENT_INT64 8 ALIGNMENT_FLOAT32_IEEE 4 ALIGNMENT_FLOAT64_IEEE 8 /end MOD_COMMON
/begin IF_DATA XCP
 /begin PROTOCOL_LAYER 0x0100 0x07D0 0x2710 0x00 0x00 0x00 0x00 0x00 0x40 0x40 BYTE_ORDER_MSB_LAST ADDRESS_GRANULARITY_BYTE OPTIONAL_CMD ALLOC_ODT_ENTRY OPTIONAL_CMD ALLOC_ODT OPTIONAL_CMD ALLOC_DAQ OPTIONAL_CMD FREE_DAQ OPTIONAL_CMD GET_DAQ_EVENT_INFO OPTIONAL_CMD GET_DAQ_RESOLUTION_INFO OPTIONAL_CMD GET_DAQ_PROCESSOR_INFO OPTIONAL_CMD GET_DAQ_CLOCK OPTIONAL_CMD START_STOP_SYNCH OPTIONAL_CMD START_STOP_DAQ_LIST OPTIONAL_CMD GET_DAQ_LIST_MODE OPTIONAL_CMD SET_DAQ_LIST_MODE OPTIONAL_CMD WRITE_DAQ OPTIONAL_CMD SET_DAQ_PTR OPTIONAL_CMD CLEAR_DAQ_LIST OPTIONAL_CMD GET_CAL_PAGE OPTIONAL_CMD SET_CAL_PAGE OPTIONAL_CMD DOWNLOAD OPTIONAL_CMD BUILD_CHECKSUM OPTIONAL_CMD UPLOAD OPTIONAL_CMD SET_MTA COMMUNICATION_MODE_SUPPORTED BLOCK SLAVE /end PROTOCOL_LAYER
 /begin DAQ DYNAMIC 0x00 0x03 0x00 OPTIMISATION_TYPE_DEFAULT ADDRESS_EXTENSION_FREE IDENTIFICATION_FIELD_TYPE_ABSOLUTE GRANULARITY_ODT_ENTRY_SIZE_DAQ_BYTE 0xFF OVERLOAD_INDICATION_EVENT PRESCALER_SUPPORTED /begin TIMESTAMP_SUPPORTED 0x01 SIZE_WORD UNIT_1MS /end TIMESTAMP_SUPPORTED /begin EVENT "EvCan100ms" "EvCan100m" 0x00 DAQ 0x01 0x01 0x08 0x0C /end EVENT /begin EVENT "EvCan10ms" "EvCan10ms" 0x01 DAQ 0x01 0x01 0x07 0x08 /end EVENT /begin EVENT "EvCan50ms" "EvCan50ms" 0x02 DAQ 0x01 0x01 0x07 0x0B /end EVENT /end DAQ
 /begin PAG 0x05 /end PAG
 /begin PGM PGM_MODE_ABSOLUTE 0x00 0x00 /end PGM
 /begin XCP_ON_CAN 0x0100 CAN_ID_MASTER 0x400006B8 CAN_ID_SLAVE 0x400006B9 BAUDRATE 0x07A120 SAMPLE_POINT 0x4B SAMPLE_RATE SINGLE BTL_CYCLES 0x08 SJW 0x02 SYNC_EDGE SINGLE /end XCP_ON_CAN
/end IF_DATA
/begin MOD_PAR "" VERSION "Entry_XCP_1" SUPPLIER "Xp Supply" CUSTOMER "Customer" CUSTOMER_NO "XPENG MOTORS" USER "" PHONE_NO "" ECU "E38RDCU" CPU_TYPE "RH850U2A" NO_OF_INTERFACES 1
 /begin MEMORY_SEGMENT Code "" CODE FLASH INTERN 0x80030000 0x9CFFFF -1 -1 -1 -1 -1 /end MEMORY_SEGMENT
 /begin MEMORY_SEGMENT CALFALSH1 "" DATA FLASH INTERN 0xB0004000 0x2000 -1 -1 -1 -1 -1
  /begin IF_DATA XCP
   /begin SEGMENT 0x00 0x02 0x00 0x00 0x00 /begin CHECKSUM XCP_ADD_14 MAX_BLOCK_SIZE 0x2000 /end CHECKSUM
    /begin PAGE 0x00 ECU_ACCESS_WITH_XCP_ONLY XCP_READ_ACCESS_WITH_ECU_ONLY XCP_WRITE_ACCESS_NOT_ALLOWED /end PAGE
    /begin PAGE 0x01 ECU_ACCESS_WITH_XCP_ONLY XCP_READ_ACCESS_WITH_ECU_ONLY XCP_WRITE_ACCESS_WITH_ECU_ONLY /end PAGE
    /begin ADDRESS_MAPPING 0xB0004000 0xB0004000 0x2000 /end ADDRESS_MAPPING
   /end SEGMENT
  /end IF_DATA
 /end MEMORY_SEGMENT
 /begin MEMORY_SEGMENT CALFALSH0 "" DATA FLASH INTERN 0xB0006000 0x1C000 -1 -1 -1 -1 -1
  /begin IF_DATA XCP
   /begin SEGMENT 0x00 0x02 0x00 0x00 0x00 /begin CHECKSUM XCP_ADD_14 MAX_BLOCK_SIZE 0x01C000 /end CHECKSUM
    /begin PAGE 0x00 ECU_ACCESS_WITH_XCP_ONLY XCP_READ_ACCESS_WITH_ECU_ONLY XCP_WRITE_ACCESS_NOT_ALLOWED /end PAGE
    /begin PAGE 0x01 ECU_ACCESS_WITH_XCP_ONLY XCP_READ_ACCESS_WITH_ECU_ONLY XCP_WRITE_ACCESS_WITH_ECU_ONLY /end PAGE
    /begin ADDRESS_MAPPING 0xB0006000 0xB0006000 0x01C000 /end ADDRESS_MAPPING
   /end SEGMENT
  /end IF_DATA
 /end MEMORY_SEGMENT
 /begin MEMORY_SEGMENT CALFALSH3 "" DATA FLASH INTERN 0xB0080000 0x2000 -1 -1 -1 -1 -1
  /begin IF_DATA XCP
   /begin SEGMENT 0x00 0x02 0x00 0x00 0x00 /begin CHECKSUM XCP_ADD_14 MAX_BLOCK_SIZE 0x2000 /end CHECKSUM
    /begin PAGE 0x00 ECU_ACCESS_WITH_XCP_ONLY XCP_READ_ACCESS_WITH_ECU_ONLY XCP_WRITE_ACCESS_NOT_ALLOWED /end PAGE
    /begin PAGE 0x01 ECU_ACCESS_WITH_XCP_ONLY XCP_READ_ACCESS_WITH_ECU_ONLY XCP_WRITE_ACCESS_WITH_ECU_ONLY /end PAGE
    /begin ADDRESS_MAPPING 0xB0080000 0xB0080000 0x2000 /end ADDRESS_MAPPING
   /end SEGMENT
  /end IF_DATA
 /end MEMORY_SEGMENT
 /begin MEMORY_SEGMENT CALFALSH2 "" DATA FLASH INTERN 0xB0082000 0x55000 -1 -1 -1 -1 -1
  /begin IF_DATA XCP
   /begin SEGMENT 0x00 0x02 0x00 0x00 0x00 /begin CHECKSUM XCP_ADD_14 MAX_BLOCK_SIZE 0x055000 /end CHECKSUM
    /begin PAGE 0x00 ECU_ACCESS_WITH_XCP_ONLY XCP_READ_ACCESS_WITH_ECU_ONLY XCP_WRITE_ACCESS_NOT_ALLOWED /end PAGE
    /begin PAGE 0x01 ECU_ACCESS_WITH_XCP_ONLY XCP_READ_ACCESS_WITH_ECU_ONLY XCP_WRITE_ACCESS_WITH_ECU_ONLY /end PAGE
    /begin ADDRESS_MAPPING 0xB0082000 0xB0082000 0x055000 /end ADDRESS_MAPPING
   /end SEGMENT
  /end IF_DATA
 /end MEMORY_SEGMENT
/end MOD_PAR
/begin COMPU_METHOD POD_AntiPinch_CM_boolean "Q = V" IDENTICAL "%1.0" "" /end COMPU_METHOD
/begin COMPU_METHOD POD_AntiPinch_CM_int16 "Q = V" IDENTICAL "%5.0" "" /end COMPU_METHOD
/begin COMPU_METHOD POD_AntiPinch_CM_single "Q = V" IDENTICAL "%8.6" "" /end COMPU_METHOD
/begin COMPU_METHOD POD_AntiPinch_CM_uint16 "Q = V" IDENTICAL "%5.0" "" /end COMPU_METHOD
/begin COMPU_METHOD POD_AntiPinch_CM_uint8 "Q = V" IDENTICAL "%3.0" "" /end COMPU_METHOD
/begin COMPU_METHOD POD_FaultHandle_CM_boolean "Q = V" IDENTICAL "%1.0" "" /end COMPU_METHOD
/begin COMPU_METHOD POD_FaultHandle_CM_int16 "Q = V" IDENTICAL "%5.0" "" /end COMPU_METHOD
/begin COMPU_METHOD POD_FaultHandle_CM_single "Q = V" IDENTICAL "%8.6" "" /end COMPU_METHOD
/begin COMPU_METHOD POD_FaultHandle_CM_uint16 "Q = V" IDENTICAL "%5.0" "" /end COMPU_METHOD
/begin COMPU_METHOD POD_FaultHandle_CM_uint8 "Q = V" IDENTICAL "%3.0" "" /end COMPU_METHOD
/begin COMPU_METHOD POD_HallHandleModule_TZCU_CM_boolean "Q = V" IDENTICAL "%1.0" "" /end COMPU_METHOD
/begin COMPU_METHOD POD_HallHandleModule_TZCU_CM_int16 "Q = V" IDENTICAL "%5.0" "" /end COMPU_METHOD
/begin COMPU_METHOD POD_HallHandleModule_TZCU_CM_single "Q = V" IDENTICAL "%8.6" "" /end COMPU_METHOD
/begin COMPU_METHOD POD_HallHandleModule_TZCU_CM_uint8 "Q = V" IDENTICAL "%3.0" "" /end COMPU_METHOD
/begin COMPU_METHOD POD_MBCL_CM_boolean "Q = V" IDENTICAL "%1.0" "" /end COMPU_METHOD
/begin COMPU_METHOD POD_MBCL_CM_int16 "Q = V" IDENTICAL "%5.0" "" /end COMPU_METHOD
/begin COMPU_METHOD POD_MBCL_CM_single "Q = V" IDENTICAL "%8.6" "" /end COMPU_METHOD
/begin COMPU_METHOD POD_MBCL_CM_uint8 "Q = V" IDENTICAL "%3.0" "" /end COMPU_METHOD
/begin COMPU_METHOD POD_MBCR_CM_boolean "Q = V" IDENTICAL "%1.0" "" /end COMPU_METHOD
/begin COMPU_METHOD POD_MBCR_CM_int16 "Q = V" IDENTICAL "%5.0" "" /end COMPU_METHOD
/begin COMPU_METHOD POD_MBCR_CM_single "Q = V" IDENTICAL "%8.6" "" /end COMPU_METHOD
/begin COMPU_METHOD POD_MBCR_CM_uint8 "Q = V" IDENTICAL "%3.0" "" /end COMPU_METHOD
/begin COMPU_METHOD POD_MCML_CM_boolean "Q = V" IDENTICAL "%1.0" "" /end COMPU_METHOD
/begin COMPU_METHOD POD_MCML_CM_int16 "Q = V" IDENTICAL "%5.0" "" /end COMPU_METHOD
/begin COMPU_METHOD POD_MCML_CM_single "Q = V" IDENTICAL "%8.6" "" /end COMPU_METHOD
/begin COMPU_METHOD POD_MCML_CM_uint8 "Q = V" IDENTICAL "%3.0" "" /end COMPU_METHOD
/begin COMPU_METHOD POD_MCMR_CM_boolean "Q = V" IDENTICAL "%1.0" "" /end COMPU_METHOD
/begin COMPU_METHOD POD_MCMR_CM_int16 "Q = V" IDENTICAL "%5.0" "" /end COMPU_METHOD
/begin COMPU_METHOD POD_MCMR_CM_single "Q = V" IDENTICAL "%8.6" "" /end COMPU_METHOD
/begin COMPU_METHOD POD_MCMR_CM_uint8 "Q = V" IDENTICAL "%3.0" "" /end COMPU_METHOD
/begin COMPU_METHOD POD_SignalHandModule_T_CM_boolean "Q = V" IDENTICAL "%1.0" "" /end COMPU_METHOD
/begin COMPU_METHOD POD_SignalHandModule_T_CM_single "Q = V" IDENTICAL "%8.6" "" /end COMPU_METHOD
/begin COMPU_METHOD POD_SignalHandModule_T_CM_uint16 "Q = V" IDENTICAL "%5.0" "" /end COMPU_METHOD
/begin COMPU_METHOD POD_SignalHandModule_T_CM_uint8 "Q = V" IDENTICAL "%3.0" "" /end COMPU_METHOD
/begin COMPU_METHOD POD_SMML_CM_boolean "Q = V" IDENTICAL "%1.0" "" /end COMPU_METHOD
/begin COMPU_METHOD POD_SMML_CM_int16 "Q = V" IDENTICAL "%5.0" "" /end COMPU_METHOD
/begin COMPU_METHOD POD_SMML_CM_single "Q = V" IDENTICAL "%8.6" "" /end COMPU_METHOD
/begin COMPU_METHOD POD_SMML_CM_uint8 "Q = V" IDENTICAL "%3.0" "" /end COMPU_METHOD
/begin COMPU_METHOD POD_SMMR_CM_boolean "Q = V" IDENTICAL "%1.0" "" /end COMPU_METHOD
/begin COMPU_METHOD POD_SMMR_CM_int16 "Q = V" IDENTICAL "%5.0" "" /end COMPU_METHOD
/begin COMPU_METHOD POD_SMMR_CM_single "Q = V" IDENTICAL "%8.6" "" /end COMPU_METHOD
/begin COMPU_METHOD POD_SMMR_CM_uint8 "Q = V" IDENTICAL "%3.0" "" /end COMPU_METHOD
/begin COMPU_METHOD POD_TipToRun_CM_boolean "Q = V" IDENTICAL "%1.0" "" /end COMPU_METHOD
/begin COMPU_METHOD POD_TipToRun_CM_int16 "Q = V" IDENTICAL "%5.0" "" /end COMPU_METHOD
/begin COMPU_METHOD POD_TipToRun_CM_single "Q = V" IDENTICAL "%8.6" "" /end COMPU_METHOD
/begin COMPU_METHOD POD_TipToRun_CM_uint8 "Q = V" IDENTICAL "%3.0" "" /end COMPU_METHOD
/begin COMPU_METHOD RDM_AntiPinch_CM_int16 "Q = V" IDENTICAL "%5.0" "" /end COMPU_METHOD
/begin COMPU_METHOD RDM_AntiPinch_CM_single "Q = V" IDENTICAL "%8.6" "" /end COMPU_METHOD
/begin COMPU_METHOD RDM_AntiPinch_CM_uint16 "Q = V" IDENTICAL "%5.0" "" /end COMPU_METHOD
/begin COMPU_METHOD RDM_AntiPinch_CM_uint8 "Q = V" IDENTICAL "%3.0" "" /end COMPU_METHOD
/begin COMPU_METHOD RDM_CtrlLeverMtr_CM_boolean "Q = V" IDENTICAL "%1.0" "" /end COMPU_METHOD
/begin COMPU_METHOD RDM_CtrlLeverMtr_CM_UINT8 "Q = V" IDENTICAL "%3.0" "" /end COMPU_METHOD
/begin COMPU_METHOD RDM_CtrlLeverMtr_CM_uint8 "Q = V" IDENTICAL "%3.0" "" /end COMPU_METHOD
/begin COMPU_METHOD RDM_DetLeverMtrStallSt_CM_uint8 "Q = V" IDENTICAL "%3.0" "" /end COMPU_METHOD
/begin COMPU_METHOD RDM_DetThermProtSt_CM_uint8 "Q = V" IDENTICAL "%3.0" "" /end COMPU_METHOD
/begin COMPU_METHOD RDM_DetTrunkMoveReq_CM_int16 "Q = V" IDENTICAL "%5.0" "" /end COMPU_METHOD
/begin COMPU_METHOD RDM_DetTrunkMoveReq_CM_int8 "Q = V" IDENTICAL "%3.0" "" /end COMPU_METHOD
/begin COMPU_METHOD RDM_DetTrunkMoveReq_CM_single "Q = V" IDENTICAL "%8.6" "" /end COMPU_METHOD
/begin COMPU_METHOD RDM_DetTrunkMoveReq_CM_uint16 "Q = V" IDENTICAL "%5.0" "" /end COMPU_METHOD
/begin COMPU_METHOD RDM_DetTrunkMoveReq_CM_UINT8 "Q = V" IDENTICAL "%3.0" "" /end COMPU_METHOD
/begin COMPU_METHOD RDM_DetTrunkMoveReq_CM_uint8 "Q = V" IDENTICAL "%3.0" "" /end COMPU_METHOD
/begin COMPU_METHOD RDM_GetTrunkPos_CM_int16 "Q = V" IDENTICAL "%5.0" "" /end COMPU_METHOD
/begin COMPU_METHOD RDM_GetTrunkPos_CM_uint16 "Q = V" IDENTICAL "%5.0" "" /end COMPU_METHOD
/begin COMPU_METHOD RDM_GetTrunkPos_CM_uint8 "Q = V" IDENTICAL "%3.0" "" /end COMPU_METHOD
/begin COMPU_METHOD RDM_HallDeco_CM_uint16 "Q = V" IDENTICAL "%5.0" "" /end COMPU_METHOD
/begin COMPU_METHOD RDM_HallDeco_CM_uint8 "Q = V" IDENTICAL "%3.0" "" /end COMPU_METHOD
/begin COMPU_METHOD RDM_LearnRF_CM_int8 "Q = V" IDENTICAL "%3.0" "" /end COMPU_METHOD
/begin COMPU_METHOD RDM_LearnRF_CM_uint16 "Q = V" IDENTICAL "%5.0" "" /end COMPU_METHOD
/begin COMPU_METHOD RDM_LearnRF_CM_uint8 "Q = V" IDENTICAL "%3.0" "" /end COMPU_METHOD
/begin COMPU_METHOD RDM_SetSwSt_CM_uint8 "Q = V" IDENTICAL "%3.0" "" /end COMPU_METHOD
/begin COMPU_METHOD RDM_SOARx_CM_uint8 "Q = V" IDENTICAL "%3.0" "" /end COMPU_METHOD
/begin COMPU_METHOD RDMLatch_DetMotorStall_CM_uint16 "Q = V" IDENTICAL "%5.0" "" /end COMPU_METHOD
/begin COMPU_METHOD RDMLatch_FITOut_CM_uint16 "Q = V" IDENTICAL "%5.0" "" /end COMPU_METHOD
/begin COMPU_METHOD RDMLatch_FITOut_CM_UINT8 "Q = V" IDENTICAL "%3.0" "" /end COMPU_METHOD
/begin COMPU_METHOD RDMLatch_FITOut_CM_uint8 "Q = V" IDENTICAL "%3.0" "" /end COMPU_METHOD
/begin COMPU_METHOD RDMLatch_SetCinchRelsCmd_CM_uint16 "Q = V" IDENTICAL "%5.0" "" /end COMPU_METHOD
/begin COMPU_METHOD RDMLatch_SetCinchRelsCmd_CM_uint8 "Q = V" IDENTICAL "%3.0" "" /end COMPU_METHOD
/begin CHARACTERISTIC CDD_CARTYPE_VEEA_MEB31_INLAND "Macros definition used for State, Movement State." VALUE 0x0 Scalar_UBYTE 0 RDMLatch_SetCinchRelsCmd_CM_uint8 0 255 /end CHARACTERISTIC
/begin CHARACTERISTIC CDD_CARTYPE_VEEA_MY26_INLAND "Macros definition used for State, Movement State." VALUE 0x0 Scalar_UBYTE 0 RDMLatch_SetCinchRelsCmd_CM_uint8 0 255 /end CHARACTERISTIC
/begin CHARACTERISTIC CalC_CinchMotDriveTmMax_ms "" VALUE 0xB00072B4 Scalar_UWORD 0 RDMLatch_DetMotorStall_CM_uint16 0 65535 /end CHARACTERISTIC
/begin CHARACTERISTIC CalC_CinchMotDriveTmMin_ms "" VALUE 0xB00072B6 Scalar_UWORD 0 RDMLatch_SetCinchRelsCmd_CM_uint16 0 65535 /end CHARACTERISTIC
/begin CHARACTERISTIC CalC_CinchStallReverse_ms "" VALUE 0xB00072BA Scalar_UWORD 0 RDMLatch_SetCinchRelsCmd_CM_uint16 0 65535 /end CHARACTERISTIC
/begin CHARACTERISTIC CalC_Debug_TrnkGrOrSpdCond "" VALUE 0xB000727C Scalar_UBYTE 0 RDM_DetTrunkMoveReq_CM_uint8 0 255 /end CHARACTERISTIC
/begin CHARACTERISTIC CalC_DelayStartCinch_ms "" VALUE 0xB00072BC Scalar_UWORD 0 RDMLatch_SetCinchRelsCmd_CM_uint16 0 65535 /end CHARACTERISTIC
/begin CHARACTERISTIC CalC_DelayStopCinRe_ms "" VALUE 0xB00072BE Scalar_UWORD 0 RDMLatch_SetCinchRelsCmd_CM_uint16 0 65535 /end CHARACTERISTIC
/begin CHARACTERISTIC CalC_DelayStopCinchStall_ms "" VALUE 0xB00072C0 Scalar_UWORD 0 RDMLatch_SetCinchRelsCmd_CM_uint16 0 65535 /end CHARACTERISTIC
/begin CHARACTERISTIC CalC_DelayStopCinch_ms "" VALUE 0xB00072C2 Scalar_UWORD 0 RDMLatch_SetCinchRelsCmd_CM_uint16 0 65535 /end CHARACTERISTIC
/begin CHARACTERISTIC CalC_DelayStopForPawl_ms "" VALUE 0xB00072C4 Scalar_UWORD 0 RDMLatch_SetCinchRelsCmd_CM_uint16 0 65535 /end CHARACTERISTIC
/begin CHARACTERISTIC CalC_DelayStopForScond_ms "" VALUE 0xB00072C6 Scalar_UWORD 0 RDMLatch_SetCinchRelsCmd_CM_uint16 0 65535 /end CHARACTERISTIC
/begin CHARACTERISTIC CalC_DelayStopRelsRe_ms "" VALUE 0x0 Scalar_UWORD 0 RDMLatch_SetCinchRelsCmd_CM_uint16 0 65535 /end CHARACTERISTIC
/begin CHARACTERISTIC CalC_DelayUnlockRevs_ms "" VALUE 0xB00072C8 Scalar_UWORD 0 RDMLatch_SetCinchRelsCmd_CM_uint16 0 65535 /end CHARACTERISTIC
/begin CHARACTERISTIC CalC_LatchMotDynamicBrk_ms "" VALUE 0xB00072D0 Scalar_UWORD 0 RDMLatch_SetCinchRelsCmd_CM_uint16 0 65535 /end CHARACTERISTIC
/begin CHARACTERISTIC CalC_LatchMotStlMax_mA "" VALUE 0xB00072D2 Scalar_UWORD 0 RDMLatch_DetMotorStall_CM_uint16 0 65535 /end CHARACTERISTIC
/begin CHARACTERISTIC CalC_LatchMotStlMin_mA "" VALUE 0xB00072D4 Scalar_UWORD 0 RDMLatch_DetMotorStall_CM_uint16 0 65535 /end CHARACTERISTIC
/begin CHARACTERISTIC CalC_LatchMotStl_ms "" VALUE 0xB00072D6 Scalar_UWORD 0 RDMLatch_DetMotorStall_CM_uint16 0 65535 /end CHARACTERISTIC
/begin CHARACTERISTIC CalC_LatchNormCurr_mA "" VALUE 0xB00072DA Scalar_UWORD 0 RDMLatch_DetMotorStall_CM_uint16 0 65535 /end CHARACTERISTIC
/begin CHARACTERISTIC CalC_LatchStartUp_ms "" VALUE 0xB00072DC Scalar_UWORD 0 RDMLatch_SetCinchRelsCmd_CM_uint16 0 65535 /end CHARACTERISTIC
/begin CHARACTERISTIC CalC_LatchStlRels_ms "" VALUE 0xB00072DE Scalar_UWORD 0 RDMLatch_DetMotorStall_CM_uint16 0 65535 /end CHARACTERISTIC
/begin CHARACTERISTIC CalC_TrnkAPRevsMtrSpd "" VALUE 0xB0007098 Scalar_UWORD 0 RDM_DetTrunkMoveReq_CM_uint16 0 65535 /end CHARACTERISTIC
/begin CHARACTERISTIC CalC_TrnkAntiDriveMaxPosTol "" VALUE 0xB000709A Scalar_UBYTE 0 RDM_CtrlLeverMtr_CM_uint8 0 255 /end CHARACTERISTIC
/begin CHARACTERISTIC CalC_TrnkAntiDrivePwm "" VALUE 0xB000709B Scalar_UBYTE 0 RDM_CtrlLeverMtr_CM_uint8 0 255 /end CHARACTERISTIC
/begin CHARACTERISTIC CalC_TrnkClsManAsstMinPWM "" VALUE 0xB000711C Scalar_UBYTE 0 RDM_DetTrunkMoveReq_CM_uint8 0 255 /end CHARACTERISTIC
/begin CHARACTERISTIC CalC_TrnkClsMtrNormSpd "" VALUE 0xB000711E Scalar_UWORD 0 RDM_AntiPinch_CM_uint16 0 65535 /end CHARACTERISTIC
/begin CHARACTERISTIC CalC_TrnkClsMtrStartSpd "" VALUE 0xB0007120 Scalar_UWORD 0 RDM_DetTrunkMoveReq_CM_uint16 0 65535 /end CHARACTERISTIC
/begin CHARACTERISTIC CalC_TrnkClsMtrStartTm "" VALUE 0xB0007122 Scalar_UWORD 0 RDM_DetTrunkMoveReq_CM_uint16 0 65535 /end CHARACTERISTIC
/begin CHARACTERISTIC CalC_TrnkClsMtrStopDist "" VALUE 0xB0007124 Scalar_UWORD 0 RDM_AntiPinch_CM_uint16 0 65535 /end CHARACTERISTIC
/begin CHARACTERISTIC CalC_TrnkClsMtrStopSpd "" VALUE 0xB0007126 Scalar_UWORD 0 RDM_DetTrunkMoveReq_CM_uint16 0 65535 /end CHARACTERISTIC
/begin CHARACTERISTIC CalC_TrnkClsTmpSpd "" VAL_BLK 0xB0007144 Scalar_FLOAT32_IEEE 0 RDM_DetTrunkMoveReq_CM_single -3.4e+38 3.4e+38 MATRIX_DIM 3 /end CHARACTERISTIC
/begin CHARACTERISTIC CalC_TrnkClsTraceAPMtrSpdThr "" VALUE 0xB0007151 Scalar_UBYTE 0 RDM_AntiPinch_CM_uint8 0 255 /end CHARACTERISTIC
/begin CHARACTERISTIC CalC_TrnkFullClsdTgtPos "" VALUE 0xB000715E Scalar_SWORD 0 RDM_DetTrunkMoveReq_CM_int16 -32768 32767 /end CHARACTERISTIC
/begin CHARACTERISTIC CalC_TrnkHalfClsDecPWM_pct "" VALUE 0xB0007160 Scalar_UBYTE 0 RDM_DetTrunkMoveReq_CM_uint8 0 255 /end CHARACTERISTIC
/begin CHARACTERISTIC CalC_TrnkHallZone_HalfClosed_H "" VALUE 0xB000716C Scalar_SWORD 0 RDM_AntiPinch_CM_int16 -32768 32767 /end CHARACTERISTIC
/begin CHARACTERISTIC CalC_TrnkLatchCinchPWM "" VALUE 0xB00072E4 Scalar_UBYTE 0 RDMLatch_SetCinchRelsCmd_CM_uint8 0 255 /end CHARACTERISTIC
/begin CHARACTERISTIC CalC_TrnkLatchUnlckExitCurrThr_mA "" VALUE 0xB00072E6 Scalar_UWORD 0 RDMLatch_SetCinchRelsCmd_CM_uint16 0 65535 /end CHARACTERISTIC
/begin CHARACTERISTIC CalC_TrnkMinSftStpOpnHallPosOffset "" VALUE 0xB0007176 Scalar_UWORD 0 RDM_DetTrunkMoveReq_CM_uint16 0 65535 /end CHARACTERISTIC
/begin CHARACTERISTIC CalC_TrnkMtrOpnStartUpDist "" VALUE 0xB000717A Scalar_UWORD 0 RDM_GetTrunkPos_CM_uint16 0 65535 /end CHARACTERISTIC
/begin CHARACTERISTIC CalC_TrnkMtrPWMDwnLim "" VALUE 0xB000717C Scalar_UBYTE 0 RDM_DetTrunkMoveReq_CM_uint8 0 255 /end CHARACTERISTIC
/begin CHARACTERISTIC CalC_TrnkMtrSlowStartCfg "" VALUE 0xB000717E Scalar_UBYTE 0 RDM_DetTrunkMoveReq_CM_uint8 0 255 /end CHARACTERISTIC
/begin CHARACTERISTIC CalC_TrnkMtrSlowStopCfg "" VALUE 0xB000717F Scalar_UBYTE 0 RDM_DetTrunkMoveReq_CM_uint8 0 255 /end CHARACTERISTIC
/begin CHARACTERISTIC CalC_TrnkMtrSpdCtrClsLpCfg "" VALUE 0xB0007180 Scalar_UBYTE 0 RDM_DetTrunkMoveReq_CM_uint8 0 255 /end CHARACTERISTIC
/begin CHARACTERISTIC CalC_TrnkNormMvHallPosTol "" VALUE 0xB000718A Scalar_UWORD 0 RDM_DetTrunkMoveReq_CM_uint16 0 65535 /end CHARACTERISTIC
/begin CHARACTERISTIC CalC_TrnkOpnMtrBtmStartPosThr "" VALUE 0xB0007198 Scalar_SWORD 0 RDM_DetTrunkMoveReq_CM_int16 -32768 32767 /end CHARACTERISTIC
/begin CHARACTERISTIC CalC_TrnkOpnMtrBtmStartTm_ms "" VALUE 0xB000719A Scalar_UWORD 0 RDM_DetTrunkMoveReq_CM_uint16 0 65535 /end CHARACTERISTIC
/begin CHARACTERISTIC CalC_TrnkOpnMtrNormSpd "" VALUE 0xB000719C Scalar_UWORD 0 RDM_AntiPinch_CM_uint16 0 65535 /end CHARACTERISTIC
/begin CHARACTERISTIC CalC_TrnkOpnMtrStartSpd "" VAL_BLK 0xB000719E Scalar_UWORD 0 RDM_DetTrunkMoveReq_CM_uint16 0 65535 MATRIX_DIM 3 /end CHARACTERISTIC
/begin CHARACTERISTIC CalC_TrnkOpnMtrStartTm "" VALUE 0xB00071AA Scalar_UWORD 0 RDM_DetTrunkMoveReq_CM_uint16 0 65535 /end CHARACTERISTIC
/begin CHARACTERISTIC CalC_TrnkOpnMtrStopDist "" VALUE 0xB00071AC Scalar_UWORD 0 RDM_DetTrunkMoveReq_CM_uint16 0 65535 /end CHARACTERISTIC
/begin CHARACTERISTIC CalC_TrnkOpnMtrStopSpd "" VALUE 0xB00071AE Scalar_UWORD 0 RDM_DetTrunkMoveReq_CM_uint16 0 65535 /end CHARACTERISTIC
/begin CHARACTERISTIC CalC_TrnkOpnPawlSwOnWaitTm_ms "" VALUE 0xB00071B2 Scalar_UWORD 0 RDM_DetTrunkMoveReq_CM_uint16 0 65535 /end CHARACTERISTIC
/begin CHARACTERISTIC CalC_TrnkPauseMtrStopDist "" VALUE 0xB00071CC Scalar_UWORD 0 RDM_DetTrunkMoveReq_CM_uint16 0 65535 /end CHARACTERISTIC
/begin CHARACTERISTIC CalC_TrnkRLvrCfgEnable "" VALUE 0xB00071D2 Scalar_UBYTE 0 RDM_CtrlLeverMtr_CM_uint8 0 255 /end CHARACTERISTIC
/begin CHARACTERISTIC CalC_TrnkSftStpClsHallPos "" VALUE 0xB00071D6 Scalar_SWORD 0 RDM_GetTrunkPos_CM_int16 -32768 32767 /end CHARACTERISTIC
/begin CHARACTERISTIC CalC_TrnkThermProtCfgEnable "" VALUE 0xB00071E2 Scalar_UBYTE 0 RDM_DetThermProtSt_CM_uint8 0 255 /end CHARACTERISTIC
/begin CHARACTERISTIC CalC_UnlockMotDriveTmMax_ms "" VALUE 0xB00072EA Scalar_UWORD 0 RDMLatch_DetMotorStall_CM_uint16 0 65535 /end CHARACTERISTIC
/begin CHARACTERISTIC CalC_UnlockMotDriveTmMin_ms "" VALUE 0xB00072EC Scalar_UWORD 0 RDMLatch_SetCinchRelsCmd_CM_uint16 0 65535 /end CHARACTERISTIC
/begin CHARACTERISTIC CalC_hIPLGClsRvrsHall_cnt "" VALUE 0xB00071E8 Scalar_UWORD 0 RDM_DetTrunkMoveReq_CM_uint16 0 65535 /end CHARACTERISTIC
/begin CHARACTERISTIC CalC_hIPLGOpenOnlyHall_cnt "" VALUE 0xB00071EE Scalar_SWORD 0 RDM_DetTrunkMoveReq_CM_int16 -32768 32767 /end CHARACTERISTIC
/begin CHARACTERISTIC CalC_hIPLGOpenRvrsHall_cnt "" VALUE 0xB00071F0 Scalar_UWORD 0 RDM_DetTrunkMoveReq_CM_uint16 0 65535 /end CHARACTERISTIC
/begin CHARACTERISTIC CalC_pctIPLGSpindleDtcy_pct "" VALUE 0xB00071F4 Scalar_UBYTE 0 RDM_DetTrunkMoveReq_CM_uint8 0 255 /end CHARACTERISTIC
/begin CHARACTERISTIC CalC_tIPLGLatchRelsTimeout_ms "" VALUE 0xB00071F6 Scalar_UWORD 0 RDM_DetTrunkMoveReq_CM_uint16 0 65535 /end CHARACTERISTIC
/begin CHARACTERISTIC CalC_tIPLGLatchRvrsMax_ms "" VALUE 0xB00072EE Scalar_UWORD 0 RDMLatch_SetCinchRelsCmd_CM_uint16 0 65535 /end CHARACTERISTIC
/begin CHARACTERISTIC CalC_tIPLGSpindleStpDly_ms "" VALUE 0xB00071F8 Scalar_UWORD 0 RDM_DetTrunkMoveReq_CM_uint16 0 65535 /end CHARACTERISTIC
/begin CHARACTERISTIC CalEn_Debug_TrnkLatchSt "" VALUE 0xB0007280 Scalar_UBYTE 0 RDM_DetTrunkMoveReq_CM_uint8 0 255 /end CHARACTERISTIC
/begin CHARACTERISTIC CalEn_Debug_TrnkStlSt "" VALUE 0xB0007281 Scalar_UBYTE 0 RDM_DetLeverMtrStallSt_CM_uint8 0 255 /end CHARACTERISTIC
/begin CHARACTERISTIC CalEn_FITOut_RDLockCtr "" VALUE 0xB00072A2 Scalar_UBYTE 0 RDMLatch_FITOut_CM_uint8 0 255 /end CHARACTERISTIC
/begin CHARACTERISTIC CalEn_FITOut_RDLockPWMCmd "" VALUE 0xB00072B1 Scalar_UBYTE 0 RDMLatch_FITOut_CM_uint8 0 255 /end CHARACTERISTIC
/begin CHARACTERISTIC CalEn_FITOut_RDUnLockCmd "" VALUE 0xB00072B2 Scalar_UBYTE 0 RDMLatch_FITOut_CM_uint8 0 255 /end CHARACTERISTIC
/begin CHARACTERISTIC CalEn_TrnkUnlckLatchReq "" VALUE 0xB000729C Scalar_UBYTE 0 RDMLatch_SetCinchRelsCmd_CM_uint8 0 255 /end CHARACTERISTIC
/begin CHARACTERISTIC CalVal_Debug_TrnkLatchSt "" VALUE 0xB0007287 Scalar_UBYTE 0 RDM_DetTrunkMoveReq_CM_uint8 0 255 /end CHARACTERISTIC
/begin CHARACTERISTIC CalVal_Debug_TrnkStlSt "" VALUE 0xB0007288 Scalar_UBYTE 0 RDM_DetLeverMtrStallSt_CM_uint8 0 255 /end CHARACTERISTIC
/begin CHARACTERISTIC CalVal_FITOutRDLockCtr_ms "" VALUE 0xB00072A0 Scalar_UWORD 0 RDMLatch_FITOut_CM_uint16 0 65535 /end CHARACTERISTIC
/begin CHARACTERISTIC CalVal_FITOut_RDLockCtr "" VALUE 0xB000729E Scalar_UBYTE 0 RDMLatch_FITOut_CM_uint8 0 255 /end CHARACTERISTIC
/begin CHARACTERISTIC CalVal_FITOut_RDLockPWMCmd "" VALUE 0xB00072B0 Scalar_UBYTE 0 RDMLatch_FITOut_CM_uint8 0 255 /end CHARACTERISTIC
/begin CHARACTERISTIC CalVal_FITOut_RDUnLockCmd "" VALUE 0xB00072B3 Scalar_UBYTE 0 RDMLatch_FITOut_CM_uint8 0 255 /end CHARACTERISTIC
/begin CHARACTERISTIC CalVal_TrnkUnlckLatchReq "" VALUE 0xB000729D Scalar_UBYTE 0 RDMLatch_SetCinchRelsCmd_CM_uint8 0 255 /end CHARACTERISTIC
/begin CHARACTERISTIC Cal_SlopeCloseSpdPatch "" CURVE 0xB00071FE Lookup1D_UWORD 0 RDM_DetTrunkMoveReq_CM_uint16 0 65535
 /begin AXIS_DESCR COM_AXIS NO_INPUT_QUANTITY RDM_DetTrunkMoveReq_CM_single 7 -3.4e+38 3.4e+38 DEPOSIT ABSOLUTE AXIS_PTS_REF Cal_SlopePatch /end AXIS_DESCR
/end CHARACTERISTIC
/begin AXIS_PTS Cal_SlopePatch "" 0x8077421C NO_INPUT_QUANTITY Lookup1D_X_FLOAT32_IEEE 0 RDM_DetTrunkMoveReq_CM_single 7 -3.4e+38 3.4e+38 DEPOSIT ABSOLUTE /end AXIS_PTS
/begin CHARACTERISTIC Cal_TempTrnkOpnMtrStartSpdAdd "" VAL_BLK 0xB000725C Scalar_UWORD 0 RDM_DetTrunkMoveReq_CM_uint16 0 65535 MATRIX_DIM 3 /end CHARACTERISTIC
/begin CHARACTERISTIC Cal_TrnkClsTmpThd "" VAL_BLK 0xB0007262 Scalar_BYTE 0 RDM_DetTrunkMoveReq_CM_int8 -128 127 MATRIX_DIM 3 /end CHARACTERISTIC
/begin MEASUREMENT Monr_AntiDriveTrig "" UBYTE RDM_CtrlLeverMtr_CM_boolean 0 0 0 1 ECU_ADDRESS 0xB0056355 /end MEASUREMENT
/begin MEASUREMENT Monr_CurState "" UBYTE RDM_DetTrunkMoveReq_CM_uint8 0 0 0 255 ECU_ADDRESS 0xB0056357 /end MEASUREMENT
/begin MEASUREMENT Monr_FITOut_RDLockCtr "" UBYTE RDMLatch_FITOut_CM_uint8 0 0 0 255 ECU_ADDRESS 0xB005638B /end MEASUREMENT
/begin MEASUREMENT Monr_FITOut_RDLockPWMCmd "" UBYTE RDMLatch_FITOut_CM_UINT8 0 0 0 255 ECU_ADDRESS 0xB005638A /end MEASUREMENT
/begin MEASUREMENT Monr_FITOut_RDUnLockCtr "" UBYTE RDMLatch_FITOut_CM_UINT8 0 0 0 255 ECU_ADDRESS 0xB005638C /end MEASUREMENT
/begin MEASUREMENT Monr_SOASetTgateMemHtPos "" UBYTE RDM_SOARx_CM_uint8 0 0 0 255 ECU_ADDRESS 0xB0056276 /end MEASUREMENT
/begin MEASUREMENT Monr_SOATgateMvtReq "" UBYTE RDM_SOARx_CM_uint8 0 0 0 255 ECU_ADDRESS 0xB0056275 /end MEASUREMENT
/begin MEASUREMENT Monr_TrnkAPOverRideErrSt "" UBYTE RDM_AntiPinch_CM_uint8 0 0 0 255 ECU_ADDRESS 0xB0056261 /end MEASUREMENT
/begin MEASUREMENT Monr_TrnkAbnEnvFlag "" UBYTE RDM_AntiPinch_CM_uint8 0 0 0 255 ECU_ADDRESS 0xB0056274 /end MEASUREMENT
/begin MEASUREMENT Monr_TrnkAllActnSts "" UBYTE RDM_CtrlLeverMtr_CM_uint8 0 0 0 255 ECU_ADDRESS 0xB0056260 /end MEASUREMENT
/begin MEASUREMENT Monr_TrnkAntiPinchSt "" UBYTE RDM_AntiPinch_CM_uint8 0 0 0 255 ECU_ADDRESS 0xB0056250 /end MEASUREMENT
/begin MEASUREMENT Monr_TrnkBatVoltPlungeFlag "" UBYTE RDM_AntiPinch_CM_uint8 0 0 0 255 ECU_ADDRESS 0xB005625A /end MEASUREMENT
/begin MEASUREMENT Monr_TrnkClsAPCurrThr "" UWORD RDM_AntiPinch_CM_uint16 0 0 0 65535 ECU_ADDRESS 0xB005634C /end MEASUREMENT
/begin MEASUREMENT Monr_TrnkClsAPSpdGap "" SWORD RDM_AntiPinch_CM_int16 0 0 -32768 32767 ECU_ADDRESS 0xB0056238 /end MEASUREMENT
/begin MEASUREMENT Monr_TrnkClsApdAvgCurr "" UWORD RDM_LearnRF_CM_uint16 0 0 0 65535 ECU_ADDRESS 0xB0056350 /end MEASUREMENT
/begin MEASUREMENT Monr_TrnkClsCurAPThresh "" FLOAT32_IEEE RDM_AntiPinch_CM_single 0 0 -3.4e+38 3.4e+38 ECU_ADDRESS 0xB0056240 /end MEASUREMENT
/begin MEASUREMENT Monr_TrnkClsHrdAPRefSpd "" UWORD RDM_AntiPinch_CM_uint16 0 0 0 65535 ECU_ADDRESS 0xB005623A /end MEASUREMENT
/begin MEASUREMENT Monr_TrnkClsSftAPRefSpd "" UWORD RDM_AntiPinch_CM_uint16 0 0 0 65535 ECU_ADDRESS 0xB005623C /end MEASUREMENT
/begin MEASUREMENT Monr_TrnkClsTraceAPRefSpd "" UWORD RDM_AntiPinch_CM_uint16 0 0 0 65535 ECU_ADDRESS 0xB0056236 /end MEASUREMENT
/begin MEASUREMENT Monr_TrnkCurBlockNum "" UWORD RDM_GetTrunkPos_CM_uint16 0 0 0 65535 ECU_ADDRESS 0xB0056256 /end MEASUREMENT
/begin MEASUREMENT Monr_TrnkCurRF "" SBYTE RDM_LearnRF_CM_int8 0 0 -128 127 ECU_ADDRESS 0xB0056251 /end MEASUREMENT
/begin MEASUREMENT Monr_TrnkDiagResetFlag "" UBYTE RDM_CtrlLeverMtr_CM_UINT8 0 0 0 255 ECU_ADDRESS 0xB0056262 /end MEASUREMENT
/begin MEASUREMENT Monr_TrnkExitRefSpdProcFlag "" UBYTE RDM_AntiPinch_CM_uint8 0 0 0 255 ECU_ADDRESS 0xB005634E /end MEASUREMENT
/begin MEASUREMENT Monr_TrnkExtSwSt "" UBYTE RDM_SetSwSt_CM_uint8 0 0 0 255 ECU_ADDRESS 0xB005625F /end MEASUREMENT
/begin MEASUREMENT Monr_TrnkHrdOpnPos "" SWORD RDM_GetTrunkPos_CM_int16 0 0 -32768 32767 ECU_ADDRESS 0xB005627A /end MEASUREMENT
/begin MEASUREMENT Monr_TrnkInitSt "" UBYTE RDM_GetTrunkPos_CM_uint8 0 0 0 255 ECU_ADDRESS 0xB0056224 /end MEASUREMENT
/begin MEASUREMENT Monr_TrnkIntSwSt "" UBYTE RDM_SetSwSt_CM_uint8 0 0 0 255 ECU_ADDRESS 0xB005625E /end MEASUREMENT
/begin MEASUREMENT Monr_TrnkLLvrClsStartUpFlag "" UBYTE RDM_GetTrunkPos_CM_uint8 0 0 0 255 ECU_ADDRESS 0xB0056272 /end MEASUREMENT
/begin MEASUREMENT Monr_TrnkLLvrCurPos "" SWORD RDM_GetTrunkPos_CM_int16 0 0 -32768 32767 ECU_ADDRESS 0xB005622E /end MEASUREMENT
/begin MEASUREMENT Monr_TrnkLLvrHall1Cnt "" UWORD RDM_HallDeco_CM_uint16 0 0 0 65535 ECU_ADDRESS 0xB0056264 /end MEASUREMENT
/begin MEASUREMENT Monr_TrnkLLvrHall1ErrSt "" UBYTE RDM_HallDeco_CM_uint8 0 0 0 255 ECU_ADDRESS 0xB005626C /end MEASUREMENT
/begin MEASUREMENT Monr_TrnkLLvrHall2Cnt "" UWORD RDM_HallDeco_CM_uint16 0 0 0 65535 ECU_ADDRESS 0xB0056266 /end MEASUREMENT
/begin MEASUREMENT Monr_TrnkLLvrHall2ErrSt "" UBYTE RDM_HallDeco_CM_uint8 0 0 0 255 ECU_ADDRESS 0xB005626D /end MEASUREMENT
/begin MEASUREMENT Monr_TrnkLLvrHallOffsetErrSt "" UBYTE RDM_HallDeco_CM_uint8 0 0 0 255 ECU_ADDRESS 0xB005626E /end MEASUREMENT
/begin MEASUREMENT Monr_TrnkLLvrMtrCtrlCmd "" UBYTE RDM_CtrlLeverMtr_CM_uint8 0 0 0 255 ECU_ADDRESS 0xB0056226 /end MEASUREMENT
/begin MEASUREMENT Monr_TrnkLLvrMtrPWMCmd "" UBYTE RDM_CtrlLeverMtr_CM_uint8 0 0 0 255 ECU_ADDRESS 0xB0056228 /end MEASUREMENT
/begin MEASUREMENT Monr_TrnkLLvrMtrStlSt "" UBYTE RDM_DetLeverMtrStallSt_CM_uint8 0 0 0 255 ECU_ADDRESS 0xB005622A /end MEASUREMENT
/begin MEASUREMENT Monr_TrnkLLvrOpnStartUpFlag "" UBYTE RDM_GetTrunkPos_CM_uint8 0 0 0 255 ECU_ADDRESS 0xB0056273 /end MEASUREMENT
/begin MEASUREMENT Monr_TrnkLatchSt "" UBYTE RDM_DetTrunkMoveReq_CM_UINT8 0 0 0 255 ECU_ADDRESS 0xB005625D /end MEASUREMENT
/begin MEASUREMENT Monr_TrnkMaxBlockNum "" UWORD RDM_GetTrunkPos_CM_uint16 0 0 0 65535 ECU_ADDRESS 0xB0056258 /end MEASUREMENT
/begin MEASUREMENT Monr_TrnkMemMaxOpnPos "" SWORD RDM_GetTrunkPos_CM_int16 0 0 -32768 32767 ECU_ADDRESS 0xB0056278 /end MEASUREMENT
/begin MEASUREMENT Monr_TrnkMtrSpdRqstAdjSt "" UBYTE RDM_DetTrunkMoveReq_CM_uint8 0 0 0 255 ECU_ADDRESS 0xB005627E /end MEASUREMENT
/begin MEASUREMENT Monr_TrnkMvSrc "" UBYTE RDM_DetTrunkMoveReq_CM_uint8 0 0 0 255 ECU_ADDRESS 0xB005622D /end MEASUREMENT
/begin MEASUREMENT Monr_TrnkMvSt "" UBYTE RDM_DetTrunkMoveReq_CM_uint8 0 0 0 255 ECU_ADDRESS 0xB005622C /end MEASUREMENT
/begin MEASUREMENT Monr_TrnkMvTgtMtrSpd "" UWORD RDM_DetTrunkMoveReq_CM_uint16 0 0 0 65535 ECU_ADDRESS 0xB005627C /end MEASUREMENT
/begin MEASUREMENT Monr_TrnkNotInitRes "" UBYTE RDM_GetTrunkPos_CM_uint8 0 0 0 255 ECU_ADDRESS 0xB0056225 /end MEASUREMENT
/begin MEASUREMENT Monr_TrnkOpnAPSpdGap "" SWORD RDM_AntiPinch_CM_int16 0 0 -32768 32767 ECU_ADDRESS 0xB0056246 /end MEASUREMENT
/begin MEASUREMENT Monr_TrnkOpnCurAPThresh "" FLOAT32_IEEE RDM_AntiPinch_CM_single 0 0 -3.4e+38 3.4e+38 ECU_ADDRESS 0xB005624C /end MEASUREMENT
/begin MEASUREMENT Monr_TrnkOpnTraceAPRefSpd "" UWORD RDM_AntiPinch_CM_uint16 0 0 0 65535 ECU_ADDRESS 0xB0056244 /end MEASUREMENT
/begin MEASUREMENT Monr_TrnkOpnUnlckLatchRqst "" UBYTE RDM_DetTrunkMoveReq_CM_uint8 0 0 0 255 ECU_ADDRESS 0xB005625C /end MEASUREMENT
/begin MEASUREMENT Monr_TrnkRFTblVld "" UBYTE RDM_LearnRF_CM_uint8 0 0 0 255 ECU_ADDRESS 0xB0056252 /end MEASUREMENT
/begin MEASUREMENT Monr_TrnkRLvrCurPos "" SWORD RDM_GetTrunkPos_CM_int16 0 0 -32768 32767 ECU_ADDRESS 0xB0056230 /end MEASUREMENT
/begin MEASUREMENT Monr_TrnkRLvrHall1Cnt "" UWORD RDM_HallDeco_CM_uint16 0 0 0 65535 ECU_ADDRESS 0xB0056268 /end MEASUREMENT
/begin MEASUREMENT Monr_TrnkRLvrHall1ErrSt "" UBYTE RDM_HallDeco_CM_uint8 0 0 0 255 ECU_ADDRESS 0xB005626F /end MEASUREMENT
/begin MEASUREMENT Monr_TrnkRLvrHall2Cnt "" UWORD RDM_HallDeco_CM_uint16 0 0 0 65535 ECU_ADDRESS 0xB005626A /end MEASUREMENT
/begin MEASUREMENT Monr_TrnkRLvrHall2ErrSt "" UBYTE RDM_HallDeco_CM_uint8 0 0 0 255 ECU_ADDRESS 0xB0056270 /end MEASUREMENT
/begin MEASUREMENT Monr_TrnkRLvrHallOffsetErrSt "" UBYTE RDM_HallDeco_CM_uint8 0 0 0 255 ECU_ADDRESS 0xB0056271 /end MEASUREMENT
/begin MEASUREMENT Monr_TrnkRLvrMtrCtrlCmd "" UBYTE RDM_CtrlLeverMtr_CM_uint8 0 0 0 255 ECU_ADDRESS 0xB0056227 /end MEASUREMENT
/begin MEASUREMENT Monr_TrnkRLvrMtrPWMCmd "" UBYTE RDM_CtrlLeverMtr_CM_uint8 0 0 0 255 ECU_ADDRESS 0xB0056229 /end MEASUREMENT
/begin MEASUREMENT Monr_TrnkRLvrMtrStlSt "" UBYTE RDM_DetLeverMtrStallSt_CM_uint8 0 0 0 255 ECU_ADDRESS 0xB005622B /end MEASUREMENT
/begin MEASUREMENT Monr_TrnkThermProtCnt "" UBYTE RDM_DetThermProtSt_CM_uint8 0 0 0 255 ECU_ADDRESS 0xB0056253 /end MEASUREMENT
/begin MEASUREMENT Monr_TrnkThermProtMd "" UBYTE RDM_DetThermProtSt_CM_uint8 0 0 0 255 ECU_ADDRESS 0xB0056254 /end MEASUREMENT
/begin AXIS_PTS k_ADP_Value_AmbTrawBP "" 0x807731AC monr_VfSHM_AmbTempAP_C Lookup1D_X_FLOAT32_IEEE 0 POD_AntiPinch_CM_single 10 -3.4e+38 3.4e+38 DEPOSIT ABSOLUTE /end AXIS_PTS
/begin CHARACTERISTIC k_ADP_Value_AmbTrawCOCCloseCurrentFactor "" CURVE 0xB0006170 Lookup1D_FLOAT32_IEEE 0 POD_AntiPinch_CM_single -3.4e+38 3.4e+38
 /begin AXIS_DESCR COM_AXIS monr_VfSHM_AmbTempAP_C POD_AntiPinch_CM_single 10 -3.4e+38 3.4e+38 DEPOSIT ABSOLUTE AXIS_PTS_REF k_ADP_Value_AmbTrawBP /end AXIS_DESCR
/end CHARACTERISTIC
/begin CHARACTERISTIC k_ADP_Value_AmbTrawCOCCurrentFactor "" CURVE 0xB00061D4 Lookup1D_FLOAT32_IEEE 0 POD_AntiPinch_CM_single -3.4e+38 3.4e+38
 /begin AXIS_DESCR COM_AXIS monr_VfSHM_AmbTempAP_C POD_AntiPinch_CM_single 10 -3.4e+38 3.4e+38 DEPOSIT ABSOLUTE AXIS_PTS_REF k_ADP_Value_AmbTrawBP /end AXIS_DESCR
/end CHARACTERISTIC
/begin CHARACTERISTIC k_ADP_Value_BatVoltageCOCCurrentCloseFactor "" CURVE 0xB00061FC Lookup1D_FLOAT32_IEEE 0 POD_AntiPinch_CM_single -3.4e+38 3.4e+38
 /begin AXIS_DESCR COM_AXIS monr_ADP_Value_BatVoltaget_DiffLAP POD_AntiPinch_CM_single 15 -3.4e+38 3.4e+38 DEPOSIT ABSOLUTE AXIS_PTS_REF k_ADP_Value_BatVoltageCOCCurrentCloseOffset /end AXIS_DESCR
/end CHARACTERISTIC
/begin AXIS_PTS k_ADP_Value_BatVoltageCOCCurrentCloseOffset "" 0x80773238 monr_ADP_Value_BatVoltaget_DiffLAP Lookup1D_X_FLOAT32_IEEE 0 POD_AntiPinch_CM_single 15 -3.4e+38 3.4e+38 DEPOSIT ABSOLUTE /end AXIS_PTS
/begin CHARACTERISTIC k_ADP_Value_BatVoltageCOCCurrentFactor "" CURVE 0xB0006274 Lookup1D_FLOAT32_IEEE 0 POD_AntiPinch_CM_single -3.4e+38 3.4e+38
 /begin AXIS_DESCR COM_AXIS monr_ADP_Value_BatVoltaget_DiffLAP POD_AntiPinch_CM_single 15 -3.4e+38 3.4e+38 DEPOSIT ABSOLUTE AXIS_PTS_REF k_ADP_Value_BatVoltageCOCCurrentOffset /end AXIS_DESCR
/end CHARACTERISTIC
/begin AXIS_PTS k_ADP_Value_BatVoltageCOCCurrentOffset "" 0x807732B0 monr_ADP_Value_BatVoltaget_DiffLAP Lookup1D_X_FLOAT32_IEEE 0 POD_AntiPinch_CM_single 15 -3.4e+38 3.4e+38 DEPOSIT ABSOLUTE /end AXIS_PTS
/begin CHARACTERISTIC k_ADP_Value_CurrentCompensateLimitMax "" VALUE 0xB0006144 Scalar_FLOAT32_IEEE 0 POD_AntiPinch_CM_single -3.4e+38 3.4e+38 /end CHARACTERISTIC
/begin CHARACTERISTIC k_ADP_Value_CurrentLimitClose "" VAL_BLK 0xB00062EC Scalar_FLOAT32_IEEE 0 POD_AntiPinch_CM_single -3.4e+38 3.4e+38 MATRIX_DIM 5 /end CHARACTERISTIC
/begin CHARACTERISTIC k_ADP_Value_CurrentLimitMinPntClose "" VALUE 0xB000614C Scalar_FLOAT32_IEEE 0 POD_AntiPinch_CM_single -3.4e+38 3.4e+38 /end CHARACTERISTIC
/begin CHARACTERISTIC k_ADP_Value_CurrentLimitOpen "" VAL_BLK 0xB0006300 Scalar_FLOAT32_IEEE 0 POD_AntiPinch_CM_single -3.4e+38 3.4e+38 MATRIX_DIM 5 /end CHARACTERISTIC
/begin CHARACTERISTIC k_ADP_Value_CurrentRefPositionforAntiPinch "" VALUE 0xB000615C Scalar_SWORD 0 POD_AntiPinch_CM_int16 -32768 32767 /end CHARACTERISTIC
/begin CHARACTERISTIC k_HHM_Ti_SequenceTime "" VALUE 0xB00063EC Scalar_FLOAT32_IEEE 0 POD_HallHandleModule_TZCU_CM_single -3.4e+38 3.4e+38 /end CHARACTERISTIC
/begin CHARACTERISTIC k_HHM_Ti_TimeManualDoorCloseMovSts "" VALUE 0xB0006414 Scalar_FLOAT32_IEEE 0 POD_HallHandleModule_TZCU_CM_single -3.4e+38 3.4e+38 /end CHARACTERISTIC
/begin CHARACTERISTIC k_HHM_Ti_TimeManualDoorOpenMovSts "" VALUE 0xB0006418 Scalar_FLOAT32_IEEE 0 POD_HallHandleModule_TZCU_CM_single -3.4e+38 3.4e+38 /end CHARACTERISTIC
/begin MEASUREMENT monr_VbAP_AntiPinchStsDspLFH_flg "" UBYTE POD_FaultHandle_CM_boolean 0 0 0 1 ECU_ADDRESS 0xB0055A98 /end MEASUREMENT
/begin MEASUREMENT monr_VbAP_AntiPinchStsDspLSMML_flg "" UBYTE POD_SMML_CM_boolean 0 0 0 1 ECU_ADDRESS 0xB0056005 /end MEASUREMENT
/begin MEASUREMENT monr_VbAP_AntiPinchStsDspRFH_flg "" UBYTE POD_FaultHandle_CM_boolean 0 0 0 1 ECU_ADDRESS 0xB0055A99 /end MEASUREMENT
/begin MEASUREMENT monr_VbAP_AntiPinchStsDspRSHM_flg "" UBYTE POD_SignalHandModule_T_CM_boolean 0 0 0 1 ECU_ADDRESS 0xB0055E79 /end MEASUREMENT
/begin MEASUREMENT monr_VbAP_AntiPinchStsDspRSMMR_flg "" UBYTE POD_SMMR_CM_boolean 0 0 0 1 ECU_ADDRESS 0xB005605A /end MEASUREMENT
/begin MEASUREMENT monr_VbAP_ReferenceCurrentResRAP_flg "" UBYTE POD_AntiPinch_CM_boolean 0 0 0 1 ECU_ADDRESS 0xB00558B0 /end MEASUREMENT
/begin MEASUREMENT monr_VbAP_ThermprotnLSMML_flg "" UBYTE POD_SMML_CM_boolean 0 0 0 1 ECU_ADDRESS 0xB0056008 /end MEASUREMENT
/begin MEASUREMENT monr_VbFH_AnptiplayLSMML_flg "" UBYTE POD_SMML_CM_boolean 0 0 0 1 ECU_ADDRESS 0xB0056006 /end MEASUREMENT
/begin MEASUREMENT monr_VbFH_AnptiplayRSMMR_flg "" UBYTE POD_SMMR_CM_boolean 0 0 0 1 ECU_ADDRESS 0xB0056073 /end MEASUREMENT
/begin MEASUREMENT monr_VbFH_ECUWakeUpLHHM_flg "" UBYTE POD_HallHandleModule_TZCU_CM_boolean 0 0 0 1 ECU_ADDRESS 0xB0055B94 /end MEASUREMENT
/begin MEASUREMENT monr_VbFH_ECUWakeUpLSMML_flg "" UBYTE POD_SMML_CM_boolean 0 0 0 1 ECU_ADDRESS 0xB0055FF4 /end MEASUREMENT
/begin MEASUREMENT monr_VbFH_ECUWakeUpRHHM_flg "" UBYTE POD_HallHandleModule_TZCU_CM_boolean 0 0 0 1 ECU_ADDRESS 0xB0055B95 /end MEASUREMENT
/begin MEASUREMENT monr_VbFH_ECUWakeUpRSMMR_flg "" UBYTE POD_SMMR_CM_boolean 0 0 0 1 ECU_ADDRESS 0xB0056053 /end MEASUREMENT
/begin MEASUREMENT monr_VbFH_FrbdMaiMotWrkLHHM_flg "" UBYTE POD_HallHandleModule_TZCU_CM_boolean 0 0 0 1 ECU_ADDRESS 0xB0055B96 /end MEASUREMENT
/begin MEASUREMENT monr_VbFH_FrbdMaiMotWrkLMCML_flg "" UBYTE POD_MCML_CM_boolean 0 0 0 1 ECU_ADDRESS 0xB0055D3E /end MEASUREMENT
/begin MEASUREMENT monr_VbFH_FrbdMaiMotWrkLMCMR_flg "" UBYTE POD_MCMR_CM_boolean 0 0 0 1 ECU_ADDRESS 0xB0055DD8 /end MEASUREMENT
/begin MEASUREMENT monr_VbFH_FrbdMaiMotWrkLSMML_flg "" UBYTE POD_SMML_CM_boolean 0 0 0 1 ECU_ADDRESS 0xB0056047 /end MEASUREMENT
/begin MEASUREMENT monr_VbFH_FrbdMaiMotWrkRHHM_flg "" UBYTE POD_HallHandleModule_TZCU_CM_boolean 0 0 0 1 ECU_ADDRESS 0xB0055B97 /end MEASUREMENT
/begin MEASUREMENT monr_VbFH_FrbdMaiMotWrkRSMMR_flg "" UBYTE POD_SMMR_CM_boolean 0 0 0 1 ECU_ADDRESS 0xB0056089 /end MEASUREMENT
/begin MEASUREMENT monr_VbFH_FrntIncinAgFltLSMML_flg "" UBYTE POD_SMML_CM_boolean 0 0 0 1 ECU_ADDRESS 0xB005603D /end MEASUREMENT
/begin MEASUREMENT monr_VbFH_FrntIncinAgFltRSMMR_flg "" UBYTE POD_SMMR_CM_boolean 0 0 0 1 ECU_ADDRESS 0xB0056098 /end MEASUREMENT
/begin MEASUREMENT monr_VbFH_GyroSigFltLTTR_flg "" UBYTE POD_TipToRun_CM_boolean 0 0 0 1 ECU_ADDRESS 0xB0056168 /end MEASUREMENT
/begin MEASUREMENT monr_VbFH_GyroSigFltRTTR_flg "" UBYTE POD_TipToRun_CM_boolean 0 0 0 1 ECU_ADDRESS 0xB0056169 /end MEASUREMENT
/begin MEASUREMENT monr_VbFH_HallSigErrLHHM_flg "" UBYTE POD_HallHandleModule_TZCU_CM_boolean 0 0 0 1 ECU_ADDRESS 0xB0055B9A /end MEASUREMENT
/begin MEASUREMENT monr_VbFH_HallSigErrLMCML_flg "" UBYTE POD_MCML_CM_boolean 0 0 0 1 ECU_ADDRESS 0xB0055D3F /end MEASUREMENT
/begin MEASUREMENT monr_VbFH_HallSigErrLMCMR_flg "" UBYTE POD_MCMR_CM_boolean 0 0 0 1 ECU_ADDRESS 0xB0055DCC /end MEASUREMENT
/begin MEASUREMENT monr_VbFH_HallSigErrLSMML_flg "" UBYTE POD_SMML_CM_boolean 0 0 0 1 ECU_ADDRESS 0xB0056045 /end MEASUREMENT
/begin MEASUREMENT monr_VbFH_HallSigErrLTTR_flg "" UBYTE POD_TipToRun_CM_boolean 0 0 0 1 ECU_ADDRESS 0xB005616A /end MEASUREMENT
/begin MEASUREMENT monr_VbFH_HallSigErrRHHM_flg "" UBYTE POD_HallHandleModule_TZCU_CM_boolean 0 0 0 1 ECU_ADDRESS 0xB0055B9B /end MEASUREMENT
/begin MEASUREMENT monr_VbFH_HallSigErrRSMMR_flg "" UBYTE POD_SMMR_CM_boolean 0 0 0 1 ECU_ADDRESS 0xB00560A4 /end MEASUREMENT
/begin MEASUREMENT monr_VbFH_HallSigErrRTTR_flg "" UBYTE POD_TipToRun_CM_boolean 0 0 0 1 ECU_ADDRESS 0xB005616B /end MEASUREMENT
/begin MEASUREMENT monr_VbFH_RdrTioutLSMML_flg "" UBYTE POD_SMML_CM_boolean 0 0 0 1 ECU_ADDRESS 0xB0056044 /end MEASUREMENT
/begin MEASUREMENT monr_VbFH_RdrTioutRSMMR_flg "" UBYTE POD_SMMR_CM_boolean 0 0 0 1 ECU_ADDRESS 0xB0056088 /end MEASUREMENT
/begin MEASUREMENT monr_VbFH_SideIncinAgFltLSMML_flg "" UBYTE POD_SMML_CM_boolean 0 0 0 1 ECU_ADDRESS 0xB005603E /end MEASUREMENT
/begin MEASUREMENT monr_VbFH_SideIncinAgFltRSMMR_flg "" UBYTE POD_SMMR_CM_boolean 0 0 0 1 ECU_ADDRESS 0xB0056099 /end MEASUREMENT
/begin MEASUREMENT monr_VbFH_ThermprotnRSMMR_flg "" UBYTE POD_SMMR_CM_boolean 0 0 0 1 ECU_ADDRESS 0xB0056071 /end MEASUREMENT
/begin MEASUREMENT monr_VbHHM_DoorOpenLAP_flg "" UBYTE POD_AntiPinch_CM_boolean 0 0 0 1 ECU_ADDRESS 0xB0055900 /end MEASUREMENT
/begin MEASUREMENT monr_VbHHM_DoorOpenLMCML_flg "" UBYTE POD_MCML_CM_boolean 0 0 0 1 ECU_ADDRESS 0xB0055D50 /end MEASUREMENT
/begin MEASUREMENT monr_VbHHM_DoorOpenLMCMR_flg "" UBYTE POD_MCMR_CM_boolean 0 0 0 1 ECU_ADDRESS 0xB0055DDE /end MEASUREMENT
/begin MEASUREMENT monr_VbHHM_DoorOpenLSMML_flg "" UBYTE POD_SMML_CM_boolean 0 0 0 1 ECU_ADDRESS 0xB0056009 /end MEASUREMENT
/begin MEASUREMENT monr_VbHHM_DoorOpenRAP_flg "" UBYTE POD_AntiPinch_CM_boolean 0 0 0 1 ECU_ADDRESS 0xB0055901 /end MEASUREMENT
/begin MEASUREMENT monr_VbHHM_DoorOpenRSMMR_flg "" UBYTE POD_SMMR_CM_boolean 0 0 0 1 ECU_ADDRESS 0xB0056072 /end MEASUREMENT
/begin MEASUREMENT monr_VbHHM_HallSigFltLFH_flg "" UBYTE POD_FaultHandle_CM_boolean 0 0 0 1 ECU_ADDRESS 0xB0055AEC /end MEASUREMENT
/begin MEASUREMENT monr_VbHHM_HallSigFltRFH_flg "" UBYTE POD_FaultHandle_CM_boolean 0 0 0 1 ECU_ADDRESS 0xB0055AED /end MEASUREMENT
/begin MEASUREMENT monr_VbMCM_ManualAssistLMBCL_flag "" UBYTE POD_MBCL_CM_boolean 0 0 0 1 ECU_ADDRESS 0xB0055CEC /end MEASUREMENT
/begin MEASUREMENT monr_VbMCM_ManualAssistRMBCR_flag "" UBYTE POD_MBCR_CM_boolean 0 0 0 1 ECU_ADDRESS 0xB0055CFD /end MEASUREMENT
/begin MEASUREMENT monr_VbMCM_MotorBrkgLMBCL_flg "" UBYTE POD_MBCL_CM_boolean 0 0 0 1 ECU_ADDRESS 0xB0055CDB /end MEASUREMENT
/begin MEASUREMENT monr_VbMCM_MotorBrkgRMBCR_flg "" UBYTE POD_MBCR_CM_boolean 0 0 0 1 ECU_ADDRESS 0xB0055CF9 /end MEASUREMENT
/begin MEASUREMENT monr_VbMCM_TipToRunLMBCL_flag "" UBYTE POD_MBCL_CM_boolean 0 0 0 1 ECU_ADDRESS 0xB0055CCC /end MEASUREMENT
/begin MEASUREMENT monr_VbMCM_TipToRunRMBCR_flag "" UBYTE POD_MBCR_CM_boolean 0 0 0 1 ECU_ADDRESS 0xB0055CF8 /end MEASUREMENT
/begin MEASUREMENT monr_VbSHM_IceBreakDoorActvLSMML_flg "" UBYTE POD_SMML_CM_boolean 0 0 0 1 ECU_ADDRESS 0xB0055FF8 /end MEASUREMENT
/begin MEASUREMENT monr_VbSHM_IceBreakDoorActvRSMMR_flg "" UBYTE POD_SMMR_CM_boolean 0 0 0 1 ECU_ADDRESS 0xB005608E /end MEASUREMENT
/begin MEASUREMENT monr_VbSMM_BrkFrcRelsLFH_flg "" UBYTE POD_FaultHandle_CM_boolean 0 0 0 1 ECU_ADDRESS 0xB0055AFA /end MEASUREMENT
/begin MEASUREMENT monr_VbSMM_BrkFrcRelsRFH_flg "" UBYTE POD_FaultHandle_CM_boolean 0 0 0 1 ECU_ADDRESS 0xB0055AFB /end MEASUREMENT
/begin MEASUREMENT monr_VbSMM_BrkMotModCtrlLFH_flg "" UBYTE POD_FaultHandle_CM_boolean 0 0 0 1 ECU_ADDRESS 0xB0055AFC /end MEASUREMENT
/begin MEASUREMENT monr_VbSMM_BrkMotModCtrlLTTR_flg "" UBYTE POD_TipToRun_CM_boolean 0 0 0 1 ECU_ADDRESS 0xB005616C /end MEASUREMENT
/begin MEASUREMENT monr_VbSMM_BrkMotModCtrlRFH_flg "" UBYTE POD_FaultHandle_CM_boolean 0 0 0 1 ECU_ADDRESS 0xB0055AFD /end MEASUREMENT
/begin MEASUREMENT monr_VbSMM_BrkMotModCtrlRTTR_flg "" UBYTE POD_TipToRun_CM_boolean 0 0 0 1 ECU_ADDRESS 0xB005616D /end MEASUREMENT
/begin MEASUREMENT monr_VbSMM_DoorFreeMovgLTTR_flg "" UBYTE POD_TipToRun_CM_boolean 0 0 0 1 ECU_ADDRESS 0xB005616E /end MEASUREMENT
/begin MEASUREMENT monr_VbSMM_DoorFreeMovgRTTR_flg "" UBYTE POD_TipToRun_CM_boolean 0 0 0 1 ECU_ADDRESS 0xB005616F /end MEASUREMENT
/begin MEASUREMENT monr_VbSMM_ElecDoorClsReqLFH_flg "" UBYTE POD_FaultHandle_CM_boolean 0 0 0 1 ECU_ADDRESS 0xB0055AFE /end MEASUREMENT
/begin MEASUREMENT monr_VbSMM_ElecDoorClsReqRFH_flg "" UBYTE POD_FaultHandle_CM_boolean 0 0 0 1 ECU_ADDRESS 0xB0055AFF /end MEASUREMENT
/begin MEASUREMENT monr_VbSMM_ElecDoorOpenReqLFH_flg "" UBYTE POD_FaultHandle_CM_boolean 0 0 0 1 ECU_ADDRESS 0xB0055B00 /end MEASUREMENT
/begin MEASUREMENT monr_VbSMM_ElecDoorOpenReqRFH_flg "" UBYTE POD_FaultHandle_CM_boolean 0 0 0 1 ECU_ADDRESS 0xB0055B01 /end MEASUREMENT
/begin MEASUREMENT monr_VbSMM_HoldModeLMBCL_flg "" UBYTE POD_MBCL_CM_boolean 0 0 0 1 ECU_ADDRESS 0xB0055CD6 /end MEASUREMENT
/begin MEASUREMENT monr_VbSMM_HoldModeLMCML_flg "" UBYTE POD_MCML_CM_boolean 0 0 0 1 ECU_ADDRESS 0xB0055D86 /end MEASUREMENT
/begin MEASUREMENT monr_VbSMM_HoldModeRMBCR_flg "" UBYTE POD_MBCR_CM_boolean 0 0 0 1 ECU_ADDRESS 0xB0055D0B /end MEASUREMENT
/begin MEASUREMENT monr_VbSMM_HoldModeRMCMR_flg "" UBYTE POD_MCMR_CM_boolean 0 0 0 1 ECU_ADDRESS 0xB0055E19 /end MEASUREMENT
/begin MEASUREMENT monr_VbSMM_ManAsstEnableLTTR_flg "" UBYTE POD_TipToRun_CM_boolean 0 0 0 1 ECU_ADDRESS 0xB0056170 /end MEASUREMENT
/begin MEASUREMENT monr_VbSMM_ManAsstEnableRTTR_flg "" UBYTE POD_TipToRun_CM_boolean 0 0 0 1 ECU_ADDRESS 0xB0056171 /end MEASUREMENT
/begin MEASUREMENT monr_VbSMM_RdrWrkReqByCEMLSHM_flg "" UBYTE POD_SignalHandModule_T_CM_boolean 0 0 0 1 ECU_ADDRESS 0xB0055E92 /end MEASUREMENT
/begin MEASUREMENT monr_VbSMM_RdrWrkReqByCEMRSHM_flg "" UBYTE POD_SignalHandModule_T_CM_boolean 0 0 0 1 ECU_ADDRESS 0xB0055E93 /end MEASUREMENT
/begin MEASUREMENT monr_VbSMM_RdrWrkReqLFH_flg "" UBYTE POD_FaultHandle_CM_boolean 0 0 0 1 ECU_ADDRESS 0xB0055B02 /end MEASUREMENT
/begin MEASUREMENT monr_VbSMM_RdrWrkReqRFH_flg "" UBYTE POD_FaultHandle_CM_boolean 0 0 0 1 ECU_ADDRESS 0xB0055B03 /end MEASUREMENT
/begin MEASUREMENT monr_VbSMM_TiptoRunEnableLTTR_flg "" UBYTE POD_TipToRun_CM_boolean 0 0 0 1 ECU_ADDRESS 0xB0056172 /end MEASUREMENT
/begin MEASUREMENT monr_VbSMM_TiptoRunEnableRTTR_flg "" UBYTE POD_TipToRun_CM_boolean 0 0 0 1 ECU_ADDRESS 0xB0056173 /end MEASUREMENT
/begin MEASUREMENT monr_VbTTR_TipToRunRqstLSHM_flg "" UBYTE POD_SignalHandModule_T_CM_boolean 0 0 0 1 ECU_ADDRESS 0xB0055E96 /end MEASUREMENT
/begin MEASUREMENT monr_VbTTR_TipToRunRqstLSMML_flg "" UBYTE POD_SMML_CM_boolean 0 0 0 1 ECU_ADDRESS 0xB0056025 /end MEASUREMENT
/begin MEASUREMENT monr_VbTTR_TipToRunRqstRSMMR_flg "" UBYTE POD_SMMR_CM_boolean 0 0 0 1 ECU_ADDRESS 0xB0056064 /end MEASUREMENT
/begin MEASUREMENT monr_VeFH_DoorLckPstnLAP_enum "" UBYTE POD_AntiPinch_CM_uint8 0 0 0 255 ECU_ADDRESS 0xB0055904 /end MEASUREMENT
/begin MEASUREMENT monr_VeFH_DoorLckPstnLHHM_enum "" UBYTE POD_HallHandleModule_TZCU_CM_uint8 0 0 0 255 ECU_ADDRESS 0xB0055BD2 /end MEASUREMENT
/begin MEASUREMENT monr_VeFH_DoorLckPstnRAP_enum "" UBYTE POD_AntiPinch_CM_uint8 0 0 0 255 ECU_ADDRESS 0xB0055905 /end MEASUREMENT
/begin MEASUREMENT monr_VeFH_DoorLckPstnRHHM_enum "" UBYTE POD_HallHandleModule_TZCU_CM_uint8 0 0 0 255 ECU_ADDRESS 0xB0055BD3 /end MEASUREMENT
/begin MEASUREMENT monr_VeHHM_DoorMovStsLFH_NULL "" UBYTE POD_FaultHandle_CM_uint8 0 0 0 255 ECU_ADDRESS 0xB0055B0F /end MEASUREMENT
/begin MEASUREMENT monr_VeHHM_DoorMovStsLMCML_NULL "" UBYTE POD_MCML_CM_uint8 0 0 0 255 ECU_ADDRESS 0xB0055D51 /end MEASUREMENT
/begin MEASUREMENT monr_VeHHM_DoorMovStsLSMML_NULL "" UBYTE POD_SMML_CM_uint8 0 0 0 255 ECU_ADDRESS 0xB005600A /end MEASUREMENT
/begin MEASUREMENT monr_VeHHM_DoorMovStsLTTR_NULL "" UBYTE POD_TipToRun_CM_uint8 0 0 0 255 ECU_ADDRESS 0xB0056176 /end MEASUREMENT
/begin MEASUREMENT monr_VeHHM_DoorMovStsRFH_NULL "" UBYTE POD_FaultHandle_CM_uint8 0 0 0 255 ECU_ADDRESS 0xB0055B10 /end MEASUREMENT
/begin MEASUREMENT monr_VeHHM_DoorMovStsRMCMR_NULL "" UBYTE POD_MCMR_CM_uint8 0 0 0 255 ECU_ADDRESS 0xB0055DE8 /end MEASUREMENT
/begin MEASUREMENT monr_VeHHM_DoorMovStsRSMMR_NULL "" UBYTE POD_SMMR_CM_uint8 0 0 0 255 ECU_ADDRESS 0xB0056074 /end MEASUREMENT
/begin MEASUREMENT monr_VeHHM_DoorMovStsRTTR_NULL "" UBYTE POD_TipToRun_CM_uint8 0 0 0 255 ECU_ADDRESS 0xB0056177 /end MEASUREMENT
/begin MEASUREMENT monr_VeHHM_SectorIndexLAP_enum "" UBYTE POD_AntiPinch_CM_uint8 0 0 0 255 ECU_ADDRESS 0xB0055906 /end MEASUREMENT
/begin MEASUREMENT monr_VeHHM_SectorIndexLMCML_enum "" UBYTE POD_MCML_CM_uint8 0 0 0 255 ECU_ADDRESS 0xB0055D52 /end MEASUREMENT
/begin MEASUREMENT monr_VeHHM_SectorIndexRAP_enum "" UBYTE POD_AntiPinch_CM_uint8 0 0 0 255 ECU_ADDRESS 0xB0055907 /end MEASUREMENT
/begin MEASUREMENT monr_VeHHM_SectorIndexRMCMR_enum "" UBYTE POD_MCMR_CM_uint8 0 0 0 255 ECU_ADDRESS 0xB0055DE9 /end MEASUREMENT
/begin MEASUREMENT monr_VeHHM_UsrSetMaxPstnLFH_pct "" UBYTE POD_FaultHandle_CM_uint8 0 0 0 255 ECU_ADDRESS 0xB0055B11 /end MEASUREMENT
/begin MEASUREMENT monr_VeHHM_UsrSetMaxPstnLSHM_pct "" UBYTE POD_SignalHandModule_T_CM_uint8 0 0 0 255 ECU_ADDRESS 0xB0055E97 /end MEASUREMENT
/begin MEASUREMENT monr_VeHHM_UsrSetMaxPstnLSMML_pct "" UBYTE POD_SMML_CM_uint8 0 0 0 255 ECU_ADDRESS 0xB0056004 /end MEASUREMENT
/begin MEASUREMENT monr_VeHHM_UsrSetMaxPstnRFH_pct "" UBYTE POD_FaultHandle_CM_uint8 0 0 0 255 ECU_ADDRESS 0xB0055B12 /end MEASUREMENT
/begin MEASUREMENT monr_VeHHM_UsrSetMaxPstnRSHM_pct "" UBYTE POD_SignalHandModule_T_CM_uint8 0 0 0 255 ECU_ADDRESS 0xB0055E98 /end MEASUREMENT
/begin MEASUREMENT monr_VeHHM_UsrSetMaxPstnRSMMR_pct "" UBYTE POD_SMMR_CM_uint8 0 0 0 255 ECU_ADDRESS 0xB0056058 /end MEASUREMENT
/begin MEASUREMENT monr_VeINP_AirIntakeStSHM_pct "" UBYTE POD_SignalHandModule_T_CM_uint8 0 0 0 255 ECU_ADDRESS 0xB0055E99 /end MEASUREMENT
/begin MEASUREMENT monr_VeINP_DOWLXWarningSHM_enum "" UBYTE POD_SignalHandModule_T_CM_uint8 0 0 0 255 ECU_ADDRESS 0xB0055E9D /end MEASUREMENT
/begin MEASUREMENT monr_VeINP_DOWRXWarningSHM_enum "" UBYTE POD_SignalHandModule_T_CM_uint8 0 0 0 255 ECU_ADDRESS 0xB0055E9E /end MEASUREMENT
/begin MEASUREMENT monr_VeINP_DRMXLErrSHM_enum "" UBYTE POD_SignalHandModule_T_CM_uint8 0 0 0 255 ECU_ADDRESS 0xB0055E9F /end MEASUREMENT
/begin MEASUREMENT monr_VeINP_DRMXLStSHM_enum "" UBYTE POD_SignalHandModule_T_CM_uint8 0 0 0 255 ECU_ADDRESS 0xB0055EA0 /end MEASUREMENT
/begin MEASUREMENT monr_VeINP_DRMXRErrSHM_enum "" UBYTE POD_SignalHandModule_T_CM_uint8 0 0 0 255 ECU_ADDRESS 0xB0055EA1 /end MEASUREMENT
/begin MEASUREMENT monr_VeINP_DRMXRStSHM_enum "" UBYTE POD_SignalHandModule_T_CM_uint8 0 0 0 255 ECU_ADDRESS 0xB0055EA2 /end MEASUREMENT
/begin MEASUREMENT monr_VeINP_DoorOpenerXLReqSHM_enum "" UBYTE POD_SignalHandModule_T_CM_uint8 0 0 0 255 ECU_ADDRESS 0xB0055E9A /end MEASUREMENT
/begin MEASUREMENT monr_VeINP_DoorOpenerXRReqSHM_enum "" UBYTE POD_SignalHandModule_T_CM_uint8 0 0 0 255 ECU_ADDRESS 0xB0055E9B /end MEASUREMENT
/begin MEASUREMENT monr_VeINP_ExterTempVDSHM_enum "" UBYTE POD_SignalHandModule_T_CM_uint8 0 0 0 255 ECU_ADDRESS 0xB0055EA3 /end MEASUREMENT
/begin MEASUREMENT monr_VeINP_FLWinPosStFBSHM_pct "" UBYTE POD_SignalHandModule_T_CM_uint8 0 0 0 255 ECU_ADDRESS 0xB0055EA4 /end MEASUREMENT
/begin MEASUREMENT monr_VeINP_FRWinPosStFBSHM_pct "" UBYTE POD_SignalHandModule_T_CM_uint8 0 0 0 255 ECU_ADDRESS 0xB0055EA5 /end MEASUREMENT
/begin MEASUREMENT monr_VeINP_ModSetSHM_enum "" UBYTE POD_SignalHandModule_T_CM_uint8 0 0 0 255 ECU_ADDRESS 0xB0055EAB /end MEASUREMENT
/begin MEASUREMENT monr_VeINP_RLWinPosStFBSHM_pct "" UBYTE POD_SignalHandModule_T_CM_uint8 0 0 0 255 ECU_ADDRESS 0xB0055EAD /end MEASUREMENT
/begin MEASUREMENT monr_VeINP_RRWinPosStFBSHM_pct "" UBYTE POD_SignalHandModule_T_CM_uint8 0 0 0 255 ECU_ADDRESS 0xB0055EAF /end MEASUREMENT
/begin MEASUREMENT monr_VeINP_RoofPosValueSHM_pct "" UBYTE POD_SignalHandModule_T_CM_uint8 0 0 0 255 ECU_ADDRESS 0xB0055EAE /end MEASUREMENT
/begin MEASUREMENT monr_VeINP_TgatePosSHM_pct "" UBYTE POD_SignalHandModule_T_CM_uint8 0 0 0 255 ECU_ADDRESS 0xB0055EB6 /end MEASUREMENT
/begin MEASUREMENT monr_VeINP_VehSpdVDSHM_enum "" UBYTE POD_SignalHandModule_T_CM_uint8 0 0 0 255 ECU_ADDRESS 0xB0055EB8 /end MEASUREMENT
/begin MEASUREMENT monr_VeINP_WindExitSpdSHM_enum "" UBYTE POD_SignalHandModule_T_CM_uint8 0 0 0 255 ECU_ADDRESS 0xB0055EBA /end MEASUREMENT
/begin MEASUREMENT monr_VeINP_XLDoorLockStSHM_enum "" UBYTE POD_SignalHandModule_T_CM_uint8 0 0 0 255 ECU_ADDRESS 0xB0055EBB /end MEASUREMENT
/begin MEASUREMENT monr_VeINP_XLDoorOpenAgSHM_deg "" UBYTE POD_SignalHandModule_T_CM_uint8 0 0 0 255 ECU_ADDRESS 0xB0055EBC /end MEASUREMENT
/begin MEASUREMENT monr_VeINP_XLMaiMotOCErrSHM_flg "" UBYTE POD_SignalHandModule_T_CM_uint8 0 0 0 255 ECU_ADDRESS 0xB0055EC0 /end MEASUREMENT
/begin MEASUREMENT monr_VeINP_XLMaiMotSCBErrSHM_flg "" UBYTE POD_SignalHandModule_T_CM_uint8 0 0 0 255 ECU_ADDRESS 0xB0055EC1 /end MEASUREMENT
/begin MEASUREMENT monr_VeINP_XLMaiMotSCGErrSHM_flg "" UBYTE POD_SignalHandModule_T_CM_uint8 0 0 0 255 ECU_ADDRESS 0xB0055EC2 /end MEASUREMENT
/begin MEASUREMENT monr_VeINP_XLPitchAgVDSHM_enum "" UBYTE POD_SignalHandModule_T_CM_uint8 0 0 0 255 ECU_ADDRESS 0xB0055EC3 /end MEASUREMENT
/begin MEASUREMENT monr_VeINP_XLReqSHM_enum "" UBYTE POD_SignalHandModule_T_CM_uint8 0 0 0 255 ECU_ADDRESS 0xB0055EC4 /end MEASUREMENT
/begin MEASUREMENT monr_VeINP_XLRollAgVDSHM_enum "" UBYTE POD_SignalHandModule_T_CM_uint8 0 0 0 255 ECU_ADDRESS 0xB0055EC5 /end MEASUREMENT
/begin MEASUREMENT monr_VeINP_XRDoorLockStSHM_enum "" UBYTE POD_SignalHandModule_T_CM_uint8 0 0 0 255 ECU_ADDRESS 0xB0055EC6 /end MEASUREMENT
/begin MEASUREMENT monr_VeINP_XRDoorOpenAgSHM_deg "" UBYTE POD_SignalHandModule_T_CM_uint8 0 0 0 255 ECU_ADDRESS 0xB0055EC7 /end MEASUREMENT
/begin MEASUREMENT monr_VeINP_XRMaiMotOCErrSHM_flg "" UBYTE POD_SignalHandModule_T_CM_uint8 0 0 0 255 ECU_ADDRESS 0xB0055ECB /end MEASUREMENT
/begin MEASUREMENT monr_VeINP_XRMaiMotSCBErrSHM_flg "" UBYTE POD_SignalHandModule_T_CM_uint8 0 0 0 255 ECU_ADDRESS 0xB0055ECC /end MEASUREMENT
/begin MEASUREMENT monr_VeINP_XRMaiMotSCGErrSHM_flg "" UBYTE POD_SignalHandModule_T_CM_uint8 0 0 0 255 ECU_ADDRESS 0xB0055ECD /end MEASUREMENT
/begin MEASUREMENT monr_VeINP_XRPitchAgVDSHM_enum "" UBYTE POD_SignalHandModule_T_CM_uint8 0 0 0 255 ECU_ADDRESS 0xB0055ECE /end MEASUREMENT
/begin MEASUREMENT monr_VeINP_XRReqSHM_enum "" UBYTE POD_SignalHandModule_T_CM_uint8 0 0 0 255 ECU_ADDRESS 0xB0055ECF /end MEASUREMENT
/begin MEASUREMENT monr_VeINP_XRRollAgVDSHM_enum "" UBYTE POD_SignalHandModule_T_CM_uint8 0 0 0 255 ECU_ADDRESS 0xB0055ED0 /end MEASUREMENT
/begin MEASUREMENT monr_VeMCM_CmdStateLFH_NULL "" UBYTE POD_FaultHandle_CM_uint8 0 0 0 255 ECU_ADDRESS 0xB0055B15 /end MEASUREMENT
/begin MEASUREMENT monr_VeMCM_CmdStateLSMML_NULL "" UBYTE POD_SMML_CM_uint8 0 0 0 255 ECU_ADDRESS 0xB0056049 /end MEASUREMENT
/begin MEASUREMENT monr_VeMCM_CmdStateRFH_NULL "" UBYTE POD_FaultHandle_CM_uint8 0 0 0 255 ECU_ADDRESS 0xB0055B16 /end MEASUREMENT
/begin MEASUREMENT monr_VeMCM_CmdStateRSMMR_NULL "" UBYTE POD_SMMR_CM_uint8 0 0 0 255 ECU_ADDRESS 0xB005608A /end MEASUREMENT
/begin MEASUREMENT monr_VeMCM_MotorCtrlModeLSHM_enum "" UBYTE POD_SignalHandModule_T_CM_uint8 0 0 0 255 ECU_ADDRESS 0xB0055ED1 /end MEASUREMENT
/begin MEASUREMENT monr_VeMCM_MotorCtrlModeRSHM_enum "" UBYTE POD_SignalHandModule_T_CM_uint8 0 0 0 255 ECU_ADDRESS 0xB0055ED2 /end MEASUREMENT
/begin MEASUREMENT monr_VeSHM_CbnPressLvlAP_enum "" UBYTE POD_AntiPinch_CM_uint8 0 0 0 255 ECU_ADDRESS 0xB0055908 /end MEASUREMENT
/begin MEASUREMENT monr_VeSHM_CbnPressLvlMCML_enum "" UBYTE POD_MCML_CM_uint8 0 0 0 255 ECU_ADDRESS 0xB0055D70 /end MEASUREMENT
/begin MEASUREMENT monr_VeSHM_CbnPressLvlMCMR_enum "" UBYTE POD_MCMR_CM_uint8 0 0 0 255 ECU_ADDRESS 0xB0055E04 /end MEASUREMENT
/begin MEASUREMENT monr_VeSHM_DoorLckPstnLFH_enum "" UBYTE POD_FaultHandle_CM_uint8 0 0 0 255 ECU_ADDRESS 0xB0055B17 /end MEASUREMENT
/begin MEASUREMENT monr_VeSHM_DoorLckPstnLSMML_enum "" UBYTE POD_SMML_CM_uint8 0 0 0 255 ECU_ADDRESS 0xB0055FFA /end MEASUREMENT
/begin MEASUREMENT monr_VeSHM_DoorLckPstnRFH_enum "" UBYTE POD_FaultHandle_CM_uint8 0 0 0 255 ECU_ADDRESS 0xB0055B18 /end MEASUREMENT
/begin MEASUREMENT monr_VeSHM_DoorLckPstnRSMMR_enum "" UBYTE POD_SMMR_CM_uint8 0 0 0 255 ECU_ADDRESS 0xB00560A6 /end MEASUREMENT
/begin MEASUREMENT monr_VeSHM_DoorModStsFH_enum "" UBYTE POD_FaultHandle_CM_uint8 0 0 0 255 ECU_ADDRESS 0xB0055B19 /end MEASUREMENT
/begin MEASUREMENT monr_VeSHM_DoorModStsSMML_enum "" UBYTE POD_SMML_CM_uint8 0 0 0 255 ECU_ADDRESS 0xB0056001 /end MEASUREMENT
/begin MEASUREMENT monr_VeSHM_DoorModStsSMMR_enum "" UBYTE POD_SMMR_CM_uint8 0 0 0 255 ECU_ADDRESS 0xB0056056 /end MEASUREMENT
/begin MEASUREMENT monr_VeSHM_DoorOpenArlmLSMML_enum "" UBYTE POD_SMML_CM_uint8 0 0 0 255 ECU_ADDRESS 0xB0056000 /end MEASUREMENT
/begin MEASUREMENT monr_VeSHM_DoorOpenArlmRSMMR_enum "" UBYTE POD_SMMR_CM_uint8 0 0 0 255 ECU_ADDRESS 0xB0056054 /end MEASUREMENT
/begin MEASUREMENT monr_VeSHM_DoorStsLSMML_enum "" UBYTE POD_SMML_CM_uint8 0 0 0 255 ECU_ADDRESS 0xB0055FF9 /end MEASUREMENT
/begin MEASUREMENT monr_VeSHM_DoorStsRSMMR_enum "" UBYTE POD_SMMR_CM_uint8 0 0 0 255 ECU_ADDRESS 0xB00560BF /end MEASUREMENT
/begin MEASUREMENT monr_VeSHM_DoorTypCfgAP_enum "" UBYTE POD_AntiPinch_CM_uint8 0 0 0 255 ECU_ADDRESS 0xB0055909 /end MEASUREMENT
/begin MEASUREMENT monr_VeSHM_DoorTypCfgFH_enum "" UBYTE POD_FaultHandle_CM_uint8 0 0 0 255 ECU_ADDRESS 0xB0055B1A /end MEASUREMENT
/begin MEASUREMENT monr_VeSHM_DoorTypCfgMCML_enum "" UBYTE POD_MCML_CM_uint8 0 0 0 255 ECU_ADDRESS 0xB0055D85 /end MEASUREMENT
/begin MEASUREMENT monr_VeSHM_DoorTypCfgMCMR_enum "" UBYTE POD_MCMR_CM_uint8 0 0 0 255 ECU_ADDRESS 0xB0055E18 /end MEASUREMENT
/begin MEASUREMENT monr_VeSHM_DoorTypCfgSMML_enum "" UBYTE POD_SMML_CM_uint8 0 0 0 255 ECU_ADDRESS 0xB0056050 /end MEASUREMENT
/begin MEASUREMENT monr_VeSHM_DoorTypCfgSMMR_enum "" UBYTE POD_SMMR_CM_uint8 0 0 0 255 ECU_ADDRESS 0xB005608B /end MEASUREMENT
/begin MEASUREMENT monr_VeSHM_DoorTypCfgTTR_enum "" UBYTE POD_TipToRun_CM_uint8 0 0 0 255 ECU_ADDRESS 0xB0056178 /end MEASUREMENT
/begin MEASUREMENT monr_VeSHM_DoorWrkReqLFH_enum "" UBYTE POD_FaultHandle_CM_uint8 0 0 0 255 ECU_ADDRESS 0xB0055B1B /end MEASUREMENT
/begin MEASUREMENT monr_VeSHM_DoorWrkReqLHHM_enum "" UBYTE POD_HallHandleModule_TZCU_CM_uint8 0 0 0 255 ECU_ADDRESS 0xB0055BDB /end MEASUREMENT
/begin MEASUREMENT monr_VeSHM_DoorWrkReqLSMML_enum "" UBYTE POD_SMML_CM_uint8 0 0 0 255 ECU_ADDRESS 0xB0055FF6 /end MEASUREMENT
/begin MEASUREMENT monr_VeSHM_DoorWrkReqRFH_enum "" UBYTE POD_FaultHandle_CM_uint8 0 0 0 255 ECU_ADDRESS 0xB0055B1C /end MEASUREMENT
/begin MEASUREMENT monr_VeSHM_DoorWrkReqRHHM_enum "" UBYTE POD_HallHandleModule_TZCU_CM_uint8 0 0 0 255 ECU_ADDRESS 0xB0055BDC /end MEASUREMENT
/begin MEASUREMENT monr_VeSHM_DoorWrkReqRSMMR_enum "" UBYTE POD_SMMR_CM_uint8 0 0 0 255 ECU_ADDRESS 0xB0056065 /end MEASUREMENT
/begin MEASUREMENT monr_VeSHM_DoorWrkReqSrcLSMML_enum "" UBYTE POD_SMML_CM_uint8 0 0 0 255 ECU_ADDRESS 0xB0055FF7 /end MEASUREMENT
/begin MEASUREMENT monr_VeSHM_DoorWrkReqSrcRSMMR_enum "" UBYTE POD_SMMR_CM_uint8 0 0 0 255 ECU_ADDRESS 0xB005607E /end MEASUREMENT
/begin MEASUREMENT monr_VeSHM_FrntIncinAgQlyLFH_enum "" UBYTE POD_FaultHandle_CM_uint8 0 0 0 255 ECU_ADDRESS 0xB0055B1E /end MEASUREMENT
/begin MEASUREMENT monr_VeSHM_FrntIncinAgQlyRFH_enum "" UBYTE POD_FaultHandle_CM_uint8 0 0 0 255 ECU_ADDRESS 0xB0055B1F /end MEASUREMENT
/begin MEASUREMENT monr_VeSHM_NVMDoorOprtStsLHHM_enum "" UBYTE POD_HallHandleModule_TZCU_CM_uint8 0 0 0 255 ECU_ADDRESS 0xB0055BDD /end MEASUREMENT
/begin MEASUREMENT monr_VeSHM_NVMDoorOprtStsLSMML_enum "" UBYTE POD_SMML_CM_uint8 0 0 0 255 ECU_ADDRESS 0xB0055FF5 /end MEASUREMENT
/begin MEASUREMENT monr_VeSHM_NVMDoorOprtStsRHHM_enum "" UBYTE POD_HallHandleModule_TZCU_CM_uint8 0 0 0 255 ECU_ADDRESS 0xB0055BDE /end MEASUREMENT
/begin MEASUREMENT monr_VeSHM_NVMDoorOprtStsRSMMR_enum "" UBYTE POD_SMMR_CM_uint8 0 0 0 255 ECU_ADDRESS 0xB005608D /end MEASUREMENT
/begin MEASUREMENT monr_VeSHM_PwrModDoorSetPstnHHM_pct "" UBYTE POD_HallHandleModule_TZCU_CM_uint8 0 0 0 255 ECU_ADDRESS 0xB0055BDF /end MEASUREMENT
/begin MEASUREMENT monr_VeSHM_SideIncinAgQlyLFH_enum "" UBYTE POD_FaultHandle_CM_uint8 0 0 0 255 ECU_ADDRESS 0xB0055B22 /end MEASUREMENT
/begin MEASUREMENT monr_VeSHM_SideIncinAgQlyRFH_enum "" UBYTE POD_FaultHandle_CM_uint8 0 0 0 255 ECU_ADDRESS 0xB0055B23 /end MEASUREMENT
/begin MEASUREMENT monr_VeSHM_UsrSetMaxPstnHHM_pct "" UBYTE POD_HallHandleModule_TZCU_CM_uint8 0 0 0 255 ECU_ADDRESS 0xB0055BE0 /end MEASUREMENT
/begin MEASUREMENT monr_VeSHM_VehSpdLgtQlyFH_enum "" UBYTE POD_FaultHandle_CM_uint8 0 0 0 255 ECU_ADDRESS 0xB0055B26 /end MEASUREMENT
/begin MEASUREMENT monr_VeSHM_VehSptStsFH_enum "" UBYTE POD_FaultHandle_CM_uint8 0 0 0 255 ECU_ADDRESS 0xB0055B27 /end MEASUREMENT
/begin MEASUREMENT monr_VeSHM_VehSptStsSMML_enum "" UBYTE POD_SMML_CM_uint8 0 0 0 255 ECU_ADDRESS 0xB0055FFF /end MEASUREMENT
/begin MEASUREMENT monr_VeSHM_VehSptStsSMMR_enum "" UBYTE POD_SMMR_CM_uint8 0 0 0 255 ECU_ADDRESS 0xB00560C1 /end MEASUREMENT
/begin MEASUREMENT monr_VeSHM_WakeUpTypLFH_NULL "" UBYTE POD_FaultHandle_CM_uint8 0 0 0 255 ECU_ADDRESS 0xB0055B28 /end MEASUREMENT
/begin MEASUREMENT monr_VeSHM_WakeUpTypRFH_NULL "" UBYTE POD_FaultHandle_CM_uint8 0 0 0 255 ECU_ADDRESS 0xB0055B29 /end MEASUREMENT
/begin MEASUREMENT monr_VeSMM_DOPFcnStateLAP_enum "" UBYTE POD_AntiPinch_CM_uint8 0 0 0 255 ECU_ADDRESS 0xB005590A /end MEASUREMENT
/begin MEASUREMENT monr_VeSMM_DOPFcnStateLFH_enum "" UBYTE POD_FaultHandle_CM_uint8 0 0 0 255 ECU_ADDRESS 0xB0055B2A /end MEASUREMENT
/begin MEASUREMENT monr_VeSMM_DOPFcnStateLHHM_enum "" UBYTE POD_HallHandleModule_TZCU_CM_uint8 0 0 0 255 ECU_ADDRESS 0xB0055BE1 /end MEASUREMENT
/begin MEASUREMENT monr_VeSMM_DOPFcnStateLMBCL_enum "" UBYTE POD_MBCL_CM_uint8 0 0 0 255 ECU_ADDRESS 0xB0055CC4 /end MEASUREMENT
/begin MEASUREMENT monr_VeSMM_DOPFcnStateLMCML_enum "" UBYTE POD_MCML_CM_uint8 0 0 0 255 ECU_ADDRESS 0xB0055D40 /end MEASUREMENT
/begin MEASUREMENT monr_VeSMM_DOPFcnStateLSHM_enum "" UBYTE POD_SignalHandModule_T_CM_uint8 0 0 0 255 ECU_ADDRESS 0xB0055F1D /end MEASUREMENT
/begin MEASUREMENT monr_VeSMM_DOPFcnStateLTTR_enum "" UBYTE POD_TipToRun_CM_uint8 0 0 0 255 ECU_ADDRESS 0xB0056179 /end MEASUREMENT
/begin MEASUREMENT monr_VeSMM_DOPFcnStateRAP_enum "" UBYTE POD_AntiPinch_CM_uint8 0 0 0 255 ECU_ADDRESS 0xB005590B /end MEASUREMENT
/begin MEASUREMENT monr_VeSMM_DOPFcnStateRFH_enum "" UBYTE POD_FaultHandle_CM_uint8 0 0 0 255 ECU_ADDRESS 0xB0055B2B /end MEASUREMENT
/begin MEASUREMENT monr_VeSMM_DOPFcnStateRHHM_enum "" UBYTE POD_HallHandleModule_TZCU_CM_uint8 0 0 0 255 ECU_ADDRESS 0xB0055BE2 /end MEASUREMENT
/begin MEASUREMENT monr_VeSMM_DOPFcnStateRMBCR_enum "" UBYTE POD_MBCR_CM_uint8 0 0 0 255 ECU_ADDRESS 0xB0055D0C /end MEASUREMENT
/begin MEASUREMENT monr_VeSMM_DOPFcnStateRMCMR_enum "" UBYTE POD_MCMR_CM_uint8 0 0 0 255 ECU_ADDRESS 0xB0055DD0 /end MEASUREMENT
/begin MEASUREMENT monr_VeSMM_DOPFcnStateRSHM_enum "" UBYTE POD_SignalHandModule_T_CM_uint8 0 0 0 255 ECU_ADDRESS 0xB0055F1E /end MEASUREMENT
/begin MEASUREMENT monr_VeSMM_DOPFcnStateRTTR_enum "" UBYTE POD_TipToRun_CM_uint8 0 0 0 255 ECU_ADDRESS 0xB005617A /end MEASUREMENT
/begin MEASUREMENT monr_VeSMM_DoorLatPosnLMCML_enum "" UBYTE POD_MCML_CM_uint8 0 0 0 255 ECU_ADDRESS 0xB0055D44 /end MEASUREMENT
/begin MEASUREMENT monr_VeSMM_DoorLatPosnRMCMR_enum "" UBYTE POD_MCMR_CM_uint8 0 0 0 255 ECU_ADDRESS 0xB0055DDC /end MEASUREMENT
/begin MEASUREMENT monr_VeSMM_HoverModCtrlLAP_enum "" UBYTE POD_AntiPinch_CM_uint8 0 0 0 255 ECU_ADDRESS 0xB005590C /end MEASUREMENT
/begin MEASUREMENT monr_VeSMM_HoverModCtrlLHHM_enum "" UBYTE POD_HallHandleModule_TZCU_CM_uint8 0 0 0 255 ECU_ADDRESS 0xB0055BE3 /end MEASUREMENT
/begin MEASUREMENT monr_VeSMM_HoverModCtrlLMBCL_enum "" UBYTE POD_MBCL_CM_uint8 0 0 0 255 ECU_ADDRESS 0xB0055CED /end MEASUREMENT
/begin MEASUREMENT monr_VeSMM_HoverModCtrlLMCML_enum "" UBYTE POD_MCML_CM_uint8 0 0 0 255 ECU_ADDRESS 0xB0055D4C /end MEASUREMENT
/begin MEASUREMENT monr_VeSMM_HoverModCtrlLTTR_enum "" UBYTE POD_TipToRun_CM_uint8 0 0 0 255 ECU_ADDRESS 0xB005617B /end MEASUREMENT
/begin MEASUREMENT monr_VeSMM_HoverModCtrlRAP_enum "" UBYTE POD_AntiPinch_CM_uint8 0 0 0 255 ECU_ADDRESS 0xB005590D /end MEASUREMENT
/begin MEASUREMENT monr_VeSMM_HoverModCtrlRHHM_enum "" UBYTE POD_HallHandleModule_TZCU_CM_uint8 0 0 0 255 ECU_ADDRESS 0xB0055BE4 /end MEASUREMENT
/begin MEASUREMENT monr_VeSMM_HoverModCtrlRMBCR_enum "" UBYTE POD_MBCR_CM_uint8 0 0 0 255 ECU_ADDRESS 0xB0055CFC /end MEASUREMENT
/begin MEASUREMENT monr_VeSMM_HoverModCtrlRMCMR_enum "" UBYTE POD_MCMR_CM_uint8 0 0 0 255 ECU_ADDRESS 0xB0055DDD /end MEASUREMENT
/begin MEASUREMENT monr_VeSMM_HoverModCtrlRTTR_enum "" UBYTE POD_TipToRun_CM_uint8 0 0 0 255 ECU_ADDRESS 0xB005617C /end MEASUREMENT
/begin MEASUREMENT monr_VeSMM_MotorCtrlModeLAP_enum "" UBYTE POD_AntiPinch_CM_uint8 0 0 0 255 ECU_ADDRESS 0xB005590E /end MEASUREMENT
/begin MEASUREMENT monr_VeSMM_MotorCtrlModeLFH_enum "" UBYTE POD_FaultHandle_CM_uint8 0 0 0 255 ECU_ADDRESS 0xB0055B2C /end MEASUREMENT
/begin MEASUREMENT monr_VeSMM_MotorCtrlModeLHHM_enum "" UBYTE POD_HallHandleModule_TZCU_CM_uint8 0 0 0 255 ECU_ADDRESS 0xB0055BE5 /end MEASUREMENT
/begin MEASUREMENT monr_VeSMM_MotorCtrlModeLMBCL_enum "" UBYTE POD_MBCL_CM_uint8 0 0 0 255 ECU_ADDRESS 0xB0055CE0 /end MEASUREMENT
/begin MEASUREMENT monr_VeSMM_MotorCtrlModeLMCML_enum "" UBYTE POD_MCML_CM_uint8 0 0 0 255 ECU_ADDRESS 0xB0055D41 /end MEASUREMENT
/begin MEASUREMENT monr_VeSMM_MotorCtrlModeLTTR_enum "" UBYTE POD_TipToRun_CM_uint8 0 0 0 255 ECU_ADDRESS 0xB005617D /end MEASUREMENT
/begin MEASUREMENT monr_VeSMM_MotorCtrlModeRAP_enum "" UBYTE POD_AntiPinch_CM_uint8 0 0 0 255 ECU_ADDRESS 0xB005590F /end MEASUREMENT
/begin MEASUREMENT monr_VeSMM_MotorCtrlModeRFH_enum "" UBYTE POD_FaultHandle_CM_uint8 0 0 0 255 ECU_ADDRESS 0xB0055B2D /end MEASUREMENT
/begin MEASUREMENT monr_VeSMM_MotorCtrlModeRHHM_enum "" UBYTE POD_HallHandleModule_TZCU_CM_uint8 0 0 0 255 ECU_ADDRESS 0xB0055BE6 /end MEASUREMENT
/begin MEASUREMENT monr_VeSMM_MotorCtrlModeRMBCR_enum "" UBYTE POD_MBCR_CM_uint8 0 0 0 255 ECU_ADDRESS 0xB0055D13 /end MEASUREMENT
/begin MEASUREMENT monr_VeSMM_MotorCtrlModeRMCMR_enum "" UBYTE POD_MCMR_CM_uint8 0 0 0 255 ECU_ADDRESS 0xB0055DD9 /end MEASUREMENT
/begin MEASUREMENT monr_VeSMM_MotorCtrlModeRTTR_enum "" UBYTE POD_TipToRun_CM_uint8 0 0 0 255 ECU_ADDRESS 0xB005617E /end MEASUREMENT
/begin MEASUREMENT monr_VeSMM_MotorCtrlStateLAP_enum "" UBYTE POD_AntiPinch_CM_uint8 0 0 0 255 ECU_ADDRESS 0xB0055910 /end MEASUREMENT
/begin MEASUREMENT monr_VeSMM_MotorCtrlStateLFH_enum "" UBYTE POD_FaultHandle_CM_uint8 0 0 0 255 ECU_ADDRESS 0xB0055B2E /end MEASUREMENT
/begin MEASUREMENT monr_VeSMM_MotorCtrlStateLHHM_enum "" UBYTE POD_HallHandleModule_TZCU_CM_uint8 0 0 0 255 ECU_ADDRESS 0xB0055BE7 /end MEASUREMENT
/begin MEASUREMENT monr_VeSMM_MotorCtrlStateLMCML_enum "" UBYTE POD_MCML_CM_uint8 0 0 0 255 ECU_ADDRESS 0xB0055D42 /end MEASUREMENT
/begin MEASUREMENT monr_VeSMM_MotorCtrlStateLTTR_enum "" UBYTE POD_TipToRun_CM_uint8 0 0 0 255 ECU_ADDRESS 0xB005617F /end MEASUREMENT
/begin MEASUREMENT monr_VeSMM_MotorCtrlStateRAP_enum "" UBYTE POD_AntiPinch_CM_uint8 0 0 0 255 ECU_ADDRESS 0xB0055911 /end MEASUREMENT
/begin MEASUREMENT monr_VeSMM_MotorCtrlStateRFH_enum "" UBYTE POD_FaultHandle_CM_uint8 0 0 0 255 ECU_ADDRESS 0xB0055B2F /end MEASUREMENT
/begin MEASUREMENT monr_VeSMM_MotorCtrlStateRHHM_enum "" UBYTE POD_HallHandleModule_TZCU_CM_uint8 0 0 0 255 ECU_ADDRESS 0xB0055BE8 /end MEASUREMENT
/begin MEASUREMENT monr_VeSMM_MotorCtrlStateRMCMR_enum "" UBYTE POD_MCMR_CM_uint8 0 0 0 255 ECU_ADDRESS 0xB0055DDA /end MEASUREMENT
/begin MEASUREMENT monr_VeSMM_MotorCtrlStateRTTR_enum "" UBYTE POD_TipToRun_CM_uint8 0 0 0 255 ECU_ADDRESS 0xB0056180 /end MEASUREMENT
/begin MEASUREMENT monr_VeSMM_OpenDoorCmdLHHM_enum "" UBYTE POD_HallHandleModule_TZCU_CM_uint8 0 0 0 255 ECU_ADDRESS 0xB0055BE9 /end MEASUREMENT
/begin MEASUREMENT monr_VeSMM_OpenDoorCmdRHHM_enum "" UBYTE POD_HallHandleModule_TZCU_CM_uint8 0 0 0 255 ECU_ADDRESS 0xB0055BEA /end MEASUREMENT
/begin MEASUREMENT monr_VeSMM_PushLockLMCML_NULL "" UBYTE POD_MCML_CM_uint8 0 0 0 255 ECU_ADDRESS 0xB0055D45 /end MEASUREMENT
/begin MEASUREMENT monr_VeSMM_PushLockRMCMR_NULL "" UBYTE POD_MCMR_CM_uint8 0 0 0 255 ECU_ADDRESS 0xB0055DDF /end MEASUREMENT
/begin MEASUREMENT monr_VeSMM_StopEventLAP_enum "" UBYTE POD_AntiPinch_CM_uint8 0 0 0 255 ECU_ADDRESS 0xB0055912 /end MEASUREMENT
/begin MEASUREMENT monr_VeSMM_StopEventLHHM_enum "" UBYTE POD_HallHandleModule_TZCU_CM_uint8 0 0 0 255 ECU_ADDRESS 0xB0055BEB /end MEASUREMENT
/begin MEASUREMENT monr_VeSMM_StopEventLMBCL_enum "" UBYTE POD_MBCL_CM_uint8 0 0 0 255 ECU_ADDRESS 0xB0055CE1 /end MEASUREMENT
/begin MEASUREMENT monr_VeSMM_StopEventLMCML_enum "" UBYTE POD_MCML_CM_uint8 0 0 0 255 ECU_ADDRESS 0xB0055D43 /end MEASUREMENT
/begin MEASUREMENT monr_VeSMM_StopEventLTTR_enum "" UBYTE POD_TipToRun_CM_uint8 0 0 0 255 ECU_ADDRESS 0xB0056181 /end MEASUREMENT
/begin MEASUREMENT monr_VeSMM_StopEventRAP_enum "" UBYTE POD_AntiPinch_CM_uint8 0 0 0 255 ECU_ADDRESS 0xB0055913 /end MEASUREMENT
/begin MEASUREMENT monr_VeSMM_StopEventRHHM_enum "" UBYTE POD_HallHandleModule_TZCU_CM_uint8 0 0 0 255 ECU_ADDRESS 0xB0055BEC /end MEASUREMENT
/begin MEASUREMENT monr_VeSMM_StopEventRMBCR_enum "" UBYTE POD_MBCR_CM_uint8 0 0 0 255 ECU_ADDRESS 0xB0055D12 /end MEASUREMENT
/begin MEASUREMENT monr_VeSMM_StopEventRMCMR_enum "" UBYTE POD_MCMR_CM_uint8 0 0 0 255 ECU_ADDRESS 0xB0055DDB /end MEASUREMENT
/begin MEASUREMENT monr_VeSMM_StopEventRTTR_enum "" UBYTE POD_TipToRun_CM_uint8 0 0 0 255 ECU_ADDRESS 0xB0056182 /end MEASUREMENT
/begin MEASUREMENT monr_VeTTR_ManAsstRqstLSMML_enum "" UBYTE POD_SMML_CM_uint8 0 0 0 255 ECU_ADDRESS 0xB0056026 /end MEASUREMENT
/begin MEASUREMENT monr_VeTTR_ManAsstRqstRSMMR_enum "" UBYTE POD_SMMR_CM_uint8 0 0 0 255 ECU_ADDRESS 0xB0056070 /end MEASUREMENT
/begin MEASUREMENT monr_VfAP_ValueBrkgCompenRAP_MA "" FLOAT32_IEEE POD_AntiPinch_CM_single 0 0 -3.4e+38 3.4e+38 ECU_ADDRESS 0xB00558C0 /end MEASUREMENT
/begin MEASUREMENT monr_VfAP_ValueReferenceCurrentCmpRAP_MA "" FLOAT32_IEEE POD_AntiPinch_CM_single 0 0 -3.4e+38 3.4e+38 ECU_ADDRESS 0xB00558D8 /end MEASUREMENT
/begin MEASUREMENT monr_VfAP_ValueReferenceCurrentRAP_MA "" FLOAT32_IEEE POD_AntiPinch_CM_single 0 0 -3.4e+38 3.4e+38 ECU_ADDRESS 0xB00558E0 /end MEASUREMENT
/begin MEASUREMENT monr_VfAP_ValueSlopeCompenRAP_MA "" FLOAT32_IEEE POD_AntiPinch_CM_single 0 0 -3.4e+38 3.4e+38 ECU_ADDRESS 0xB00558F0 /end MEASUREMENT
/begin MEASUREMENT monr_VfHHM_AswHallPositionLMCML_deg "" FLOAT32_IEEE POD_MCML_CM_single 0 0 -3.4e+38 3.4e+38 ECU_ADDRESS 0xB0055D58 /end MEASUREMENT
/begin MEASUREMENT monr_VfHHM_AswHallPositionLSHM_deg "" FLOAT32_IEEE POD_SignalHandModule_T_CM_single 0 0 -3.4e+38 3.4e+38 ECU_ADDRESS 0xB0055F20 /end MEASUREMENT
/begin MEASUREMENT monr_VfHHM_AswHallPositionLSMML_deg "" FLOAT32_IEEE POD_SMML_CM_single 0 0 -3.4e+38 3.4e+38 ECU_ADDRESS 0xB0056014 /end MEASUREMENT
/begin MEASUREMENT monr_VfHHM_AswHallPositionLTTR_deg "" FLOAT32_IEEE POD_TipToRun_CM_single 0 0 -3.4e+38 3.4e+38 ECU_ADDRESS 0xB0056188 /end MEASUREMENT
/begin MEASUREMENT monr_VfHHM_AswHallPositionRMCMR_deg "" FLOAT32_IEEE POD_MCMR_CM_single 0 0 -3.4e+38 3.4e+38 ECU_ADDRESS 0xB0055DEC /end MEASUREMENT
/begin MEASUREMENT monr_VfHHM_AswHallPositionRSHM_deg "" FLOAT32_IEEE POD_SignalHandModule_T_CM_single 0 0 -3.4e+38 3.4e+38 ECU_ADDRESS 0xB0055F24 /end MEASUREMENT
/begin MEASUREMENT monr_VfHHM_AswHallPositionRSMMR_deg "" FLOAT32_IEEE POD_SMMR_CM_single 0 0 -3.4e+38 3.4e+38 ECU_ADDRESS 0xB0056080 /end MEASUREMENT
/begin MEASUREMENT monr_VfHHM_AswHallPositionRTTR_deg "" FLOAT32_IEEE POD_TipToRun_CM_single 0 0 -3.4e+38 3.4e+38 ECU_ADDRESS 0xB005618C /end MEASUREMENT
/begin MEASUREMENT monr_VfHHM_DoorPstnLSMML_pct "" FLOAT32_IEEE POD_SMML_CM_single 0 0 -3.4e+38 3.4e+38 ECU_ADDRESS 0xB0056018 /end MEASUREMENT
/begin MEASUREMENT monr_VfHHM_DoorPstnRSMMR_pct "" FLOAT32_IEEE POD_SMMR_CM_single 0 0 -3.4e+38 3.4e+38 ECU_ADDRESS 0xB0056060 /end MEASUREMENT
/begin MEASUREMENT monr_VfHHM_MaxOpenPositionLSMML_deg "" FLOAT32_IEEE POD_SMML_CM_single 0 0 -3.4e+38 3.4e+38 ECU_ADDRESS 0xB0056010 /end MEASUREMENT
/begin MEASUREMENT monr_VfHHM_MaxOpenPositionRSMMR_deg "" FLOAT32_IEEE POD_SMMR_CM_single 0 0 -3.4e+38 3.4e+38 ECU_ADDRESS 0xB0056078 /end MEASUREMENT
/begin MEASUREMENT monr_VfIMU_AgSpdLAP_degps "" FLOAT32_IEEE POD_AntiPinch_CM_single 0 0 -3.4e+38 3.4e+38 ECU_ADDRESS 0xB0055914 /end MEASUREMENT
/begin MEASUREMENT monr_VfIMU_AgSpdLFH_degps "" FLOAT32_IEEE POD_FaultHandle_CM_single 0 0 -3.4e+38 3.4e+38 ECU_ADDRESS 0xB0055B38 /end MEASUREMENT
/begin MEASUREMENT monr_VfIMU_AgSpdLHHM_degps "" FLOAT32_IEEE POD_HallHandleModule_TZCU_CM_single 0 0 -3.4e+38 3.4e+38 ECU_ADDRESS 0xB0055C18 /end MEASUREMENT
/begin MEASUREMENT monr_VfIMU_AgSpdLSMML_degps "" FLOAT32_IEEE POD_SMML_CM_single 0 0 -3.4e+38 3.4e+38 ECU_ADDRESS 0xB0056020 /end MEASUREMENT
/begin MEASUREMENT monr_VfIMU_AgSpdRAP_degps "" FLOAT32_IEEE POD_AntiPinch_CM_single 0 0 -3.4e+38 3.4e+38 ECU_ADDRESS 0xB0055918 /end MEASUREMENT
/begin MEASUREMENT monr_VfIMU_AgSpdRFH_degps "" FLOAT32_IEEE POD_FaultHandle_CM_single 0 0 -3.4e+38 3.4e+38 ECU_ADDRESS 0xB0055B3C /end MEASUREMENT
/begin MEASUREMENT monr_VfIMU_AgSpdRHHM_degps "" FLOAT32_IEEE POD_HallHandleModule_TZCU_CM_single 0 0 -3.4e+38 3.4e+38 ECU_ADDRESS 0xB0055C1C /end MEASUREMENT
/begin MEASUREMENT monr_VfIMU_AgSpdRSMMR_degps "" FLOAT32_IEEE POD_SMMR_CM_single 0 0 -3.4e+38 3.4e+38 ECU_ADDRESS 0xB005605C /end MEASUREMENT
/begin MEASUREMENT monr_VfIMU_VehPitchLFH_deg "" FLOAT32_IEEE POD_FaultHandle_CM_single 0 0 -3.4e+38 3.4e+38 ECU_ADDRESS 0xB0055B40 /end MEASUREMENT
/begin MEASUREMENT monr_VfIMU_VehPitchRFH_deg "" FLOAT32_IEEE POD_FaultHandle_CM_single 0 0 -3.4e+38 3.4e+38 ECU_ADDRESS 0xB0055B44 /end MEASUREMENT
/begin MEASUREMENT monr_VfIMU_VehRollLFH_deg "" FLOAT32_IEEE POD_FaultHandle_CM_single 0 0 -3.4e+38 3.4e+38 ECU_ADDRESS 0xB0055B48 /end MEASUREMENT
/begin MEASUREMENT monr_VfIMU_VehRollRFH_deg "" FLOAT32_IEEE POD_FaultHandle_CM_single 0 0 -3.4e+38 3.4e+38 ECU_ADDRESS 0xB0055B4C /end MEASUREMENT
/begin MEASUREMENT monr_VfINP_DoorRLOpenAgSHM_deg "" FLOAT32_IEEE POD_SignalHandModule_T_CM_single 0 0 -3.4e+38 3.4e+38 ECU_ADDRESS 0xB0055F30 /end MEASUREMENT
/begin MEASUREMENT monr_VfINP_DoorRROpenAgSHM_deg "" FLOAT32_IEEE POD_SignalHandModule_T_CM_single 0 0 -3.4e+38 3.4e+38 ECU_ADDRESS 0xB0055F34 /end MEASUREMENT
/begin MEASUREMENT monr_VfINP_ExterTempSHM_C "" FLOAT32_IEEE POD_SignalHandModule_T_CM_single 0 0 -3.4e+38 3.4e+38 ECU_ADDRESS 0xB0055F38 /end MEASUREMENT
/begin MEASUREMENT monr_VfINP_FLGYROAgSpdSHM_degps "" FLOAT32_IEEE POD_SignalHandModule_T_CM_single 0 0 -3.4e+38 3.4e+38 ECU_ADDRESS 0xB0055F3C /end MEASUREMENT
/begin MEASUREMENT monr_VfINP_FRGYROAgSpdSHM_degps "" FLOAT32_IEEE POD_SignalHandModule_T_CM_single 0 0 -3.4e+38 3.4e+38 ECU_ADDRESS 0xB0055F40 /end MEASUREMENT
/begin MEASUREMENT monr_VfINP_MaiMotCurrLSHM_A "" FLOAT32_IEEE POD_SignalHandModule_T_CM_single 0 0 -3.4e+38 3.4e+38 ECU_ADDRESS 0xB0055F44 /end MEASUREMENT
/begin MEASUREMENT monr_VfINP_MaiMotCurrRSHM_A "" FLOAT32_IEEE POD_SignalHandModule_T_CM_single 0 0 -3.4e+38 3.4e+38 ECU_ADDRESS 0xB0055F48 /end MEASUREMENT
/begin MEASUREMENT monr_VfINP_UBRVoltSHM_V "" FLOAT32_IEEE POD_SignalHandModule_T_CM_single 0 0 -3.4e+38 3.4e+38 ECU_ADDRESS 0xB0055F4C /end MEASUREMENT
/begin MEASUREMENT monr_VfINP_VehSpdSHM_kph "" FLOAT32_IEEE POD_SignalHandModule_T_CM_single 0 0 -3.4e+38 3.4e+38 ECU_ADDRESS 0xB0055F50 /end MEASUREMENT
/begin MEASUREMENT monr_VfINP_XLPitchAgSHM_deg "" FLOAT32_IEEE POD_SignalHandModule_T_CM_single 0 0 -3.4e+38 3.4e+38 ECU_ADDRESS 0xB0055F58 /end MEASUREMENT
/begin MEASUREMENT monr_VfINP_XLRollAgSHM_deg "" FLOAT32_IEEE POD_SignalHandModule_T_CM_single 0 0 -3.4e+38 3.4e+38 ECU_ADDRESS 0xB0055F5C /end MEASUREMENT
/begin MEASUREMENT monr_VfINP_XRPitchAgSHM_deg "" FLOAT32_IEEE POD_SignalHandModule_T_CM_single 0 0 -3.4e+38 3.4e+38 ECU_ADDRESS 0xB0055F64 /end MEASUREMENT
/begin MEASUREMENT monr_VfINP_XRRollAgSHM_deg "" FLOAT32_IEEE POD_SignalHandModule_T_CM_single 0 0 -3.4e+38 3.4e+38 ECU_ADDRESS 0xB0055F68 /end MEASUREMENT
/begin MEASUREMENT monr_VfMCM_BrakingTorqueLAP_NULL "" FLOAT32_IEEE POD_AntiPinch_CM_single 0 0 -3.4e+38 3.4e+38 ECU_ADDRESS 0xB005591C /end MEASUREMENT
/begin MEASUREMENT monr_VfMCM_BrakingTorqueRAP_NULL "" FLOAT32_IEEE POD_AntiPinch_CM_single 0 0 -3.4e+38 3.4e+38 ECU_ADDRESS 0xB0055920 /end MEASUREMENT
/begin MEASUREMENT monr_VfMCM_GravityTorqueLMBCL_Nm "" FLOAT32_IEEE POD_MBCL_CM_single 0 0 -3.4e+38 3.4e+38 ECU_ADDRESS 0xB0055CE8 /end MEASUREMENT
/begin MEASUREMENT monr_VfMCM_GravityTorqueRMBCR_Nm "" FLOAT32_IEEE POD_MBCR_CM_single 0 0 -3.4e+38 3.4e+38 ECU_ADDRESS 0xB0055CF0 /end MEASUREMENT
/begin MEASUREMENT monr_VfMCM_MotorCtrlDutyLAP_NULL "" FLOAT32_IEEE POD_AntiPinch_CM_single 0 0 -3.4e+38 3.4e+38 ECU_ADDRESS 0xB0055934 /end MEASUREMENT
/begin MEASUREMENT monr_VfMCM_MotorCtrlDutyRAP_NULL "" FLOAT32_IEEE POD_AntiPinch_CM_single 0 0 -3.4e+38 3.4e+38 ECU_ADDRESS 0xB0055938 /end MEASUREMENT
/begin MEASUREMENT monr_VfMCM_RoadInclnLMBCL_deg "" FLOAT32_IEEE POD_MBCL_CM_single 0 0 -3.4e+38 3.4e+38 ECU_ADDRESS 0xB0055CD0 /end MEASUREMENT
/begin MEASUREMENT monr_VfMCM_RoadInclnRMBCR_deg "" FLOAT32_IEEE POD_MBCR_CM_single 0 0 -3.4e+38 3.4e+38 ECU_ADDRESS 0xB0055D04 /end MEASUREMENT
/begin MEASUREMENT monr_VfMCM_SideIncinAgLMBCL_deg "" FLOAT32_IEEE POD_MBCL_CM_single 0 0 -3.4e+38 3.4e+38 ECU_ADDRESS 0xB0055CC8 /end MEASUREMENT
/begin MEASUREMENT monr_VfMCM_SideIncinAgRMBCR_deg "" FLOAT32_IEEE POD_MBCR_CM_single 0 0 -3.4e+38 3.4e+38 ECU_ADDRESS 0xB0055D00 /end MEASUREMENT
/begin MEASUREMENT monr_VfMCM_TarPosLAP_NULL "" FLOAT32_IEEE POD_AntiPinch_CM_single 0 0 -3.4e+38 3.4e+38 ECU_ADDRESS 0xB005593C /end MEASUREMENT
/begin MEASUREMENT monr_VfMCM_TarPosRAP_NULL "" FLOAT32_IEEE POD_AntiPinch_CM_single 0 0 -3.4e+38 3.4e+38 ECU_ADDRESS 0xB0055940 /end MEASUREMENT
/begin MEASUREMENT monr_VfMCM_TarSpdLAP_NULL "" FLOAT32_IEEE POD_AntiPinch_CM_single 0 0 -3.4e+38 3.4e+38 ECU_ADDRESS 0xB0055944 /end MEASUREMENT
/begin MEASUREMENT monr_VfMCM_TarSpdRAP_NULL "" FLOAT32_IEEE POD_AntiPinch_CM_single 0 0 -3.4e+38 3.4e+38 ECU_ADDRESS 0xB0055948 /end MEASUREMENT
/begin MEASUREMENT monr_VfMCM_ldlToAntipinchLAP_MA "" FLOAT32_IEEE POD_AntiPinch_CM_single 0 0 -3.4e+38 3.4e+38 ECU_ADDRESS 0xB0055924 /end MEASUREMENT
/begin MEASUREMENT monr_VfMCM_ldlToAntipinchRAP_MA "" FLOAT32_IEEE POD_AntiPinch_CM_single 0 0 -3.4e+38 3.4e+38 ECU_ADDRESS 0xB0055928 /end MEASUREMENT
/begin MEASUREMENT monr_VfMCM_lrefToAntipinchLAP_MA "" FLOAT32_IEEE POD_AntiPinch_CM_single 0 0 -3.4e+38 3.4e+38 ECU_ADDRESS 0xB005592C /end MEASUREMENT
/begin MEASUREMENT monr_VfMCM_lrefToAntipinchRAP_MA "" FLOAT32_IEEE POD_AntiPinch_CM_single 0 0 -3.4e+38 3.4e+38 ECU_ADDRESS 0xB0055930 /end MEASUREMENT
/begin MEASUREMENT monr_VfSHM_AmbTempAP_C "" FLOAT32_IEEE POD_AntiPinch_CM_single 0 0 -3.4e+38 3.4e+38 ECU_ADDRESS 0xB005594C /end MEASUREMENT
/begin MEASUREMENT monr_VfSHM_AmbTempMCML_C "" FLOAT32_IEEE POD_MCML_CM_single 0 0 -3.4e+38 3.4e+38 ECU_ADDRESS 0xB0055D68 /end MEASUREMENT
/begin MEASUREMENT monr_VfSHM_AmbTempMCMR_C "" FLOAT32_IEEE POD_MCMR_CM_single 0 0 -3.4e+38 3.4e+38 ECU_ADDRESS 0xB0055DFC /end MEASUREMENT
/begin MEASUREMENT monr_VfSHM_AmbTempSMML_C "" FLOAT32_IEEE POD_SMML_CM_single 0 0 -3.4e+38 3.4e+38 ECU_ADDRESS 0xB005602C /end MEASUREMENT
/begin MEASUREMENT monr_VfSHM_AmbTempSMMR_C "" FLOAT32_IEEE POD_SMMR_CM_single 0 0 -3.4e+38 3.4e+38 ECU_ADDRESS 0xB005606C /end MEASUREMENT
/begin MEASUREMENT monr_VfSHM_BatVoltageValueAP_MV "" FLOAT32_IEEE POD_AntiPinch_CM_single 0 0 -3.4e+38 3.4e+38 ECU_ADDRESS 0xB0055950 /end MEASUREMENT
/begin MEASUREMENT monr_VfSHM_BatVoltageValueFH_MV "" FLOAT32_IEEE POD_FaultHandle_CM_single 0 0 -3.4e+38 3.4e+38 ECU_ADDRESS 0xB0055B50 /end MEASUREMENT
/begin MEASUREMENT monr_VfSHM_BatVoltageValueMCML_MV "" FLOAT32_IEEE POD_MCML_CM_single 0 0 -3.4e+38 3.4e+38 ECU_ADDRESS 0xB0055D38 /end MEASUREMENT
/begin MEASUREMENT monr_VfSHM_BatVoltageValueMCMR_MV "" FLOAT32_IEEE POD_MCMR_CM_single 0 0 -3.4e+38 3.4e+38 ECU_ADDRESS 0xB0055DD4 /end MEASUREMENT
/begin MEASUREMENT monr_VfSHM_DoorRdrAgLFH_deg "" FLOAT32_IEEE POD_FaultHandle_CM_single 0 0 -3.4e+38 3.4e+38 ECU_ADDRESS 0xB0055B54 /end MEASUREMENT
/begin MEASUREMENT monr_VfSHM_DoorRdrAgLSMML_deg "" FLOAT32_IEEE POD_SMML_CM_single 0 0 -3.4e+38 3.4e+38 ECU_ADDRESS 0xB0056040 /end MEASUREMENT
/begin MEASUREMENT monr_VfSHM_DoorRdrAgRFH_deg "" FLOAT32_IEEE POD_FaultHandle_CM_single 0 0 -3.4e+38 3.4e+38 ECU_ADDRESS 0xB0055B58 /end MEASUREMENT
/begin MEASUREMENT monr_VfSHM_DoorRdrAgRSMMR_deg "" FLOAT32_IEEE POD_SMMR_CM_single 0 0 -3.4e+38 3.4e+38 ECU_ADDRESS 0xB00560A0 /end MEASUREMENT
/begin MEASUREMENT monr_VfSHM_FrntIncinAgLAP_deg "" FLOAT32_IEEE POD_AntiPinch_CM_single 0 0 -3.4e+38 3.4e+38 ECU_ADDRESS 0xB0055954 /end MEASUREMENT
/begin MEASUREMENT monr_VfSHM_FrntIncinAgLFH_deg "" FLOAT32_IEEE POD_FaultHandle_CM_single 0 0 -3.4e+38 3.4e+38 ECU_ADDRESS 0xB0055B5C /end MEASUREMENT
/begin MEASUREMENT monr_VfSHM_FrntIncinAgLHHM_deg "" FLOAT32_IEEE POD_HallHandleModule_TZCU_CM_single 0 0 -3.4e+38 3.4e+38 ECU_ADDRESS 0xB0055C20 /end MEASUREMENT
/begin MEASUREMENT monr_VfSHM_FrntIncinAgLMCML_deg "" FLOAT32_IEEE POD_MCML_CM_single 0 0 -3.4e+38 3.4e+38 ECU_ADDRESS 0xB0055D7C /end MEASUREMENT
/begin MEASUREMENT monr_VfSHM_FrntIncinAgLSMML_deg "" FLOAT32_IEEE POD_SMML_CM_single 0 0 -3.4e+38 3.4e+38 ECU_ADDRESS 0xB0056034 /end MEASUREMENT
/begin MEASUREMENT monr_VfSHM_FrntIncinAgLTTR_deg "" FLOAT32_IEEE POD_TipToRun_CM_single 0 0 -3.4e+38 3.4e+38 ECU_ADDRESS 0xB0056198 /end MEASUREMENT
/begin MEASUREMENT monr_VfSHM_FrntIncinAgRAP_deg "" FLOAT32_IEEE POD_AntiPinch_CM_single 0 0 -3.4e+38 3.4e+38 ECU_ADDRESS 0xB0055958 /end MEASUREMENT
/begin MEASUREMENT monr_VfSHM_FrntIncinAgRFH_deg "" FLOAT32_IEEE POD_FaultHandle_CM_single 0 0 -3.4e+38 3.4e+38 ECU_ADDRESS 0xB0055B60 /end MEASUREMENT
/begin MEASUREMENT monr_VfSHM_FrntIncinAgRHHM_deg "" FLOAT32_IEEE POD_HallHandleModule_TZCU_CM_single 0 0 -3.4e+38 3.4e+38 ECU_ADDRESS 0xB0055C24 /end MEASUREMENT
/begin MEASUREMENT monr_VfSHM_FrntIncinAgRMCMR_deg "" FLOAT32_IEEE POD_MCMR_CM_single 0 0 -3.4e+38 3.4e+38 ECU_ADDRESS 0xB0055E14 /end MEASUREMENT
/begin MEASUREMENT monr_VfSHM_FrntIncinAgRSMMR_deg "" FLOAT32_IEEE POD_SMMR_CM_single 0 0 -3.4e+38 3.4e+38 ECU_ADDRESS 0xB0056094 /end MEASUREMENT
/begin MEASUREMENT monr_VfSHM_FrntIncinAgRTTR_deg "" FLOAT32_IEEE POD_TipToRun_CM_single 0 0 -3.4e+38 3.4e+38 ECU_ADDRESS 0xB005619C /end MEASUREMENT
/begin MEASUREMENT monr_VfSHM_MainMotoCurrentLAP_MA "" FLOAT32_IEEE POD_AntiPinch_CM_single 0 0 -3.4e+38 3.4e+38 ECU_ADDRESS 0xB005595C /end MEASUREMENT
/begin MEASUREMENT monr_VfSHM_MainMotoCurrentLFH_MA "" FLOAT32_IEEE POD_FaultHandle_CM_single 0 0 -3.4e+38 3.4e+38 ECU_ADDRESS 0xB0055B64 /end MEASUREMENT
/begin MEASUREMENT monr_VfSHM_MainMotoCurrentLHHM_MA "" FLOAT32_IEEE POD_HallHandleModule_TZCU_CM_single 0 0 -3.4e+38 3.4e+38 ECU_ADDRESS 0xB0055C28 /end MEASUREMENT
/begin MEASUREMENT monr_VfSHM_MainMotoCurrentLMCML_MA "" FLOAT32_IEEE POD_MCML_CM_single 0 0 -3.4e+38 3.4e+38 ECU_ADDRESS 0xB0055D34 /end MEASUREMENT
/begin MEASUREMENT monr_VfSHM_MainMotoCurrentLSMML_MA "" FLOAT32_IEEE POD_SMML_CM_single 0 0 -3.4e+38 3.4e+38 ECU_ADDRESS 0xB0056028 /end MEASUREMENT
/begin MEASUREMENT monr_VfSHM_MainMotoCurrentRAP_MA "" FLOAT32_IEEE POD_AntiPinch_CM_single 0 0 -3.4e+38 3.4e+38 ECU_ADDRESS 0xB0055960 /end MEASUREMENT
/begin MEASUREMENT monr_VfSHM_MainMotoCurrentRFH_MA "" FLOAT32_IEEE POD_FaultHandle_CM_single 0 0 -3.4e+38 3.4e+38 ECU_ADDRESS 0xB0055B68 /end MEASUREMENT
/begin MEASUREMENT monr_VfSHM_MainMotoCurrentRHHM_MA "" FLOAT32_IEEE POD_HallHandleModule_TZCU_CM_single 0 0 -3.4e+38 3.4e+38 ECU_ADDRESS 0xB0055C2C /end MEASUREMENT
/begin MEASUREMENT monr_VfSHM_MainMotoCurrentRMCMR_MA "" FLOAT32_IEEE POD_MCMR_CM_single 0 0 -3.4e+38 3.4e+38 ECU_ADDRESS 0xB0055DC8 /end MEASUREMENT
/begin MEASUREMENT monr_VfSHM_MainMotoCurrentRSMMR_MA "" FLOAT32_IEEE POD_SMMR_CM_single 0 0 -3.4e+38 3.4e+38 ECU_ADDRESS 0xB0056068 /end MEASUREMENT
/begin MEASUREMENT monr_VfSHM_SideIncinAgLAP_deg "" FLOAT32_IEEE POD_AntiPinch_CM_single 0 0 -3.4e+38 3.4e+38 ECU_ADDRESS 0xB0055964 /end MEASUREMENT
/begin MEASUREMENT monr_VfSHM_SideIncinAgLFH_deg "" FLOAT32_IEEE POD_FaultHandle_CM_single 0 0 -3.4e+38 3.4e+38 ECU_ADDRESS 0xB0055B6C /end MEASUREMENT
/begin MEASUREMENT monr_VfSHM_SideIncinAgLHHM_deg "" FLOAT32_IEEE POD_HallHandleModule_TZCU_CM_single 0 0 -3.4e+38 3.4e+38 ECU_ADDRESS 0xB0055C30 /end MEASUREMENT
/begin MEASUREMENT monr_VfSHM_SideIncinAgLMCML_deg "" FLOAT32_IEEE POD_MCML_CM_single 0 0 -3.4e+38 3.4e+38 ECU_ADDRESS 0xB0055D80 /end MEASUREMENT
/begin MEASUREMENT monr_VfSHM_SideIncinAgLSMML_deg "" FLOAT32_IEEE POD_SMML_CM_single 0 0 -3.4e+38 3.4e+38 ECU_ADDRESS 0xB0056038 /end MEASUREMENT
/begin MEASUREMENT monr_VfSHM_SideIncinAgLTTR_deg "" FLOAT32_IEEE POD_TipToRun_CM_single 0 0 -3.4e+38 3.4e+38 ECU_ADDRESS 0xB00561A0 /end MEASUREMENT
/begin MEASUREMENT monr_VfSHM_SideIncinAgRAP_deg "" FLOAT32_IEEE POD_AntiPinch_CM_single 0 0 -3.4e+38 3.4e+38 ECU_ADDRESS 0xB0055968 /end MEASUREMENT
/begin MEASUREMENT monr_VfSHM_SideIncinAgRFH_deg "" FLOAT32_IEEE POD_FaultHandle_CM_single 0 0 -3.4e+38 3.4e+38 ECU_ADDRESS 0xB0055B70 /end MEASUREMENT
/begin MEASUREMENT monr_VfSHM_SideIncinAgRHHM_deg "" FLOAT32_IEEE POD_HallHandleModule_TZCU_CM_single 0 0 -3.4e+38 3.4e+38 ECU_ADDRESS 0xB0055C34 /end MEASUREMENT
/begin MEASUREMENT monr_VfSHM_SideIncinAgRMCMR_deg "" FLOAT32_IEEE POD_MCMR_CM_single 0 0 -3.4e+38 3.4e+38 ECU_ADDRESS 0xB0055E0C /end MEASUREMENT
/begin MEASUREMENT monr_VfSHM_SideIncinAgRSMMR_deg "" FLOAT32_IEEE POD_SMMR_CM_single 0 0 -3.4e+38 3.4e+38 ECU_ADDRESS 0xB005609C /end MEASUREMENT
/begin MEASUREMENT monr_VfSHM_SideIncinAgRTTR_deg "" FLOAT32_IEEE POD_TipToRun_CM_single 0 0 -3.4e+38 3.4e+38 ECU_ADDRESS 0xB00561A4 /end MEASUREMENT
/begin MEASUREMENT monr_VfSHM_VehLVBattFH_V "" FLOAT32_IEEE POD_FaultHandle_CM_single 0 0 -3.4e+38 3.4e+38 ECU_ADDRESS 0xB0055B74 /end MEASUREMENT
/begin MEASUREMENT monr_VfSHM_VehSpdLgtAP_mps "" FLOAT32_IEEE POD_AntiPinch_CM_single 0 0 -3.4e+38 3.4e+38 ECU_ADDRESS 0xB005596C /end MEASUREMENT
/begin MEASUREMENT monr_VfSHM_VehSpdLgtFH_mps "" FLOAT32_IEEE POD_FaultHandle_CM_single 0 0 -3.4e+38 3.4e+38 ECU_ADDRESS 0xB0055B78 /end MEASUREMENT
/begin MEASUREMENT monr_VfSHM_VehSpdLgtMCML_mps "" FLOAT32_IEEE POD_MCML_CM_single 0 0 -3.4e+38 3.4e+38 ECU_ADDRESS 0xB0055D74 /end MEASUREMENT
/begin MEASUREMENT monr_VfSHM_VehSpdLgtMCMR_mps "" FLOAT32_IEEE POD_MCMR_CM_single 0 0 -3.4e+38 3.4e+38 ECU_ADDRESS 0xB0055E08 /end MEASUREMENT
/begin MEASUREMENT monr_VfSMM_TopDegforDoorOpenLMCML_NULL "" FLOAT32_IEEE POD_MCML_CM_single 0 0 -3.4e+38 3.4e+38 ECU_ADDRESS 0xB0055D48 /end MEASUREMENT
/begin MEASUREMENT monr_VfSMM_TopDegforDoorOpenRMCMR_NULL "" FLOAT32_IEEE POD_MCMR_CM_single 0 0 -3.4e+38 3.4e+38 ECU_ADDRESS 0xB0055DE4 /end MEASUREMENT
/begin MEASUREMENT monr_VsHHM_AntiPinchHallPositionLAP_NULL "" SWORD POD_AntiPinch_CM_int16 0 0 -32768 32767 ECU_ADDRESS 0xB0055970 /end MEASUREMENT
/begin MEASUREMENT monr_VsHHM_AntiPinchHallPositionLSMML_NULL "" SWORD POD_SMML_CM_int16 0 0 -32768 32767 ECU_ADDRESS 0xB005600E /end MEASUREMENT
/begin MEASUREMENT monr_VsHHM_AntiPinchHallPositionLTTR_NULL "" SWORD POD_TipToRun_CM_int16 0 0 -32768 32767 ECU_ADDRESS 0xB00561A8 /end MEASUREMENT
/begin MEASUREMENT monr_VsHHM_AntiPinchHallPositionRAP_NULL "" SWORD POD_AntiPinch_CM_int16 0 0 -32768 32767 ECU_ADDRESS 0xB0055972 /end MEASUREMENT
/begin MEASUREMENT monr_VsHHM_AntiPinchHallPositionRSMMR_NULL "" SWORD POD_SMMR_CM_int16 0 0 -32768 32767 ECU_ADDRESS 0xB0056076 /end MEASUREMENT
/begin MEASUREMENT monr_VsHHM_AntiPinchHallPositionRTTR_NULL "" SWORD POD_TipToRun_CM_int16 0 0 -32768 32767 ECU_ADDRESS 0xB00561AA /end MEASUREMENT
/begin MEASUREMENT monr_VsHHM_AswHallAccLMCML_g "" SWORD POD_MCML_CM_int16 0 0 -32768 32767 ECU_ADDRESS 0xB0055D60 /end MEASUREMENT
/begin MEASUREMENT monr_VsHHM_AswHallAccRMCMR_g "" SWORD POD_MCMR_CM_int16 0 0 -32768 32767 ECU_ADDRESS 0xB0055DF0 /end MEASUREMENT
/begin MEASUREMENT monr_VsHHM_AswHallPositionLAP_NULL "" SWORD POD_AntiPinch_CM_int16 0 0 -32768 32767 ECU_ADDRESS 0xB0055974 /end MEASUREMENT
/begin MEASUREMENT monr_VsHHM_AswHallPositionLMBCL_NULL "" SWORD POD_MBCL_CM_int16 0 0 -32768 32767 ECU_ADDRESS 0xB0055CDE /end MEASUREMENT
/begin MEASUREMENT monr_VsHHM_AswHallPositionLMCML_NULL "" SWORD POD_MCML_CM_int16 0 0 -32768 32767 ECU_ADDRESS 0xB0055D54 /end MEASUREMENT
/begin MEASUREMENT monr_VsHHM_AswHallPositionLSMML_NULL "" SWORD POD_SMML_CM_int16 0 0 -32768 32767 ECU_ADDRESS 0xB005600C /end MEASUREMENT
/begin MEASUREMENT monr_VsHHM_AswHallPositionLTTR_NULL "" SWORD POD_TipToRun_CM_int16 0 0 -32768 32767 ECU_ADDRESS 0xB00561AC /end MEASUREMENT
/begin MEASUREMENT monr_VsHHM_AswHallPositionRAP_NULL "" SWORD POD_AntiPinch_CM_int16 0 0 -32768 32767 ECU_ADDRESS 0xB0055976 /end MEASUREMENT
/begin MEASUREMENT monr_VsHHM_AswHallPositionRMBCR_NULL "" SWORD POD_MBCR_CM_int16 0 0 -32768 32767 ECU_ADDRESS 0xB0055D0E /end MEASUREMENT
/begin MEASUREMENT monr_VsHHM_AswHallPositionRMCMR_NULL "" SWORD POD_MCMR_CM_int16 0 0 -32768 32767 ECU_ADDRESS 0xB0055DEA /end MEASUREMENT
/begin MEASUREMENT monr_VsHHM_AswHallPositionRSMMR_NULL "" SWORD POD_SMMR_CM_int16 0 0 -32768 32767 ECU_ADDRESS 0xB005607C /end MEASUREMENT
/begin MEASUREMENT monr_VsHHM_AswHallPositionRTTR_NULL "" SWORD POD_TipToRun_CM_int16 0 0 -32768 32767 ECU_ADDRESS 0xB00561AE /end MEASUREMENT
/begin MEASUREMENT monr_VsHHM_AswHallSpeedLAP_rpm "" SWORD POD_AntiPinch_CM_int16 0 0 -32768 32767 ECU_ADDRESS 0xB0055978 /end MEASUREMENT
/begin MEASUREMENT monr_VsHHM_AswHallSpeedLMBCL_rpm "" SWORD POD_MBCL_CM_int16 0 0 -32768 32767 ECU_ADDRESS 0xB0055CDC /end MEASUREMENT
/begin MEASUREMENT monr_VsHHM_AswHallSpeedLMCML_rpm "" SWORD POD_MCML_CM_int16 0 0 -32768 32767 ECU_ADDRESS 0xB0055D5E /end MEASUREMENT
/begin MEASUREMENT monr_VsHHM_AswHallSpeedLSMML_rpm "" SWORD POD_SMML_CM_int16 0 0 -32768 32767 ECU_ADDRESS 0xB005601C /end MEASUREMENT
/begin MEASUREMENT monr_VsHHM_AswHallSpeedLTTR_rpm "" SWORD POD_TipToRun_CM_int16 0 0 -32768 32767 ECU_ADDRESS 0xB00561B0 /end MEASUREMENT
/begin MEASUREMENT monr_VsHHM_AswHallSpeedRAP_rpm "" SWORD POD_AntiPinch_CM_int16 0 0 -32768 32767 ECU_ADDRESS 0xB005597A /end MEASUREMENT
/begin MEASUREMENT monr_VsHHM_AswHallSpeedRMBCR_rpm "" SWORD POD_MBCR_CM_int16 0 0 -32768 32767 ECU_ADDRESS 0xB0055D10 /end MEASUREMENT
/begin MEASUREMENT monr_VsHHM_AswHallSpeedRMCMR_rpm "" SWORD POD_MCMR_CM_int16 0 0 -32768 32767 ECU_ADDRESS 0xB0055DFA /end MEASUREMENT
/begin MEASUREMENT monr_VsHHM_AswHallSpeedRSMMR_rpm "" SWORD POD_SMMR_CM_int16 0 0 -32768 32767 ECU_ADDRESS 0xB0056084 /end MEASUREMENT
/begin MEASUREMENT monr_VsHHM_AswHallSpeedRTTR_rpm "" SWORD POD_TipToRun_CM_int16 0 0 -32768 32767 ECU_ADDRESS 0xB00561B2 /end MEASUREMENT
/begin MEASUREMENT monr_VsHHM_HallCntrLFH_NULL "" SWORD POD_FaultHandle_CM_int16 0 0 -32768 32767 ECU_ADDRESS 0xB0055B7C /end MEASUREMENT
/begin MEASUREMENT monr_VsHHM_HallCntrRFH_NULL "" SWORD POD_FaultHandle_CM_int16 0 0 -32768 32767 ECU_ADDRESS 0xB0055B7E /end MEASUREMENT
/begin MEASUREMENT monr_VsMCM_totalFeedBackDutyRMBCR_NULL "" SWORD POD_MBCR_CM_int16 0 0 -32768 32767 ECU_ADDRESS 0xB00561C6 /end MEASUREMENT
/begin MEASUREMENT monr_VsSHM_NVMHallCntrLHHM_NULL "" SWORD POD_HallHandleModule_TZCU_CM_int16 0 0 -32768 32767 ECU_ADDRESS 0xB0055C5C /end MEASUREMENT
/begin MEASUREMENT monr_VsSHM_NVMHallCntrRHHM_NULL "" SWORD POD_HallHandleModule_TZCU_CM_int16 0 0 -32768 32767 ECU_ADDRESS 0xB0055C5E /end MEASUREMENT
/begin MEASUREMENT monr_VuHHM_HallPWMLAP_Hz "" UWORD POD_AntiPinch_CM_uint16 0 0 0 65535 ECU_ADDRESS 0xB005597C /end MEASUREMENT
/begin MEASUREMENT monr_VuHHM_HallPWMLFH_Hz "" UWORD POD_FaultHandle_CM_uint16 0 0 0 65535 ECU_ADDRESS 0xB0055B80 /end MEASUREMENT
/begin MEASUREMENT monr_VuHHM_HallPWMRAP_Hz "" UWORD POD_AntiPinch_CM_uint16 0 0 0 65535 ECU_ADDRESS 0xB005597E /end MEASUREMENT
/begin MEASUREMENT monr_VuHHM_HallPWMRFH_Hz "" UWORD POD_FaultHandle_CM_uint16 0 0 0 65535 ECU_ADDRESS 0xB0055B82 /end MEASUREMENT
/begin MEASUREMENT monr_VuMCM_MotorCtrlDuty1LSHM_NULL "" UWORD POD_SignalHandModule_T_CM_uint16 0 0 0 65535 ECU_ADDRESS 0xB0055FC8 /end MEASUREMENT
/begin MEASUREMENT monr_VuMCM_MotorCtrlDuty1RSHM_NULL "" UWORD POD_SignalHandModule_T_CM_uint16 0 0 0 65535 ECU_ADDRESS 0xB0055FCA /end MEASUREMENT
/begin MEASUREMENT monr_VuMCM_MotorCtrlDuty2LSHM_NULL "" UWORD POD_SignalHandModule_T_CM_uint16 0 0 0 65535 ECU_ADDRESS 0xB0055FCC /end MEASUREMENT
/begin MEASUREMENT monr_VuMCM_MotorCtrlDuty2RSHM_NULL "" UWORD POD_SignalHandModule_T_CM_uint16 0 0 0 65535 ECU_ADDRESS 0xB0055FCE /end MEASUREMENT
/begin GROUP POD_AntiPinch "POD_AntiPinch" ROOT /begin SUB_GROUP Root_POD_AntiPinch /end SUB_GROUP /end GROUP
/begin GROUP POD_FaultHandle "POD_FaultHandle" ROOT /begin SUB_GROUP Root_POD_FaultHandle /end SUB_GROUP /end GROUP
/begin GROUP POD_FITOut "POD_FITOut" ROOT /begin SUB_GROUP Root_RDM_FITOut_Main_sys /end SUB_GROUP /end GROUP
/begin GROUP POD_HallHandleModule_TZCU "POD_HallHandleModule_TZCU" ROOT /begin SUB_GROUP Root_POD_HallHandleModule /end SUB_GROUP /end GROUP
/begin GROUP POD_MBCL "POD_MBCL" ROOT /begin SUB_GROUP Root_POD_MotorBrakeCtrlL_Step_sys /end SUB_GROUP /end GROUP
/begin GROUP POD_MBCR "POD_MBCR" ROOT /begin SUB_GROUP Root_POD_MotorBrakeCtrlR_Step_sys /end SUB_GROUP /end GROUP
/begin GROUP POD_MCML "POD_MCML" ROOT /begin SUB_GROUP Root_POD_MotorCtrlModuleL_Step_sys /end SUB_GROUP /end GROUP
/begin GROUP POD_MCMR "POD_MCMR" ROOT /begin SUB_GROUP Root_POD_MotorCtrlModuleR_Step_sys /end SUB_GROUP /end GROUP
/begin GROUP POD_SignalHandModule_T "POD_SignalHandModule_T" ROOT /begin SUB_GROUP Root_POD_SignalHandModule /end SUB_GROUP /end GROUP
/begin GROUP POD_SMML "POD_SMML" ROOT /begin SUB_GROUP Root_POD_StateManageMduleL_Step_sys /end SUB_GROUP /end GROUP
/begin GROUP POD_SMMR "POD_SMMR" ROOT /begin SUB_GROUP Root_POD_StateManageMduleR_Step_sys /end SUB_GROUP /end GROUP
/begin GROUP POD_TipToRun "POD_TipToRun" ROOT /begin SUB_GROUP Root_POD_TipToRun /end SUB_GROUP /end GROUP
/begin GROUP RDM_AntiPinch "RDM_AntiPinch" ROOT /begin SUB_GROUP Root_RDM_AntiPinch_Main_sys /end SUB_GROUP /end GROUP
/begin GROUP RDM_CtrlLeverMtr "RDM_CtrlLeverMtr" ROOT /begin SUB_GROUP Root_RDM_CtrlLeverMtr_Main_sys /end SUB_GROUP /end GROUP
/begin GROUP RDM_DetLeverMtrStallSt "RDM_DetLeverMtrStallSt" ROOT /begin SUB_GROUP Root_RDM_DetLeverMtrStallSt_Main_sys /end SUB_GROUP /end GROUP
/begin GROUP RDM_DetThermProtSt "RDM_DetThermProtSt" ROOT /begin SUB_GROUP Root_RDM_DetThermProtSt_Main_sys /end SUB_GROUP /end GROUP
/begin GROUP RDM_DetTrunkMoveReq "RDM_DetTrunkMoveReq" ROOT /begin SUB_GROUP Root_RDM_DetTrunkMoveReq_Main_sys /end SUB_GROUP /end GROUP
/begin GROUP RDM_FITIn "RDM_FITIn" ROOT /begin SUB_GROUP Root_RDM_FITIn_Main_sys /end SUB_GROUP /end GROUP
/begin GROUP RDM_FITOut "RDM_FITOut" ROOT /begin SUB_GROUP Root_RDM_FITOut_Main_sys /end SUB_GROUP /end GROUP
/begin GROUP RDM_GetTrunkPos "RDM_GetTrunkPos" ROOT /begin SUB_GROUP Root_RDM_GetTrunkPos_Main_sys /end SUB_GROUP /end GROUP
/begin GROUP RDM_HallDeco "RDM_HallDeco" ROOT
 /begin SUB_GROUP Root_NotificationRightLeverHallCnt_ISR_sys Root_RDM_HallDeco_Main_sys /end SUB_GROUP
/end GROUP
/begin GROUP RDM_LearnRF "RDM_LearnRF" ROOT /begin SUB_GROUP Root_RDM_LearnRF_Main_sys /end SUB_GROUP /end GROUP
/begin GROUP RDM_SetSwSt "RDM_SetSwSt" ROOT /begin SUB_GROUP Root_RDM_SetSwSt_Main_sys /end SUB_GROUP /end GROUP
/begin GROUP RDM_SOARx "RDM_SOARx" ROOT /begin SUB_GROUP Root_RDM_SOARx_Main_sys /end SUB_GROUP /end GROUP
/begin GROUP RDMLatch_DetMotorStall "RDMLatch_DetMotorStall" ROOT /begin SUB_GROUP Root_RDMLatch_DetMotorStall_Main_sys /end SUB_GROUP /end GROUP
/begin GROUP RDMLatch_FITIn "RDMLatch_FITIn" ROOT /begin SUB_GROUP Root_RDMLatch_FITIn_Main_sys /end SUB_GROUP /end GROUP
/begin GROUP RDMLatch_FITOut "RDMLatch_FITOut" ROOT /begin SUB_GROUP Root_RDMLatch_FITOut_Main_sys /end SUB_GROUP /end GROUP
/begin GROUP RDMLatch_SetCinchRelsCmd "RDMLatch_SetCinchRelsCmd" ROOT /begin SUB_GROUP Root_RDMLatch_SetCinchRelsCmd_Main_sys /end SUB_GROUP /end GROUP
/begin GROUP Root_NotificationRightLeverHallCnt_ISR_sys "RDM_HallDeco/NotificationRightLeverHallCnt_ISR_sys" /begin REF_CHARACTERISTIC CalC_TrnkRLvrCfgEnable /end REF_CHARACTERISTIC /end GROUP
/begin GROUP Root_POD_AntiPinch "POD_AntiPinch/POD_AntiPinch" /begin SUB_GROUP S2_AntiPinch /end SUB_GROUP
 /begin REF_MEASUREMENT monr_VbHHM_DoorOpenLAP_flg monr_VbHHM_DoorOpenRAP_flg monr_VeFH_DoorLckPstnLAP_enum monr_VeFH_DoorLckPstnRAP_enum monr_VeHHM_SectorIndexLAP_enum monr_VeHHM_SectorIndexRAP_enum monr_VeSHM_CbnPressLvlAP_enum monr_VeSHM_DoorTypCfgAP_enum monr_VeSMM_DOPFcnStateLAP_enum monr_VeSMM_DOPFcnStateRAP_enum monr_VeSMM_HoverModCtrlLAP_enum monr_VeSMM_HoverModCtrlRAP_enum monr_VeSMM_MotorCtrlModeLAP_enum monr_VeSMM_MotorCtrlModeRAP_enum monr_VeSMM_MotorCtrlStateLAP_enum monr_VeSMM_MotorCtrlStateRAP_enum monr_VeSMM_StopEventLAP_enum monr_VeSMM_StopEventRAP_enum monr_VfIMU_AgSpdLAP_degps monr_VfIMU_AgSpdRAP_degps monr_VfMCM_BrakingTorqueLAP_NULL monr_VfMCM_BrakingTorqueRAP_NULL monr_VfMCM_MotorCtrlDutyLAP_NULL monr_VfMCM_MotorCtrlDutyRAP_NULL monr_VfMCM_TarPosLAP_NULL monr_VfMCM_TarPosRAP_NULL monr_VfMCM_TarSpdLAP_NULL monr_VfMCM_TarSpdRAP_NULL monr_VfMCM_ldlToAntipinchLAP_MA monr_VfMCM_ldlToAntipinchRAP_MA monr_VfMCM_lrefToAntipinchLAP_MA monr_VfMCM_lrefToAntipinchRAP_MA monr_VfSHM_AmbTempAP_C monr_VfSHM_BatVoltageValueAP_MV monr_VfSHM_FrntIncinAgLAP_deg monr_VfSHM_FrntIncinAgRAP_deg monr_VfSHM_MainMotoCurrentLAP_MA monr_VfSHM_MainMotoCurrentRAP_MA monr_VfSHM_SideIncinAgLAP_deg monr_VfSHM_SideIncinAgRAP_deg monr_VfSHM_VehSpdLgtAP_mps monr_VsHHM_AntiPinchHallPositionLAP_NULL monr_VsHHM_AntiPinchHallPositionRAP_NULL monr_VsHHM_AswHallPositionLAP_NULL monr_VsHHM_AswHallPositionRAP_NULL monr_VsHHM_AswHallSpeedLAP_rpm monr_VsHHM_AswHallSpeedRAP_rpm monr_VuHHM_HallPWMLAP_Hz monr_VuHHM_HallPWMRAP_Hz /end REF_MEASUREMENT
/end GROUP
/begin GROUP Root_POD_FaultHandle "POD_FaultHandle/POD_FaultHandle" /begin SUB_GROUP S2_FaultHandle /end SUB_GROUP
 /begin REF_MEASUREMENT monr_VbAP_AntiPinchStsDspLFH_flg monr_VbAP_AntiPinchStsDspRFH_flg monr_VbHHM_HallSigFltLFH_flg monr_VbHHM_HallSigFltRFH_flg monr_VbSMM_BrkFrcRelsLFH_flg monr_VbSMM_BrkFrcRelsRFH_flg monr_VbSMM_BrkMotModCtrlLFH_flg monr_VbSMM_BrkMotModCtrlRFH_flg monr_VbSMM_ElecDoorClsReqLFH_flg monr_VbSMM_ElecDoorClsReqRFH_flg monr_VbSMM_ElecDoorOpenReqLFH_flg monr_VbSMM_ElecDoorOpenReqRFH_flg monr_VbSMM_RdrWrkReqLFH_flg monr_VbSMM_RdrWrkReqRFH_flg monr_VeHHM_DoorMovStsLFH_NULL monr_VeHHM_DoorMovStsRFH_NULL monr_VeHHM_UsrSetMaxPstnLFH_pct monr_VeHHM_UsrSetMaxPstnRFH_pct monr_VeMCM_CmdStateLFH_NULL monr_VeMCM_CmdStateRFH_NULL monr_VeSHM_DoorLckPstnLFH_enum monr_VeSHM_DoorLckPstnRFH_enum monr_VeSHM_DoorModStsFH_enum monr_VeSHM_DoorTypCfgFH_enum monr_VeSHM_DoorWrkReqLFH_enum monr_VeSHM_DoorWrkReqRFH_enum monr_VeSHM_FrntIncinAgQlyLFH_enum monr_VeSHM_FrntIncinAgQlyRFH_enum monr_VeSHM_SideIncinAgQlyLFH_enum monr_VeSHM_SideIncinAgQlyRFH_enum monr_VeSHM_VehSpdLgtQlyFH_enum monr_VeSHM_VehSptStsFH_enum monr_VeSHM_WakeUpTypLFH_NULL monr_VeSHM_WakeUpTypRFH_NULL monr_VeSMM_DOPFcnStateLFH_enum monr_VeSMM_DOPFcnStateRFH_enum monr_VeSMM_MotorCtrlModeLFH_enum monr_VeSMM_MotorCtrlModeRFH_enum monr_VeSMM_MotorCtrlStateLFH_enum monr_VeSMM_MotorCtrlStateRFH_enum monr_VfIMU_AgSpdLFH_degps monr_VfIMU_AgSpdRFH_degps monr_VfIMU_VehPitchLFH_deg monr_VfIMU_VehPitchRFH_deg monr_VfIMU_VehRollLFH_deg monr_VfIMU_VehRollRFH_deg monr_VfSHM_BatVoltageValueFH_MV monr_VfSHM_DoorRdrAgLFH_deg monr_VfSHM_DoorRdrAgRFH_deg monr_VfSHM_FrntIncinAgLFH_deg monr_VfSHM_FrntIncinAgRFH_deg monr_VfSHM_MainMotoCurrentLFH_MA monr_VfSHM_MainMotoCurrentRFH_MA monr_VfSHM_SideIncinAgLFH_deg monr_VfSHM_SideIncinAgRFH_deg monr_VfSHM_VehLVBattFH_V monr_VfSHM_VehSpdLgtFH_mps monr_VsHHM_HallCntrLFH_NULL monr_VsHHM_HallCntrRFH_NULL monr_VuHHM_HallPWMLFH_Hz monr_VuHHM_HallPWMRFH_Hz /end REF_MEASUREMENT
/end GROUP
/begin GROUP Root_POD_HallHandleModule "POD_HallHandleModule_TZCU/POD_HallHandleModule" /begin SUB_GROUP S2_HallHandleModule /end SUB_GROUP
 /begin REF_MEASUREMENT monr_VbFH_ECUWakeUpLHHM_flg monr_VbFH_ECUWakeUpRHHM_flg monr_VbFH_FrbdMaiMotWrkLHHM_flg monr_VbFH_FrbdMaiMotWrkRHHM_flg monr_VbFH_HallSigErrLHHM_flg monr_VbFH_HallSigErrRHHM_flg monr_VeFH_DoorLckPstnLHHM_enum monr_VeFH_DoorLckPstnRHHM_enum monr_VeSHM_DoorWrkReqLHHM_enum monr_VeSHM_DoorWrkReqRHHM_enum monr_VeSHM_NVMDoorOprtStsLHHM_enum monr_VeSHM_NVMDoorOprtStsRHHM_enum monr_VeSHM_PwrModDoorSetPstnHHM_pct monr_VeSHM_UsrSetMaxPstnHHM_pct monr_VeSMM_DOPFcnStateLHHM_enum monr_VeSMM_DOPFcnStateRHHM_enum monr_VeSMM_HoverModCtrlLHHM_enum monr_VeSMM_HoverModCtrlRHHM_enum monr_VeSMM_MotorCtrlModeLHHM_enum monr_VeSMM_MotorCtrlModeRHHM_enum monr_VeSMM_MotorCtrlStateLHHM_enum monr_VeSMM_MotorCtrlStateRHHM_enum monr_VeSMM_OpenDoorCmdLHHM_enum monr_VeSMM_OpenDoorCmdRHHM_enum monr_VeSMM_StopEventLHHM_enum monr_VeSMM_StopEventRHHM_enum monr_VfIMU_AgSpdLHHM_degps monr_VfIMU_AgSpdRHHM_degps monr_VfSHM_FrntIncinAgLHHM_deg monr_VfSHM_FrntIncinAgRHHM_deg monr_VfSHM_MainMotoCurrentLHHM_MA monr_VfSHM_MainMotoCurrentRHHM_MA monr_VfSHM_SideIncinAgLHHM_deg monr_VfSHM_SideIncinAgRHHM_deg monr_VsSHM_NVMHallCntrLHHM_NULL monr_VsSHM_NVMHallCntrRHHM_NULL /end REF_MEASUREMENT
/end GROUP
/begin GROUP Root_POD_MotorBrakeCtrlL_Step_sys "POD_MBCL/POD_MotorBrakeCtrlL_Step_sys" /begin SUB_GROUP S2_POD_MotorBrakeCtrlL /end SUB_GROUP
 /begin REF_MEASUREMENT monr_VbMCM_ManualAssistLMBCL_flag monr_VbMCM_MotorBrkgLMBCL_flg monr_VbMCM_TipToRunLMBCL_flag monr_VbSMM_HoldModeLMBCL_flg monr_VeSMM_DOPFcnStateLMBCL_enum monr_VeSMM_HoverModCtrlLMBCL_enum monr_VeSMM_MotorCtrlModeLMBCL_enum monr_VeSMM_StopEventLMBCL_enum monr_VfMCM_GravityTorqueLMBCL_Nm monr_VfMCM_RoadInclnLMBCL_deg monr_VfMCM_SideIncinAgLMBCL_deg monr_VsHHM_AswHallPositionLMBCL_NULL monr_VsHHM_AswHallSpeedLMBCL_rpm /end REF_MEASUREMENT
/end GROUP
/begin GROUP Root_POD_MotorBrakeCtrlR_Step_sys "POD_MBCR/POD_MotorBrakeCtrlR_Step_sys" /begin SUB_GROUP S2_POD_MotorBrakeCtrlR /end SUB_GROUP
 /begin REF_MEASUREMENT monr_VbMCM_ManualAssistRMBCR_flag monr_VbMCM_MotorBrkgRMBCR_flg monr_VbMCM_TipToRunRMBCR_flag monr_VbSMM_HoldModeRMBCR_flg monr_VeSMM_DOPFcnStateRMBCR_enum monr_VeSMM_HoverModCtrlRMBCR_enum monr_VeSMM_MotorCtrlModeRMBCR_enum monr_VeSMM_StopEventRMBCR_enum monr_VfMCM_GravityTorqueRMBCR_Nm monr_VfMCM_RoadInclnRMBCR_deg monr_VfMCM_SideIncinAgRMBCR_deg monr_VsHHM_AswHallPositionRMBCR_NULL monr_VsHHM_AswHallSpeedRMBCR_rpm monr_VsMCM_totalFeedBackDutyRMBCR_NULL /end REF_MEASUREMENT
/end GROUP
/begin GROUP Root_POD_MotorCtrlModuleL_Step_sys "POD_MCML/POD_MotorCtrlModuleL_Step_sys" /begin SUB_GROUP S2_POD_MotorCtrlModuleL /end SUB_GROUP
 /begin REF_MEASUREMENT monr_VbFH_FrbdMaiMotWrkLMCML_flg monr_VbFH_HallSigErrLMCML_flg monr_VbHHM_DoorOpenLMCML_flg monr_VbSMM_HoldModeLMCML_flg monr_VeHHM_DoorMovStsLMCML_NULL monr_VeHHM_SectorIndexLMCML_enum monr_VeSHM_CbnPressLvlMCML_enum monr_VeSHM_DoorTypCfgMCML_enum monr_VeSMM_DOPFcnStateLMCML_enum monr_VeSMM_DoorLatPosnLMCML_enum monr_VeSMM_HoverModCtrlLMCML_enum monr_VeSMM_MotorCtrlModeLMCML_enum monr_VeSMM_MotorCtrlStateLMCML_enum monr_VeSMM_PushLockLMCML_NULL monr_VeSMM_StopEventLMCML_enum monr_VfHHM_AswHallPositionLMCML_deg monr_VfSHM_AmbTempMCML_C monr_VfSHM_BatVoltageValueMCML_MV monr_VfSHM_FrntIncinAgLMCML_deg monr_VfSHM_MainMotoCurrentLMCML_MA monr_VfSHM_SideIncinAgLMCML_deg monr_VfSHM_VehSpdLgtMCML_mps monr_VfSMM_TopDegforDoorOpenLMCML_NULL monr_VsHHM_AswHallAccLMCML_g monr_VsHHM_AswHallPositionLMCML_NULL monr_VsHHM_AswHallSpeedLMCML_rpm /end REF_MEASUREMENT
/end GROUP
/begin GROUP Root_POD_MotorCtrlModuleR_Step_sys "POD_MCMR/POD_MotorCtrlModuleR_Step_sys" /begin SUB_GROUP S2_POD_MotorCtrlModuleR /end SUB_GROUP
 /begin REF_MEASUREMENT monr_VbFH_FrbdMaiMotWrkLMCMR_flg monr_VbFH_HallSigErrLMCMR_flg monr_VbHHM_DoorOpenLMCMR_flg monr_VbSMM_HoldModeRMCMR_flg monr_VeHHM_DoorMovStsRMCMR_NULL monr_VeHHM_SectorIndexRMCMR_enum monr_VeSHM_CbnPressLvlMCMR_enum monr_VeSHM_DoorTypCfgMCMR_enum monr_VeSMM_DOPFcnStateRMCMR_enum monr_VeSMM_DoorLatPosnRMCMR_enum monr_VeSMM_HoverModCtrlRMCMR_enum monr_VeSMM_MotorCtrlModeRMCMR_enum monr_VeSMM_MotorCtrlStateRMCMR_enum monr_VeSMM_PushLockRMCMR_NULL monr_VeSMM_StopEventRMCMR_enum monr_VfHHM_AswHallPositionRMCMR_deg monr_VfSHM_AmbTempMCMR_C monr_VfSHM_BatVoltageValueMCMR_MV monr_VfSHM_FrntIncinAgRMCMR_deg monr_VfSHM_MainMotoCurrentRMCMR_MA monr_VfSHM_SideIncinAgRMCMR_deg monr_VfSHM_VehSpdLgtMCMR_mps monr_VfSMM_TopDegforDoorOpenRMCMR_NULL monr_VsHHM_AswHallAccRMCMR_g monr_VsHHM_AswHallPositionRMCMR_NULL monr_VsHHM_AswHallSpeedRMCMR_rpm /end REF_MEASUREMENT
/end GROUP
/begin GROUP Root_POD_SignalHandModule "POD_SignalHandModule_T/POD_SignalHandModule" /begin SUB_GROUP S2_SignalHandModule /end SUB_GROUP
 /begin REF_MEASUREMENT monr_VbAP_AntiPinchStsDspRSHM_flg monr_VbSMM_RdrWrkReqByCEMLSHM_flg monr_VbSMM_RdrWrkReqByCEMRSHM_flg monr_VbTTR_TipToRunRqstLSHM_flg monr_VeHHM_UsrSetMaxPstnLSHM_pct monr_VeHHM_UsrSetMaxPstnRSHM_pct monr_VeINP_AirIntakeStSHM_pct monr_VeINP_DOWLXWarningSHM_enum monr_VeINP_DOWRXWarningSHM_enum monr_VeINP_DRMXLErrSHM_enum monr_VeINP_DRMXLStSHM_enum monr_VeINP_DRMXRErrSHM_enum monr_VeINP_DRMXRStSHM_enum monr_VeINP_DoorOpenerXLReqSHM_enum monr_VeINP_DoorOpenerXRReqSHM_enum monr_VeINP_ExterTempVDSHM_enum monr_VeINP_FLWinPosStFBSHM_pct monr_VeINP_FRWinPosStFBSHM_pct monr_VeINP_ModSetSHM_enum monr_VeINP_RLWinPosStFBSHM_pct monr_VeINP_RRWinPosStFBSHM_pct monr_VeINP_RoofPosValueSHM_pct monr_VeINP_TgatePosSHM_pct monr_VeINP_VehSpdVDSHM_enum monr_VeINP_WindExitSpdSHM_enum monr_VeINP_XLDoorLockStSHM_enum monr_VeINP_XLDoorOpenAgSHM_deg monr_VeINP_XLMaiMotOCErrSHM_flg monr_VeINP_XLMaiMotSCBErrSHM_flg monr_VeINP_XLMaiMotSCGErrSHM_flg monr_VeINP_XLPitchAgVDSHM_enum monr_VeINP_XLReqSHM_enum monr_VeINP_XLRollAgVDSHM_enum monr_VeINP_XRDoorLockStSHM_enum monr_VeINP_XRDoorOpenAgSHM_deg monr_VeINP_XRMaiMotOCErrSHM_flg monr_VeINP_XRMaiMotSCBErrSHM_flg monr_VeINP_XRMaiMotSCGErrSHM_flg monr_VeINP_XRPitchAgVDSHM_enum monr_VeINP_XRReqSHM_enum monr_VeINP_XRRollAgVDSHM_enum monr_VeMCM_MotorCtrlModeLSHM_enum monr_VeMCM_MotorCtrlModeRSHM_enum monr_VeSMM_DOPFcnStateLSHM_enum monr_VeSMM_DOPFcnStateRSHM_enum monr_VfHHM_AswHallPositionLSHM_deg monr_VfHHM_AswHallPositionRSHM_deg monr_VfINP_DoorRLOpenAgSHM_deg monr_VfINP_DoorRROpenAgSHM_deg monr_VfINP_ExterTempSHM_C monr_VfINP_FLGYROAgSpdSHM_degps monr_VfINP_FRGYROAgSpdSHM_degps monr_VfINP_MaiMotCurrLSHM_A monr_VfINP_MaiMotCurrRSHM_A monr_VfINP_UBRVoltSHM_V monr_VfINP_VehSpdSHM_kph monr_VfINP_XLPitchAgSHM_deg monr_VfINP_XLRollAgSHM_deg monr_VfINP_XRPitchAgSHM_deg monr_VfINP_XRRollAgSHM_deg monr_VuMCM_MotorCtrlDuty1LSHM_NULL monr_VuMCM_MotorCtrlDuty1RSHM_NULL monr_VuMCM_MotorCtrlDuty2LSHM_NULL monr_VuMCM_MotorCtrlDuty2RSHM_NULL /end REF_MEASUREMENT
/end GROUP
/begin GROUP Root_POD_StateManageMduleL_Step_sys "POD_SMML/POD_StateManageMduleL_Step_sys" /begin SUB_GROUP S1_POD_StateManageMduleL /end SUB_GROUP
 /begin REF_MEASUREMENT monr_VbAP_AntiPinchStsDspLSMML_flg monr_VbAP_ThermprotnLSMML_flg monr_VbFH_AnptiplayLSMML_flg monr_VbFH_ECUWakeUpLSMML_flg monr_VbFH_FrbdMaiMotWrkLSMML_flg monr_VbFH_FrntIncinAgFltLSMML_flg monr_VbFH_HallSigErrLSMML_flg monr_VbFH_RdrTioutLSMML_flg monr_VbFH_SideIncinAgFltLSMML_flg monr_VbHHM_DoorOpenLSMML_flg monr_VbSHM_IceBreakDoorActvLSMML_flg monr_VbTTR_TipToRunRqstLSMML_flg monr_VeHHM_DoorMovStsLSMML_NULL monr_VeHHM_UsrSetMaxPstnLSMML_pct monr_VeMCM_CmdStateLSMML_NULL monr_VeSHM_DoorLckPstnLSMML_enum monr_VeSHM_DoorModStsSMML_enum monr_VeSHM_DoorOpenArlmLSMML_enum monr_VeSHM_DoorStsLSMML_enum monr_VeSHM_DoorTypCfgSMML_enum monr_VeSHM_DoorWrkReqLSMML_enum monr_VeSHM_DoorWrkReqSrcLSMML_enum monr_VeSHM_NVMDoorOprtStsLSMML_enum monr_VeSHM_VehSptStsSMML_enum monr_VeTTR_ManAsstRqstLSMML_enum monr_VfHHM_AswHallPositionLSMML_deg monr_VfHHM_DoorPstnLSMML_pct monr_VfHHM_MaxOpenPositionLSMML_deg monr_VfIMU_AgSpdLSMML_degps monr_VfSHM_AmbTempSMML_C monr_VfSHM_DoorRdrAgLSMML_deg monr_VfSHM_FrntIncinAgLSMML_deg monr_VfSHM_MainMotoCurrentLSMML_MA monr_VfSHM_SideIncinAgLSMML_deg monr_VsHHM_AntiPinchHallPositionLSMML_NULL monr_VsHHM_AswHallPositionLSMML_NULL monr_VsHHM_AswHallSpeedLSMML_rpm /end REF_MEASUREMENT
/end GROUP
/begin GROUP Root_POD_StateManageMduleR_Step_sys "POD_SMMR/POD_StateManageMduleR_Step_sys" /begin SUB_GROUP S1_POD_StateManageMduleR /end SUB_GROUP
 /begin REF_MEASUREMENT monr_VbAP_AntiPinchStsDspRSMMR_flg monr_VbFH_AnptiplayRSMMR_flg monr_VbFH_ECUWakeUpRSMMR_flg monr_VbFH_FrbdMaiMotWrkRSMMR_flg monr_VbFH_FrntIncinAgFltRSMMR_flg monr_VbFH_HallSigErrRSMMR_flg monr_VbFH_RdrTioutRSMMR_flg monr_VbFH_SideIncinAgFltRSMMR_flg monr_VbFH_ThermprotnRSMMR_flg monr_VbHHM_DoorOpenRSMMR_flg monr_VbSHM_IceBreakDoorActvRSMMR_flg monr_VbTTR_TipToRunRqstRSMMR_flg monr_VeHHM_DoorMovStsRSMMR_NULL monr_VeHHM_UsrSetMaxPstnRSMMR_pct monr_VeMCM_CmdStateRSMMR_NULL monr_VeSHM_DoorLckPstnRSMMR_enum monr_VeSHM_DoorModStsSMMR_enum monr_VeSHM_DoorOpenArlmRSMMR_enum monr_VeSHM_DoorStsRSMMR_enum monr_VeSHM_DoorTypCfgSMMR_enum monr_VeSHM_DoorWrkReqRSMMR_enum monr_VeSHM_DoorWrkReqSrcRSMMR_enum monr_VeSHM_NVMDoorOprtStsRSMMR_enum monr_VeSHM_VehSptStsSMMR_enum monr_VeTTR_ManAsstRqstRSMMR_enum monr_VfHHM_AswHallPositionRSMMR_deg monr_VfHHM_DoorPstnRSMMR_pct monr_VfHHM_MaxOpenPositionRSMMR_deg monr_VfIMU_AgSpdRSMMR_degps monr_VfSHM_AmbTempSMMR_C monr_VfSHM_DoorRdrAgRSMMR_deg monr_VfSHM_FrntIncinAgRSMMR_deg monr_VfSHM_MainMotoCurrentRSMMR_MA monr_VfSHM_SideIncinAgRSMMR_deg monr_VsHHM_AntiPinchHallPositionRSMMR_NULL monr_VsHHM_AswHallPositionRSMMR_NULL monr_VsHHM_AswHallSpeedRSMMR_rpm /end REF_MEASUREMENT
/end GROUP
/begin GROUP Root_POD_TipToRun "POD_TipToRun/POD_TipToRun" /begin SUB_GROUP S2_TipToRun /end SUB_GROUP
 /begin REF_MEASUREMENT monr_VbFH_GyroSigFltLTTR_flg monr_VbFH_GyroSigFltRTTR_flg monr_VbFH_HallSigErrLTTR_flg monr_VbFH_HallSigErrRTTR_flg monr_VbSMM_BrkMotModCtrlLTTR_flg monr_VbSMM_BrkMotModCtrlRTTR_flg monr_VbSMM_DoorFreeMovgLTTR_flg monr_VbSMM_DoorFreeMovgRTTR_flg monr_VbSMM_ManAsstEnableLTTR_flg monr_VbSMM_ManAsstEnableRTTR_flg monr_VbSMM_TiptoRunEnableLTTR_flg monr_VbSMM_TiptoRunEnableRTTR_flg monr_VeHHM_DoorMovStsLTTR_NULL monr_VeHHM_DoorMovStsRTTR_NULL monr_VeSHM_DoorTypCfgTTR_enum monr_VeSMM_DOPFcnStateLTTR_enum monr_VeSMM_DOPFcnStateRTTR_enum monr_VeSMM_HoverModCtrlLTTR_enum monr_VeSMM_HoverModCtrlRTTR_enum monr_VeSMM_MotorCtrlModeLTTR_enum monr_VeSMM_MotorCtrlModeRTTR_enum monr_VeSMM_MotorCtrlStateLTTR_enum monr_VeSMM_MotorCtrlStateRTTR_enum monr_VeSMM_StopEventLTTR_enum monr_VeSMM_StopEventRTTR_enum monr_VfHHM_AswHallPositionLTTR_deg monr_VfHHM_AswHallPositionRTTR_deg monr_VfSHM_FrntIncinAgLTTR_deg monr_VfSHM_FrntIncinAgRTTR_deg monr_VfSHM_SideIncinAgLTTR_deg monr_VfSHM_SideIncinAgRTTR_deg monr_VsHHM_AntiPinchHallPositionLTTR_NULL monr_VsHHM_AntiPinchHallPositionRTTR_NULL monr_VsHHM_AswHallPositionLTTR_NULL monr_VsHHM_AswHallPositionRTTR_NULL monr_VsHHM_AswHallSpeedLTTR_rpm monr_VsHHM_AswHallSpeedRTTR_rpm /end REF_MEASUREMENT
/end GROUP
/begin GROUP Root_RDM_AntiPinch_Main_sys "RDM_AntiPinch/RDM_AntiPinch_Main_sys"
 /begin SUB_GROUP S3_AntiPinchMainAlgo1 S3_AntiPinchMainAlgo4 S3_AntiPinchThresh S3_DetClsTraceAPTol S3_DetOpnAPThresh S3_DetTraceAPTol S3_For_Each_Subsystem S3_SendCurAPThr S3_Subsystem1 S3_Subsystem2 S3_Subsystem3 /end SUB_GROUP
 /begin REF_CHARACTERISTIC CalC_TrnkClsMtrNormSpd CalC_TrnkClsTraceAPMtrSpdThr CalC_TrnkOpnMtrNormSpd /end REF_CHARACTERISTIC
 /begin REF_MEASUREMENT Monr_TrnkAPOverRideErrSt Monr_TrnkAbnEnvFlag Monr_TrnkAntiPinchSt Monr_TrnkBatVoltPlungeFlag Monr_TrnkClsAPCurrThr Monr_TrnkClsAPSpdGap Monr_TrnkClsCurAPThresh Monr_TrnkClsHrdAPRefSpd Monr_TrnkClsSftAPRefSpd Monr_TrnkClsTraceAPRefSpd Monr_TrnkExitRefSpdProcFlag Monr_TrnkOpnAPSpdGap Monr_TrnkOpnCurAPThresh Monr_TrnkOpnTraceAPRefSpd /end REF_MEASUREMENT
/end GROUP
/begin GROUP Root_RDM_CtrlLeverMtr_Main_sys "RDM_CtrlLeverMtr/RDM_CtrlLeverMtr_Main_sys" /begin SUB_GROUP S3_DetStallStopCond S3_For_Each_Subsystem /end SUB_GROUP
 /begin REF_CHARACTERISTIC CalC_TrnkAntiDriveMaxPosTol CalC_TrnkAntiDrivePwm CalC_TrnkRLvrCfgEnable /end REF_CHARACTERISTIC
 /begin REF_MEASUREMENT Monr_AntiDriveTrig Monr_TrnkAllActnSts Monr_TrnkDiagResetFlag Monr_TrnkLLvrMtrCtrlCmd Monr_TrnkLLvrMtrPWMCmd Monr_TrnkRLvrMtrCtrlCmd Monr_TrnkRLvrMtrPWMCmd /end REF_MEASUREMENT
/end GROUP
/begin GROUP Root_RDM_DetLeverMtrStallSt_Main_sys "RDM_DetLeverMtrStallSt/RDM_DetLeverMtrStallSt_Main_sys" /begin SUB_GROUP S3_For_Each_Subsystem /end SUB_GROUP /begin REF_CHARACTERISTIC CalEn_Debug_TrnkStlSt CalVal_Debug_TrnkStlSt /end REF_CHARACTERISTIC /begin REF_MEASUREMENT Monr_TrnkLLvrMtrStlSt Monr_TrnkRLvrMtrStlSt /end REF_MEASUREMENT /end GROUP
/begin GROUP Root_RDM_DetThermProtSt_Main_sys "RDM_DetThermProtSt/RDM_DetThermProtSt_Main_sys" /begin SUB_GROUP S3_Subsystem /end SUB_GROUP /begin REF_CHARACTERISTIC CalC_TrnkThermProtCfgEnable /end REF_CHARACTERISTIC /begin REF_MEASUREMENT Monr_TrnkThermProtCnt Monr_TrnkThermProtMd /end REF_MEASUREMENT /end GROUP
/begin GROUP Root_RDM_DetTrunkMoveReq_Main_sys "RDM_DetTrunkMoveReq/RDM_DetTrunkMoveReq_Main_sys"
 /begin SUB_GROUP S3_DetAutoInitExctCond S3_DetAutoInitPreCond S3_DetOpnStartStepTgtSpd S3_DetPWMRqst S3_RqstPreProcess /end SUB_GROUP
 /begin REF_CHARACTERISTIC CalC_Debug_TrnkGrOrSpdCond CalC_TrnkAPRevsMtrSpd CalC_TrnkClsManAsstMinPWM CalC_TrnkClsMtrNormSpd CalC_TrnkClsMtrStartSpd CalC_TrnkClsMtrStartTm CalC_TrnkClsMtrStopDist CalC_TrnkClsMtrStopSpd CalC_TrnkClsTmpSpd CalC_TrnkFullClsdTgtPos CalC_TrnkHalfClsDecPWM_pct CalC_TrnkHallZone_HalfClosed_H CalC_TrnkMinSftStpOpnHallPosOffset CalC_TrnkMtrPWMDwnLim CalC_TrnkMtrSlowStartCfg CalC_TrnkMtrSlowStopCfg CalC_TrnkMtrSpdCtrClsLpCfg CalC_TrnkNormMvHallPosTol CalC_TrnkOpnMtrBtmStartPosThr CalC_TrnkOpnMtrBtmStartTm_ms CalC_TrnkOpnMtrNormSpd CalC_TrnkOpnMtrStartSpd CalC_TrnkOpnMtrStartTm CalC_TrnkOpnMtrStopDist CalC_TrnkOpnMtrStopSpd CalC_TrnkOpnPawlSwOnWaitTm_ms CalC_TrnkPauseMtrStopDist CalC_hIPLGClsRvrsHall_cnt CalC_hIPLGOpenOnlyHall_cnt CalC_hIPLGOpenRvrsHall_cnt CalC_pctIPLGSpindleDtcy_pct CalC_tIPLGLatchRelsTimeout_ms CalC_tIPLGSpindleStpDly_ms CalEn_Debug_TrnkLatchSt CalVal_Debug_TrnkLatchSt Cal_SlopeCloseSpdPatch Cal_TempTrnkOpnMtrStartSpdAdd Cal_TrnkClsTmpThd /end REF_CHARACTERISTIC
 /begin REF_MEASUREMENT Monr_CurState Monr_TrnkLatchSt Monr_TrnkMtrSpdRqstAdjSt Monr_TrnkMvSrc Monr_TrnkMvSt Monr_TrnkMvTgtMtrSpd Monr_TrnkOpnUnlckLatchRqst /end REF_MEASUREMENT
/end GROUP
/begin GROUP Root_RDM_FITIn_Main_sys "RDM_FITIn/RDM_FITIn_Main_sys" /begin SUB_GROUP S2_Cal_RDM_FITIn /end SUB_GROUP /end GROUP
/begin GROUP Root_RDM_FITOut_Main_sys "POD_FITOut/RDM_FITOut_Main_sys" ROOT /begin SUB_GROUP S2_Subsystem /end SUB_GROUP /end GROUP
/begin GROUP Root_RDM_FITOut_Main_sys "RDM_FITOut/RDM_FITOut_Main_sys" ROOT /begin SUB_GROUP S2_FITOutCS /end SUB_GROUP /end GROUP
/begin GROUP Root_RDM_GetTrunkPos_Main_sys "RDM_GetTrunkPos/RDM_GetTrunkPos_Main_sys"
 /begin SUB_GROUP S3_AntiPinchHallBlockDivide S3_DetInitMode S3_DivideTrunkZone S3_LearnPos /end SUB_GROUP
 /begin REF_CHARACTERISTIC CalC_TrnkMtrOpnStartUpDist CalC_TrnkSftStpClsHallPos CalEn_Debug_TrnkLatchSt CalVal_Debug_TrnkLatchSt /end REF_CHARACTERISTIC
 /begin REF_MEASUREMENT Monr_TrnkCurBlockNum Monr_TrnkHrdOpnPos Monr_TrnkInitSt Monr_TrnkLLvrClsStartUpFlag Monr_TrnkLLvrCurPos Monr_TrnkLLvrOpnStartUpFlag Monr_TrnkMaxBlockNum Monr_TrnkMemMaxOpnPos Monr_TrnkNotInitRes Monr_TrnkRLvrCurPos /end REF_MEASUREMENT
/end GROUP
/begin GROUP Root_RDM_HallDeco_Main_sys "RDM_HallDeco/RDM_HallDeco_Main_sys"
 /begin SUB_GROUP S5_DetLvrHallErr S5_Hall_Based_Motor_Speed_Calculator S5_Subsystem /end SUB_GROUP
 /begin REF_CHARACTERISTIC CalC_TrnkRLvrCfgEnable /end REF_CHARACTERISTIC
 /begin REF_MEASUREMENT Monr_TrnkLLvrHall1Cnt Monr_TrnkLLvrHall1ErrSt Monr_TrnkLLvrHall2Cnt Monr_TrnkLLvrHall2ErrSt Monr_TrnkLLvrHallOffsetErrSt Monr_TrnkRLvrHall1Cnt Monr_TrnkRLvrHall1ErrSt Monr_TrnkRLvrHall2Cnt Monr_TrnkRLvrHall2ErrSt Monr_TrnkRLvrHallOffsetErrSt /end REF_MEASUREMENT
/end GROUP
/begin GROUP Root_RDM_LearnRF_Main_sys "RDM_LearnRF/RDM_LearnRF_Main_sys" /begin SUB_GROUP S3_Enabled_Subsystem2 S3_Subsystem /end SUB_GROUP /begin REF_MEASUREMENT Monr_TrnkClsApdAvgCurr Monr_TrnkCurRF Monr_TrnkRFTblVld /end REF_MEASUREMENT /end GROUP
/begin GROUP Root_RDM_SetSwSt_Main_sys "RDM_SetSwSt/RDM_SetSwSt_Main_sys" /begin SUB_GROUP S3_For_Each_Subsystem /end SUB_GROUP /begin REF_MEASUREMENT Monr_TrnkExtSwSt Monr_TrnkIntSwSt /end REF_MEASUREMENT /end GROUP
/begin GROUP Root_RDM_SOARx_Main_sys "RDM_SOARx/RDM_SOARx_Main_sys" /begin REF_MEASUREMENT Monr_SOASetTgateMemHtPos Monr_SOATgateMvtReq /end REF_MEASUREMENT /end GROUP
/begin GROUP Root_RDMLatch_DetMotorStall_Main_sys "RDMLatch_DetMotorStall/RDMLatch_DetMotorStall_Main_sys" /begin SUB_GROUP S3_MotTimesProtect1 /end SUB_GROUP
 /begin REF_CHARACTERISTIC CalC_CinchMotDriveTmMax_ms CalC_LatchMotStlMax_mA CalC_LatchMotStlMin_mA CalC_LatchMotStl_ms CalC_LatchNormCurr_mA CalC_LatchStlRels_ms CalC_UnlockMotDriveTmMax_ms /end REF_CHARACTERISTIC
/end GROUP
/begin GROUP Root_RDMLatch_FITIn_Main_sys "RDMLatch_FITIn/RDMLatch_FITIn_Main_sys" /begin SUB_GROUP S2_Cal_RDMLatch_FITIn /end SUB_GROUP /end GROUP
/begin GROUP Root_RDMLatch_FITOut_Main_sys "RDMLatch_FITOut/RDMLatch_FITOut_Main_sys"
 /begin REF_CHARACTERISTIC CalEn_FITOut_RDLockCtr CalEn_FITOut_RDLockPWMCmd CalEn_FITOut_RDUnLockCmd CalVal_FITOutRDLockCtr_ms CalVal_FITOut_RDLockCtr CalVal_FITOut_RDLockPWMCmd CalVal_FITOut_RDUnLockCmd /end REF_CHARACTERISTIC
 /begin REF_MEASUREMENT Monr_FITOut_RDLockCtr Monr_FITOut_RDLockPWMCmd Monr_FITOut_RDUnLockCtr /end REF_MEASUREMENT
/end GROUP
/begin GROUP Root_RDMLatch_SetCinchRelsCmd_Main_sys "RDMLatch_SetCinchRelsCmd/RDMLatch_SetCinchRelsCmd_Main_sys"
 /begin REF_CHARACTERISTIC CDD_CARTYPE_VEEA_MEB31_INLAND CDD_CARTYPE_VEEA_MY26_INLAND CalC_CinchMotDriveTmMax_ms CalC_CinchMotDriveTmMin_ms CalC_CinchStallReverse_ms CalC_DelayStartCinch_ms CalC_DelayStopCinRe_ms CalC_DelayStopCinchStall_ms CalC_DelayStopCinch_ms CalC_DelayStopForPawl_ms CalC_DelayStopForScond_ms CalC_DelayStopRelsRe_ms CalC_DelayUnlockRevs_ms CalC_LatchMotDynamicBrk_ms CalC_LatchStartUp_ms CalC_TrnkLatchCinchPWM CalC_TrnkLatchUnlckExitCurrThr_mA CalC_UnlockMotDriveTmMax_ms CalC_UnlockMotDriveTmMin_ms CalC_tIPLGLatchRvrsMax_ms CalEn_TrnkUnlckLatchReq CalVal_TrnkUnlckLatchReq /end REF_CHARACTERISTIC
/end GROUP
/begin GROUP Root_TZCUbody_DTC_Main_sys "TZCUbody_DTC/TZCUbody_DTC_Main_sys" /begin SUB_GROUP S2_TZCUBody_DTC_Main_sys /end SUB_GROUP /end GROUP
/begin GROUP S101_Time_Holding_Boolean "POD_AntiPinch/POD_AntiPinch/AntiPinch/AntiPinchR/Tip2RunAntiPinch/Time Holding Boolean" /begin SUB_GROUP S175_Signal_Holding_Boolean S175_Timer_Debounce /end SUB_GROUP /end GROUP
/begin GROUP S103_CloseDoor "POD_AntiPinch/POD_AntiPinch/AntiPinch/AntiPinchR/AntiPinchCurOffset/CurrentCmp/CloseDoor"
 /begin REF_CHARACTERISTIC k_ADP_Value_AmbTrawCOCCloseCurrentFactor k_ADP_Value_BatVoltageCOCCurrentCloseFactor /end REF_CHARACTERISTIC
/end GROUP
/begin GROUP S103_OpenDoor "POD_AntiPinch/POD_AntiPinch/AntiPinch/AntiPinchR/AntiPinchCurOffset/CurrentCmp/OpenDoor"
 /begin REF_CHARACTERISTIC k_ADP_Value_AmbTrawCOCCurrentFactor k_ADP_Value_BatVoltageCOCCurrentFactor /end REF_CHARACTERISTIC
/end GROUP
/begin GROUP S104_KeepReferenceCurrentFlag "POD_AntiPinch/POD_AntiPinch/AntiPinch/AntiPinchR/AntiPinchCurOffset/ReferenceCurrent/KeepReferenceCurrentFlag" /begin SUB_GROUP S109_ReferenceCurrentRes S109_ReferenceCurrentSet S109_RS /end SUB_GROUP /end GROUP
/begin GROUP S104_ReferenceCurrent "POD_AntiPinch/POD_AntiPinch/AntiPinch/AntiPinchR/AntiPinchCurOffset/ReferenceCurrent/ReferenceCurrent" /begin SUB_GROUP S110_Rising_Debounce /end SUB_GROUP /begin REF_CHARACTERISTIC k_ADP_Value_CurrentRefPositionforAntiPinch /end REF_CHARACTERISTIC /begin REF_MEASUREMENT monr_VfAP_ValueReferenceCurrentRAP_MA /end REF_MEASUREMENT /end GROUP
/begin GROUP S104_ReferenceCurrentCompensation "POD_AntiPinch/POD_AntiPinch/AntiPinch/AntiPinchR/AntiPinchCurOffset/ReferenceCurrent/ReferenceCurrentCompensation" /begin REF_CHARACTERISTIC k_ADP_Value_CurrentCompensateLimitMax /end REF_CHARACTERISTIC
 /begin REF_MEASUREMENT monr_VfAP_ValueBrkgCompenRAP_MA monr_VfAP_ValueReferenceCurrentCmpRAP_MA monr_VfAP_ValueSlopeCompenRAP_MA /end REF_MEASUREMENT
/end GROUP
/begin GROUP S105_CloseDoor "POD_AntiPinch/POD_AntiPinch/AntiPinch/AntiPinchR/AntiPinchCurOffset/SectorCompensation/CloseDoor"
 /begin REF_CHARACTERISTIC k_ADP_Value_CurrentLimitClose k_ADP_Value_CurrentLimitMinPntClose k_ADP_Value_CurrentRefPositionforAntiPinch /end REF_CHARACTERISTIC
/end GROUP
/begin GROUP S105_OpenDoor "POD_AntiPinch/POD_AntiPinch/AntiPinch/AntiPinchR/AntiPinchCurOffset/SectorCompensation/OpenDoor" /begin REF_CHARACTERISTIC k_ADP_Value_CurrentLimitOpen /end REF_CHARACTERISTIC /end GROUP
/begin GROUP S108_Rising_Debounce "POD_HallHandleModule_TZCU/POD_HallHandleModule/HallHandleModule/HallHandleModuleL/DoorMovSts/ManualMov/PerManualMovDoor/Rising Debounce" /begin REF_CHARACTERISTIC k_HHM_Ti_SequenceTime k_HHM_Ti_TimeManualDoorCloseMovSts /end REF_CHARACTERISTIC /end GROUP
/begin GROUP S108_Rising_Debounce1 "POD_HallHandleModule_TZCU/POD_HallHandleModule/HallHandleModule/HallHandleModuleL/DoorMovSts/ManualMov/PerManualMovDoor/Rising Debounce1" /begin REF_CHARACTERISTIC k_HHM_Ti_SequenceTime k_HHM_Ti_TimeManualDoorOpenMovSts /end REF_CHARACTERISTIC /end GROUP
/begin GROUP S108_Rising_Debounce2 "POD_HallHandleModule_TZCU/POD_HallHandleModule/HallHandleModule/HallHandleModuleL/DoorMovSts/ManualMov/PerManualMovDoor/Rising Debounce2" /begin REF_CHARACTERISTIC k_HHM_Ti_SequenceTime k_HHM_Ti_TimeManualDoorOpenMovSts /end REF_CHARACTERISTIC /end GROUP
/begin GROUP S108_Rising_Debounce3 "POD_HallHandleModule_TZCU/POD_HallHandleModule/HallHandleModule/HallHandleModuleL/DoorMovSts/ManualMov/PerManualMovDoor/Rising Debounce3" /begin REF_CHARACTERISTIC k_HHM_Ti_SequenceTime k_HHM_Ti_TimeManualDoorCloseMovSts /end REF_CHARACTERISTIC /end GROUP
/begin GROUP S109_DetLvrPos "RDM_GetTrunkPos/RDM_GetTrunkPos_Main_sys/LearnPos/DetLvrPos/DetLvrPos" /begin SUB_GROUP S124_CalPos S124_DetVldStlHallPosRange /end SUB_GROUP /end GROUP
/begin GROUP S109_ReferenceCurrentRes "POD_AntiPinch/POD_AntiPinch/AntiPinch/AntiPinchR/AntiPinchCurOffset/ReferenceCurrent/KeepReferenceCurrentFlag/ReferenceCurrentRes" /begin SUB_GROUP S113_Rising_Debounce1 /end SUB_GROUP /begin REF_MEASUREMENT monr_VbAP_ReferenceCurrentResRAP_flg /end REF_MEASUREMENT /end GROUP
/begin GROUP S110_Subsystem "RDM_GetTrunkPos/RDM_GetTrunkPos_Main_sys/LearnPos/DetSftStpOpnHallPos/Subsystem" /begin REF_CHARACTERISTIC CalC_Debug_TrnkGrOrSpdCond CalC_TrnkNormMvHallPosTol /end REF_CHARACTERISTIC /end GROUP
/begin GROUP S133_HallSpeedJudge "POD_HallHandleModule_TZCU/POD_HallHandleModule/HallHandleModule/HallHandleModuleL/HallCntrHandle/HallSpeed/HallSpeedJudge" /begin REF_CHARACTERISTIC k_HHM_Ti_SequenceTime /end REF_CHARACTERISTIC /end GROUP
/begin GROUP S134_Rising_Debounce "POD_HallHandleModule_TZCU/POD_HallHandleModule/HallHandleModule/HallHandleModuleL/HallCntrHandle/HallPosition/ASWHallInit/Rising Debounce" /begin REF_CHARACTERISTIC k_HHM_Ti_SequenceTime /end REF_CHARACTERISTIC /end GROUP
/begin GROUP S134_Timer_Debounce "POD_HallHandleModule_TZCU/POD_HallHandleModule/HallHandleModule/HallHandleModuleL/HallCntrHandle/HallPosition/ASWHallInit/Timer Debounce" /begin REF_CHARACTERISTIC k_HHM_Ti_SequenceTime /end REF_CHARACTERISTIC /end GROUP
/begin GROUP S152_Rising_Debounce1 "POD_HallHandleModule_TZCU/POD_HallHandleModule/HallHandleModule/HallHandleModuleL/HallCntrHandle/HallPosition/HallInitialization/LckState/Rising Debounce1" /begin REF_CHARACTERISTIC k_HHM_Ti_SequenceTime /end REF_CHARACTERISTIC /end GROUP
/begin GROUP S15_CloseDoor "POD_AntiPinch/POD_AntiPinch/AntiPinch/AntiPinchL/AntiPinchCurOffset/CurrentCmp/CloseDoor"
 /begin REF_CHARACTERISTIC k_ADP_Value_AmbTrawCOCCloseCurrentFactor k_ADP_Value_BatVoltageCOCCurrentCloseFactor /end REF_CHARACTERISTIC
/end GROUP
/begin GROUP S15_OpenDoor "POD_AntiPinch/POD_AntiPinch/AntiPinch/AntiPinchL/AntiPinchCurOffset/CurrentCmp/OpenDoor"
 /begin REF_CHARACTERISTIC k_ADP_Value_AmbTrawCOCCurrentFactor k_ADP_Value_BatVoltageCOCCurrentFactor /end REF_CHARACTERISTIC
/end GROUP
/begin GROUP S167_Rising_Debounce1 "POD_HallHandleModule_TZCU/POD_HallHandleModule/HallHandleModule/HallHandleModuleL/HallCntrHandle/HallSpeed/HallFixedTiOffset/Rising Debounce1" /begin REF_CHARACTERISTIC k_HHM_Ti_SequenceTime /end REF_CHARACTERISTIC /end GROUP
/begin GROUP S16_ReferenceCurrent "POD_AntiPinch/POD_AntiPinch/AntiPinch/AntiPinchL/AntiPinchCurOffset/ReferenceCurrent/ReferenceCurrent" /begin REF_CHARACTERISTIC k_ADP_Value_CurrentRefPositionforAntiPinch /end REF_CHARACTERISTIC /end GROUP
/begin GROUP S16_ReferenceCurrentCompensation "POD_AntiPinch/POD_AntiPinch/AntiPinch/AntiPinchL/AntiPinchCurOffset/ReferenceCurrent/ReferenceCurrentCompensation" /begin REF_CHARACTERISTIC k_ADP_Value_CurrentCompensateLimitMax /end REF_CHARACTERISTIC /end GROUP
/begin GROUP S176_Rising_Debounce "POD_HallHandleModule_TZCU/POD_HallHandleModule/HallHandleModule/HallHandleModuleL/HallErrorProcess/HALL_AFault/Rising Debounce" /begin REF_CHARACTERISTIC k_HHM_Ti_SequenceTime /end REF_CHARACTERISTIC /end GROUP
/begin GROUP S176_Rising_Debounce1 "POD_HallHandleModule_TZCU/POD_HallHandleModule/HallHandleModule/HallHandleModuleL/HallErrorProcess/HALL_AFault/Rising Debounce1" /begin REF_CHARACTERISTIC k_HHM_Ti_SequenceTime /end REF_CHARACTERISTIC /end GROUP
/begin GROUP S176_Rising_Debounce2 "POD_HallHandleModule_TZCU/POD_HallHandleModule/HallHandleModule/HallHandleModuleL/HallErrorProcess/HALL_AFault/Rising Debounce2" /begin REF_CHARACTERISTIC k_HHM_Ti_SequenceTime /end REF_CHARACTERISTIC /end GROUP
/begin GROUP S176_Rising_Debounce3 "POD_HallHandleModule_TZCU/POD_HallHandleModule/HallHandleModule/HallHandleModuleL/HallErrorProcess/HALL_AFault/Rising Debounce3" /begin REF_CHARACTERISTIC k_HHM_Ti_SequenceTime /end REF_CHARACTERISTIC /end GROUP
/begin GROUP S177_Falling_Debounce "POD_HallHandleModule_TZCU/POD_HallHandleModule/HallHandleModule/HallHandleModuleL/HallErrorProcess/HALL_BFault/Falling Debounce" /begin REF_CHARACTERISTIC k_HHM_Ti_SequenceTime /end REF_CHARACTERISTIC /end GROUP
/begin GROUP S177_Falling_Debounce1 "POD_HallHandleModule_TZCU/POD_HallHandleModule/HallHandleModule/HallHandleModuleL/HallErrorProcess/HALL_BFault/Falling Debounce1" /begin REF_CHARACTERISTIC k_HHM_Ti_SequenceTime /end REF_CHARACTERISTIC /end GROUP
/begin GROUP S177_Rising_Debounce "POD_HallHandleModule_TZCU/POD_HallHandleModule/HallHandleModule/HallHandleModuleL/HallErrorProcess/HALL_BFault/Rising Debounce" /begin REF_CHARACTERISTIC k_HHM_Ti_SequenceTime /end REF_CHARACTERISTIC /end GROUP
/begin GROUP S177_Rising_Debounce1 "POD_HallHandleModule_TZCU/POD_HallHandleModule/HallHandleModule/HallHandleModuleL/HallErrorProcess/HALL_BFault/Rising Debounce1" /begin REF_CHARACTERISTIC k_HHM_Ti_SequenceTime /end REF_CHARACTERISTIC /end GROUP
/begin GROUP S177_Rising_Debounce2 "POD_HallHandleModule_TZCU/POD_HallHandleModule/HallHandleModule/HallHandleModuleL/HallErrorProcess/HALL_BFault/Rising Debounce2" /begin REF_CHARACTERISTIC k_HHM_Ti_SequenceTime /end REF_CHARACTERISTIC /end GROUP
/begin GROUP S177_Rising_Debounce3 "POD_HallHandleModule_TZCU/POD_HallHandleModule/HallHandleModule/HallHandleModuleL/HallErrorProcess/HALL_BFault/Rising Debounce3" /begin REF_CHARACTERISTIC k_HHM_Ti_SequenceTime /end REF_CHARACTERISTIC /end GROUP
/begin GROUP S177_Rising_Debounce4 "POD_HallHandleModule_TZCU/POD_HallHandleModule/HallHandleModule/HallHandleModuleL/HallErrorProcess/HALL_BFault/Rising Debounce4" /begin REF_CHARACTERISTIC k_HHM_Ti_SequenceTime /end REF_CHARACTERISTIC /end GROUP
/begin GROUP S177_Rising_Debounce5 "POD_HallHandleModule_TZCU/POD_HallHandleModule/HallHandleModule/HallHandleModuleL/HallErrorProcess/HALL_BFault/Rising Debounce5" /begin REF_CHARACTERISTIC k_HHM_Ti_SequenceTime /end REF_CHARACTERISTIC /end GROUP
/begin GROUP S177_Rising_Debounce6 "POD_HallHandleModule_TZCU/POD_HallHandleModule/HallHandleModule/HallHandleModuleL/HallErrorProcess/HALL_BFault/Rising Debounce6" /begin REF_CHARACTERISTIC k_HHM_Ti_SequenceTime /end REF_CHARACTERISTIC /end GROUP
/begin GROUP S177_Rising_Debounce7 "POD_HallHandleModule_TZCU/POD_HallHandleModule/HallHandleModule/HallHandleModuleL/HallErrorProcess/HALL_BFault/Rising Debounce7" /begin REF_CHARACTERISTIC k_HHM_Ti_SequenceTime /end REF_CHARACTERISTIC /end GROUP
/begin GROUP S178_Rising_Debounce "POD_HallHandleModule_TZCU/POD_HallHandleModule/HallHandleModule/HallHandleModuleL/HallErrorProcess/HallJudgeCondition/Rising Debounce" /begin REF_CHARACTERISTIC k_HHM_Ti_SequenceTime /end REF_CHARACTERISTIC /end GROUP
/begin GROUP S178_Rising_Debounce1 "POD_HallHandleModule_TZCU/POD_HallHandleModule/HallHandleModule/HallHandleModuleL/HallErrorProcess/HallJudgeCondition/Rising Debounce1" /begin REF_CHARACTERISTIC k_HHM_Ti_SequenceTime /end REF_CHARACTERISTIC /end GROUP
/begin GROUP S17_CloseDoor "POD_AntiPinch/POD_AntiPinch/AntiPinch/AntiPinchL/AntiPinchCurOffset/SectorCompensation/CloseDoor"
 /begin REF_CHARACTERISTIC k_ADP_Value_CurrentLimitClose k_ADP_Value_CurrentLimitMinPntClose k_ADP_Value_CurrentRefPositionforAntiPinch /end REF_CHARACTERISTIC
/end GROUP
/begin GROUP S17_OpenDoor "POD_AntiPinch/POD_AntiPinch/AntiPinch/AntiPinchL/AntiPinchCurOffset/SectorCompensation/OpenDoor" /begin REF_CHARACTERISTIC k_ADP_Value_CurrentLimitOpen /end REF_CHARACTERISTIC /end GROUP
/begin GROUP S180_Rising_Debounce2 "POD_HallHandleModule_TZCU/POD_HallHandleModule/HallHandleModule/HallHandleModuleL/HallErrorProcess/SenorErr_Reset/Rising Debounce2" /begin REF_CHARACTERISTIC k_HHM_Ti_SequenceTime /end REF_CHARACTERISTIC /end GROUP
/begin GROUP S19_DetClsPWMLim "RDM_DetTrunkMoveReq/RDM_DetTrunkMoveReq_Main_sys/DetPWMRqst/DetClsPWMLim" /begin REF_CHARACTERISTIC CalC_TrnkClsManAsstMinPWM CalC_TrnkMtrPWMDwnLim /end REF_CHARACTERISTIC /end GROUP
/begin GROUP S242_Rising_Debounce1 "POD_HallHandleModule_TZCU/POD_HallHandleModule/HallHandleModule/HallHandleModuleL/HallErrorProcess/SenorErr_Reset/MovReset/Rising Debounce1" /begin REF_CHARACTERISTIC k_HHM_Ti_SequenceTime /end REF_CHARACTERISTIC /end GROUP
/begin GROUP S257_Rising_Debounce "POD_HallHandleModule_TZCU/POD_HallHandleModule/HallHandleModule/HallHandleModuleR/AngleConversion/DoorOpenTargetPosition/Rising Debounce" /begin REF_CHARACTERISTIC k_HHM_Ti_SequenceTime /end REF_CHARACTERISTIC /end GROUP
/begin GROUP S273_ManualDoorStop "POD_HallHandleModule_TZCU/POD_HallHandleModule/HallHandleModule/HallHandleModuleR/DoorMovSts/Hold/ManualDoorStop" /begin REF_CHARACTERISTIC k_HHM_Ti_SequenceTime /end REF_CHARACTERISTIC /end GROUP
/begin GROUP S279_Rising_Debounce "POD_HallHandleModule_TZCU/POD_HallHandleModule/HallHandleModule/HallHandleModuleR/DoorMovSts/Hold/ClosingInLock/Rising Debounce" /begin REF_CHARACTERISTIC k_HHM_Ti_SequenceTime /end REF_CHARACTERISTIC /end GROUP
/begin GROUP S280_Rising_Debounce "POD_HallHandleModule_TZCU/POD_HallHandleModule/HallHandleModule/HallHandleModuleR/DoorMovSts/Hold/DooStop/Rising Debounce" /begin REF_CHARACTERISTIC k_HHM_Ti_SequenceTime /end REF_CHARACTERISTIC /end GROUP
/begin GROUP S280_Rising_Debounce1 "POD_HallHandleModule_TZCU/POD_HallHandleModule/HallHandleModule/HallHandleModuleR/DoorMovSts/Hold/DooStop/Rising Debounce1" /begin REF_CHARACTERISTIC k_HHM_Ti_SequenceTime /end REF_CHARACTERISTIC /end GROUP
/begin GROUP S281_Rising_Debounce4 "POD_HallHandleModule_TZCU/POD_HallHandleModule/HallHandleModule/HallHandleModuleR/DoorMovSts/Hold/DoorStateErrorJudge/Rising Debounce4" /begin REF_CHARACTERISTIC k_HHM_Ti_SequenceTime /end REF_CHARACTERISTIC /end GROUP
/begin GROUP S282_Rising_Debounce "POD_HallHandleModule_TZCU/POD_HallHandleModule/HallHandleModule/HallHandleModuleR/DoorMovSts/Hold/ElecDoorStop/Rising Debounce" ROOT /begin REF_CHARACTERISTIC k_HHM_Ti_SequenceTime /end REF_CHARACTERISTIC /end GROUP
/begin GROUP S307_Rising_Debounce "POD_HallHandleModule_TZCU/POD_HallHandleModule/HallHandleModule/HallHandleModuleR/DoorMovSts/ManualMov/PerManualMovDoor/Rising Debounce" /begin REF_CHARACTERISTIC k_HHM_Ti_SequenceTime k_HHM_Ti_TimeManualDoorCloseMovSts /end REF_CHARACTERISTIC /end GROUP
/begin GROUP S307_Rising_Debounce1 "POD_HallHandleModule_TZCU/POD_HallHandleModule/HallHandleModule/HallHandleModuleR/DoorMovSts/ManualMov/PerManualMovDoor/Rising Debounce1" /begin REF_CHARACTERISTIC k_HHM_Ti_SequenceTime k_HHM_Ti_TimeManualDoorOpenMovSts /end REF_CHARACTERISTIC /end GROUP
/begin GROUP S307_Rising_Debounce2 "POD_HallHandleModule_TZCU/POD_HallHandleModule/HallHandleModule/HallHandleModuleR/DoorMovSts/ManualMov/PerManualMovDoor/Rising Debounce2" /begin REF_CHARACTERISTIC k_HHM_Ti_SequenceTime k_HHM_Ti_TimeManualDoorOpenMovSts /end REF_CHARACTERISTIC /end GROUP
/begin GROUP S307_Rising_Debounce3 "POD_HallHandleModule_TZCU/POD_HallHandleModule/HallHandleModule/HallHandleModuleR/DoorMovSts/ManualMov/PerManualMovDoor/Rising Debounce3" /begin REF_CHARACTERISTIC k_HHM_Ti_SequenceTime k_HHM_Ti_TimeManualDoorCloseMovSts /end REF_CHARACTERISTIC /end GROUP
/begin GROUP S30_Subsystem1 "RDM_AntiPinch/RDM_AntiPinch_Main_sys/Subsystem3/Subsystem1" /begin REF_CHARACTERISTIC CalC_TrnkClsMtrStopDist CalC_TrnkHallZone_HalfClosed_H /end REF_CHARACTERISTIC /end GROUP
/begin GROUP S332_HallSpeedJudge "POD_HallHandleModule_TZCU/POD_HallHandleModule/HallHandleModule/HallHandleModuleR/HallCntrHandle/HallSpeed/HallSpeedJudge" /begin REF_CHARACTERISTIC k_HHM_Ti_SequenceTime /end REF_CHARACTERISTIC /end GROUP
/begin GROUP S333_Rising_Debounce "POD_HallHandleModule_TZCU/POD_HallHandleModule/HallHandleModule/HallHandleModuleR/HallCntrHandle/HallPosition/ASWHallInit/Rising Debounce" /begin REF_CHARACTERISTIC k_HHM_Ti_SequenceTime /end REF_CHARACTERISTIC /end GROUP
/begin GROUP S333_Timer_Debounce "POD_HallHandleModule_TZCU/POD_HallHandleModule/HallHandleModule/HallHandleModuleR/HallCntrHandle/HallPosition/ASWHallInit/Timer Debounce" /begin REF_CHARACTERISTIC k_HHM_Ti_SequenceTime /end REF_CHARACTERISTIC /end GROUP
/begin GROUP S351_Rising_Debounce1 "POD_HallHandleModule_TZCU/POD_HallHandleModule/HallHandleModule/HallHandleModuleR/HallCntrHandle/HallPosition/HallInitialization/LckState/Rising Debounce1" /begin REF_CHARACTERISTIC k_HHM_Ti_SequenceTime /end REF_CHARACTERISTIC /end GROUP
/begin GROUP S366_Rising_Debounce1 "POD_HallHandleModule_TZCU/POD_HallHandleModule/HallHandleModule/HallHandleModuleR/HallCntrHandle/HallSpeed/HallFixedTiOffset/Rising Debounce1" /begin REF_CHARACTERISTIC k_HHM_Ti_SequenceTime /end REF_CHARACTERISTIC /end GROUP
/begin GROUP S375_Rising_Debounce "POD_HallHandleModule_TZCU/POD_HallHandleModule/HallHandleModule/HallHandleModuleR/HallErrorProcess/HALL_AFault/Rising Debounce" /begin REF_CHARACTERISTIC k_HHM_Ti_SequenceTime /end REF_CHARACTERISTIC /end GROUP
/begin GROUP S375_Rising_Debounce1 "POD_HallHandleModule_TZCU/POD_HallHandleModule/HallHandleModule/HallHandleModuleR/HallErrorProcess/HALL_AFault/Rising Debounce1" /begin REF_CHARACTERISTIC k_HHM_Ti_SequenceTime /end REF_CHARACTERISTIC /end GROUP
/begin GROUP S375_Rising_Debounce2 "POD_HallHandleModule_TZCU/POD_HallHandleModule/HallHandleModule/HallHandleModuleR/HallErrorProcess/HALL_AFault/Rising Debounce2" /begin REF_CHARACTERISTIC k_HHM_Ti_SequenceTime /end REF_CHARACTERISTIC /end GROUP
/begin GROUP S375_Rising_Debounce3 "POD_HallHandleModule_TZCU/POD_HallHandleModule/HallHandleModule/HallHandleModuleR/HallErrorProcess/HALL_AFault/Rising Debounce3" /begin REF_CHARACTERISTIC k_HHM_Ti_SequenceTime /end REF_CHARACTERISTIC /end GROUP
/begin GROUP S376_Falling_Debounce "POD_HallHandleModule_TZCU/POD_HallHandleModule/HallHandleModule/HallHandleModuleR/HallErrorProcess/HALL_BFault/Falling Debounce" /begin REF_CHARACTERISTIC k_HHM_Ti_SequenceTime /end REF_CHARACTERISTIC /end GROUP
/begin GROUP S376_Falling_Debounce1 "POD_HallHandleModule_TZCU/POD_HallHandleModule/HallHandleModule/HallHandleModuleR/HallErrorProcess/HALL_BFault/Falling Debounce1" /begin REF_CHARACTERISTIC k_HHM_Ti_SequenceTime /end REF_CHARACTERISTIC /end GROUP
/begin GROUP S376_Rising_Debounce "POD_HallHandleModule_TZCU/POD_HallHandleModule/HallHandleModule/HallHandleModuleR/HallErrorProcess/HALL_BFault/Rising Debounce" /begin REF_CHARACTERISTIC k_HHM_Ti_SequenceTime /end REF_CHARACTERISTIC /end GROUP
/begin GROUP S376_Rising_Debounce1 "POD_HallHandleModule_TZCU/POD_HallHandleModule/HallHandleModule/HallHandleModuleR/HallErrorProcess/HALL_BFault/Rising Debounce1" /begin REF_CHARACTERISTIC k_HHM_Ti_SequenceTime /end REF_CHARACTERISTIC /end GROUP
/begin GROUP S376_Rising_Debounce2 "POD_HallHandleModule_TZCU/POD_HallHandleModule/HallHandleModule/HallHandleModuleR/HallErrorProcess/HALL_BFault/Rising Debounce2" /begin REF_CHARACTERISTIC k_HHM_Ti_SequenceTime /end REF_CHARACTERISTIC /end GROUP
/begin GROUP S376_Rising_Debounce3 "POD_HallHandleModule_TZCU/POD_HallHandleModule/HallHandleModule/HallHandleModuleR/HallErrorProcess/HALL_BFault/Rising Debounce3" /begin REF_CHARACTERISTIC k_HHM_Ti_SequenceTime /end REF_CHARACTERISTIC /end GROUP
/begin GROUP S376_Rising_Debounce4 "POD_HallHandleModule_TZCU/POD_HallHandleModule/HallHandleModule/HallHandleModuleR/HallErrorProcess/HALL_BFault/Rising Debounce4" /begin REF_CHARACTERISTIC k_HHM_Ti_SequenceTime /end REF_CHARACTERISTIC /end GROUP
/begin GROUP S376_Rising_Debounce5 "POD_HallHandleModule_TZCU/POD_HallHandleModule/HallHandleModule/HallHandleModuleR/HallErrorProcess/HALL_BFault/Rising Debounce5" /begin REF_CHARACTERISTIC k_HHM_Ti_SequenceTime /end REF_CHARACTERISTIC /end GROUP
/begin GROUP S376_Rising_Debounce6 "POD_HallHandleModule_TZCU/POD_HallHandleModule/HallHandleModule/HallHandleModuleR/HallErrorProcess/HALL_BFault/Rising Debounce6" /begin REF_CHARACTERISTIC k_HHM_Ti_SequenceTime /end REF_CHARACTERISTIC /end GROUP
/begin GROUP S376_Rising_Debounce7 "POD_HallHandleModule_TZCU/POD_HallHandleModule/HallHandleModule/HallHandleModuleR/HallErrorProcess/HALL_BFault/Rising Debounce7" /begin REF_CHARACTERISTIC k_HHM_Ti_SequenceTime /end REF_CHARACTERISTIC /end GROUP
/begin GROUP S377_Rising_Debounce "POD_HallHandleModule_TZCU/POD_HallHandleModule/HallHandleModule/HallHandleModuleR/HallErrorProcess/HallJudgeCondition/Rising Debounce" /begin REF_CHARACTERISTIC k_HHM_Ti_SequenceTime /end REF_CHARACTERISTIC /end GROUP
/begin GROUP S377_Rising_Debounce1 "POD_HallHandleModule_TZCU/POD_HallHandleModule/HallHandleModule/HallHandleModuleR/HallErrorProcess/HallJudgeCondition/Rising Debounce1" /begin REF_CHARACTERISTIC k_HHM_Ti_SequenceTime /end REF_CHARACTERISTIC /end GROUP
/begin GROUP S379_Rising_Debounce2 "POD_HallHandleModule_TZCU/POD_HallHandleModule/HallHandleModule/HallHandleModuleR/HallErrorProcess/SenorErr_Reset/Rising Debounce2" /begin REF_CHARACTERISTIC k_HHM_Ti_SequenceTime /end REF_CHARACTERISTIC /end GROUP
/begin GROUP S3_DetAutoInitPreCond "RDM_DetTrunkMoveReq/RDM_DetTrunkMoveReq_Main_sys/DetAutoInitPreCond" /begin REF_CHARACTERISTIC CalC_hIPLGOpenOnlyHall_cnt /end REF_CHARACTERISTIC /end GROUP
/begin GROUP S3_DetOpnStartStepTgtSpd "RDM_DetTrunkMoveReq/RDM_DetTrunkMoveReq_Main_sys/DetOpnStartStepTgtSpd" /begin REF_CHARACTERISTIC CalC_TrnkOpnMtrNormSpd /end REF_CHARACTERISTIC /end GROUP
/begin GROUP S3_DetPWMRqst "RDM_DetTrunkMoveReq/RDM_DetTrunkMoveReq_Main_sys/DetPWMRqst" /begin REF_CHARACTERISTIC CalC_TrnkMtrPWMDwnLim CalC_TrnkMtrSpdCtrClsLpCfg /end REF_CHARACTERISTIC /end GROUP
/begin GROUP S3_DetStallStopCond "RDM_CtrlLeverMtr/RDM_CtrlLeverMtr_Main_sys/DetStallStopCond" /begin REF_CHARACTERISTIC CalC_TrnkRLvrCfgEnable /end REF_CHARACTERISTIC /end GROUP
/begin GROUP S3_SendCurAPThr "RDM_AntiPinch/RDM_AntiPinch_Main_sys/SendCurAPThr" /begin REF_CHARACTERISTIC CalC_TrnkClsTraceAPMtrSpdThr /end REF_CHARACTERISTIC /end GROUP
/begin GROUP S3_Subsystem "RDM_LearnRF/RDM_LearnRF_Main_sys/Subsystem" ROOT /begin REF_CHARACTERISTIC CalC_Debug_TrnkGrOrSpdCond /end REF_CHARACTERISTIC /end GROUP
/begin GROUP S441_Rising_Debounce1 "POD_HallHandleModule_TZCU/POD_HallHandleModule/HallHandleModule/HallHandleModuleR/HallErrorProcess/SenorErr_Reset/MovReset/Rising Debounce1" /begin REF_CHARACTERISTIC k_HHM_Ti_SequenceTime /end REF_CHARACTERISTIC /end GROUP
/begin GROUP S58_Rising_Debounce "POD_HallHandleModule_TZCU/POD_HallHandleModule/HallHandleModule/HallHandleModuleL/AngleConversion/DoorOpenTargetPosition/Rising Debounce" /begin REF_CHARACTERISTIC k_HHM_Ti_SequenceTime /end REF_CHARACTERISTIC /end GROUP
/begin GROUP S74_ManualDoorStop "POD_HallHandleModule_TZCU/POD_HallHandleModule/HallHandleModule/HallHandleModuleL/DoorMovSts/Hold/ManualDoorStop" /begin REF_CHARACTERISTIC k_HHM_Ti_SequenceTime /end REF_CHARACTERISTIC /end GROUP
/begin GROUP S7_AntiPinchConditions_Current "POD_AntiPinch/POD_AntiPinch/AntiPinch/AntiPinchL/AntiPinchTrig/AntiPinchConditions_Current" /begin REF_CHARACTERISTIC k_ADP_Value_CurrentRefPositionforAntiPinch /end REF_CHARACTERISTIC /end GROUP
/begin GROUP S80_Rising_Debounce "POD_HallHandleModule_TZCU/POD_HallHandleModule/HallHandleModule/HallHandleModuleL/DoorMovSts/Hold/ClosingInLock/Rising Debounce" /begin REF_CHARACTERISTIC k_HHM_Ti_SequenceTime /end REF_CHARACTERISTIC /end GROUP
/begin GROUP S81_Rising_Debounce "POD_HallHandleModule_TZCU/POD_HallHandleModule/HallHandleModule/HallHandleModuleL/DoorMovSts/Hold/DooStop/Rising Debounce" /begin REF_CHARACTERISTIC k_HHM_Ti_SequenceTime /end REF_CHARACTERISTIC /end GROUP
/begin GROUP S81_Rising_Debounce1 "POD_HallHandleModule_TZCU/POD_HallHandleModule/HallHandleModule/HallHandleModuleL/DoorMovSts/Hold/DooStop/Rising Debounce1" /begin REF_CHARACTERISTIC k_HHM_Ti_SequenceTime /end REF_CHARACTERISTIC /end GROUP
/begin GROUP S82_Rising_Debounce4 "POD_HallHandleModule_TZCU/POD_HallHandleModule/HallHandleModule/HallHandleModuleL/DoorMovSts/Hold/DoorStateErrorJudge/Rising Debounce4" /begin REF_CHARACTERISTIC k_HHM_Ti_SequenceTime /end REF_CHARACTERISTIC /end GROUP
/begin GROUP S83_Rising_Debounce "POD_HallHandleModule_TZCU/POD_HallHandleModule/HallHandleModule/HallHandleModuleL/DoorMovSts/Hold/ElecDoorStop/Rising Debounce" /begin REF_CHARACTERISTIC k_HHM_Ti_SequenceTime /end REF_CHARACTERISTIC /end GROUP
/begin GROUP S8_DetPct "RDM_GetTrunkPos/RDM_GetTrunkPos_Main_sys/DivideTrunkZone/DetPct" /begin REF_CHARACTERISTIC CalC_TrnkMinSftStpOpnHallPosOffset /end REF_CHARACTERISTIC /end GROUP
/begin GROUP S8_DetPosZone "RDM_GetTrunkPos/RDM_GetTrunkPos_Main_sys/DivideTrunkZone/DetPosZone" /begin REF_CHARACTERISTIC CalC_hIPLGOpenOnlyHall_cnt /end REF_CHARACTERISTIC /end GROUP
/begin GROUP S95_AntiPinchConditions_Current "POD_AntiPinch/POD_AntiPinch/AntiPinch/AntiPinchR/AntiPinchTrig/AntiPinchConditions_Current" /begin REF_CHARACTERISTIC k_ADP_Value_CurrentRefPositionforAntiPinch /end REF_CHARACTERISTIC /end GROUP
/begin GROUP S9_DetSftStpOpnHallPos "RDM_GetTrunkPos/RDM_GetTrunkPos_Main_sys/LearnPos/DetSftStpOpnHallPos" /begin REF_CHARACTERISTIC CalC_TrnkMinSftStpOpnHallPosOffset /end REF_CHARACTERISTIC /end GROUP
/begin RECORD_LAYOUT Array_UBYTE FNC_VALUES 1 UBYTE COLUMN_DIR DIRECT /end RECORD_LAYOUT
/begin RECORD_LAYOUT Record_FLOAT32_IEEE FNC_VALUES 1 FLOAT32_IEEE COLUMN_DIR DIRECT /end RECORD_LAYOUT
/begin RECORD_LAYOUT RL.FNC.FLOAT32_IEEE.ROW_DIR FNC_VALUES 1 FLOAT32_IEEE ROW_DIR DIRECT /end RECORD_LAYOUT
/begin RECORD_LAYOUT Scalar_FLOAT32_IEEE FNC_VALUES 1 FLOAT32_IEEE COLUMN_DIR DIRECT /end RECORD_LAYOUT
/begin RECORD_LAYOUT Scalar_SBYTE FNC_VALUES 1 SBYTE COLUMN_DIR DIRECT /end RECORD_LAYOUT
/begin RECORD_LAYOUT Scalar_SLONG FNC_VALUES 1 SLONG COLUMN_DIR DIRECT /end RECORD_LAYOUT
/begin RECORD_LAYOUT Scalar_SWORD FNC_VALUES 1 SWORD COLUMN_DIR DIRECT /end RECORD_LAYOUT
/begin RECORD_LAYOUT Scalar_UBYTE FNC_VALUES 1 UBYTE COLUMN_DIR DIRECT /end RECORD_LAYOUT
/begin RECORD_LAYOUT Scalar_UWORD FNC_VALUES 1 UWORD COLUMN_DIR DIRECT /end RECORD_LAYOUT
/end MODULE
/end PROJECT
