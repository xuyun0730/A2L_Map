ASAP2_VERSION 1 70
/begin PROJECT ProjectName "CARIAD XCP On CAN"
/begin MODULE ZCU "this is a module for XCP A2l"
/begin MOD_COMMON "" BYTE_ORDER MSB_LAST ALIGNMENT_BYTE 1 ALIGNMENT_WORD 2 ALIGNMENT_LONG 4 ALIGNMENT_INT64 8 ALIGNMENT_FLOAT32_IEEE 4 ALIGNMENT_FLOAT64_IEEE 8 /end MOD_COMMON
/begin COMPU_METHOD POD_AntiPinch_CM_boolean "Q = V" IDENTICAL "%1.0" "" /end COMPU_METHOD
/begin COMPU_METHOD POD_AntiPinch_CM_single "Q = V" IDENTICAL "%8.6" "" /end COMPU_METHOD
/begin COMPU_METHOD POD_FaultHandle_CM_boolean "Q = V" IDENTICAL "%1.0" "" /end COMPU_METHOD
/begin COMPU_METHOD POD_FaultHandle_CM_int16 "Q = V" IDENTICAL "%5.0" "" /end COMPU_METHOD
/begin COMPU_METHOD POD_FaultHandle_CM_single "Q = V" IDENTICAL "%8.6" "" /end COMPU_METHOD
/begin COMPU_METHOD POD_FaultHandle_CM_single_ms "Q = V" IDENTICAL "%8.6" "ms" /end COMPU_METHOD
/begin COMPU_METHOD POD_FaultHandle_CM_uint16_s "Q = V" IDENTICAL "%5.0" "s" /end COMPU_METHOD
/begin COMPU_METHOD POD_FaultHandle_CM_uint8 "Q = V" IDENTICAL "%3.0" "" /end COMPU_METHOD
/begin COMPU_METHOD POD_HallHandleModule_TZCU_CM_boolean "Q = V" IDENTICAL "%1.0" "" /end COMPU_METHOD
/begin COMPU_METHOD POD_HallHandleModule_TZCU_CM_int16 "Q = V" IDENTICAL "%5.0" "" /end COMPU_METHOD
/begin COMPU_METHOD POD_HallHandleModule_TZCU_CM_single "Q = V" IDENTICAL "%8.6" "" /end COMPU_METHOD
/begin COMPU_METHOD POD_HallHandleModule_TZCU_CM_uint16 "Q = V" IDENTICAL "%5.0" "" /end COMPU_METHOD
/begin COMPU_METHOD POD_HallHandleModule_TZCU_CM_uint8 "Q = V" IDENTICAL "%3.0" "" /end COMPU_METHOD
/begin COMPU_METHOD POD_SignalHandModule_T_CM_single "Q = V" IDENTICAL "%8.6" "" /end COMPU_METHOD
/begin COMPU_METHOD POD_SignalHandModule_T_CM_uint8 "Q = V" IDENTICAL "%3.0" "" /end COMPU_METHOD
/begin COMPU_METHOD POD_SMML_CM_boolean "Q = V" IDENTICAL "%1.0" "" /end COMPU_METHOD
/begin COMPU_METHOD POD_SMML_CM_single "Q = V" IDENTICAL "%8.6" "" /end COMPU_METHOD
/begin COMPU_METHOD POD_SMML_CM_uint8 "Q = V" IDENTICAL "%3.0" "" /end COMPU_METHOD
/begin COMPU_METHOD POD_SMMR_CM_boolean "Q = V" IDENTICAL "%1.0" "" /end COMPU_METHOD
/begin COMPU_METHOD POD_SMMR_CM_single "Q = V" IDENTICAL "%8.6" "" /end COMPU_METHOD
/begin COMPU_METHOD POD_SMMR_CM_uint8 "Q = V" IDENTICAL "%3.0" "" /end COMPU_METHOD
/begin COMPU_METHOD POD_TipToRun_CM_boolean "Q = V" IDENTICAL "%1.0" "" /end COMPU_METHOD
/begin COMPU_METHOD POD_TipToRun_CM_int16 "Q = V" IDENTICAL "%5.0" "" /end COMPU_METHOD
/begin COMPU_METHOD POD_TipToRun_CM_int16_rpm "Q = V" IDENTICAL "%5.0" "rpm" /end COMPU_METHOD
/begin COMPU_METHOD POD_TipToRun_CM_single "Q = V" IDENTICAL "%8.6" "" /end COMPU_METHOD
/begin COMPU_METHOD RDM_AntiPinch_CM_uint16 "Q = V" IDENTICAL "%5.0" "" /end COMPU_METHOD
/begin COMPU_METHOD RDM_DetTrunkMoveReq_CM_int16 "Q = V" IDENTICAL "%5.0" "" /end COMPU_METHOD
/begin COMPU_METHOD RDM_DetTrunkMoveReq_CM_single "Q = V" IDENTICAL "%8.6" "" /end COMPU_METHOD
/begin COMPU_METHOD RDM_DetTrunkMoveReq_CM_uint16 "Q = V" IDENTICAL "%5.0" "" /end COMPU_METHOD
/begin COMPU_METHOD RDM_DetTrunkMoveReq_CM_uint8 "Q = V" IDENTICAL "%3.0" "" /end COMPU_METHOD
/begin COMPU_METHOD RDM_FITIn_CM_UINT8 "Q = V" IDENTICAL "%3.0" "" /end COMPU_METHOD
/begin COMPU_METHOD RDM_FITIn_CM_uint8 "Q = V" IDENTICAL "%3.0" "" /end COMPU_METHOD
/begin COMPU_METHOD RDM_GetTrunkPos_CM_uint8 "Q = V" IDENTICAL "%3.0" "" /end COMPU_METHOD
/begin CHARACTERISTIC CalC_TrnkHallSeriesDir "" VALUE 0xB0007168 Scalar_UBYTE 0 RDM_GetTrunkPos_CM_uint8 0 255 /end CHARACTERISTIC
/begin CHARACTERISTIC CalC_TrnkMtrPWMUpLim "" VALUE 0xB000717D Scalar_UBYTE 0 RDM_DetTrunkMoveReq_CM_uint8 0 255 /end CHARACTERISTIC
/begin CHARACTERISTIC CalC_TrnkOpnMtrStartStepCfg "" VALUE 0xB00071A4 Scalar_UBYTE 0 RDM_DetTrunkMoveReq_CM_uint8 0 255 /end CHARACTERISTIC
/begin CHARACTERISTIC CalC_TrnkOpnSpdCtrKd "" VALUE 0xB00071B8 Scalar_FLOAT32_IEEE 0 RDM_DetTrunkMoveReq_CM_single -3.4e+38 3.4e+38 /end CHARACTERISTIC
/begin CHARACTERISTIC CalC_TrnkOpnSpdCtrKi "" VALUE 0xB00071BC Scalar_FLOAT32_IEEE 0 RDM_DetTrunkMoveReq_CM_single -3.4e+38 3.4e+38 /end CHARACTERISTIC
/begin CHARACTERISTIC CalC_TrnkOpnSpdCtrKp "" VALUE 0xB00071C0 Scalar_FLOAT32_IEEE 0 RDM_DetTrunkMoveReq_CM_single -3.4e+38 3.4e+38 /end CHARACTERISTIC
/begin CHARACTERISTIC CalC_TrnkOpnVldMaxHallPos "" VALUE 0xB00071CA Scalar_SWORD 0 RDM_DetTrunkMoveReq_CM_int16 -32768 32767 /end CHARACTERISTIC
/begin CHARACTERISTIC CalC_TrnkPshMvStMinPosDist "" VALUE 0xB00071CE Scalar_UWORD 0 RDM_DetTrunkMoveReq_CM_uint16 0 65535 /end CHARACTERISTIC
/begin CHARACTERISTIC CalC_hIPLGMechHighHall_cnt "" VALUE 0xB00071EC Scalar_UWORD 0 RDM_AntiPinch_CM_uint16 0 65535 /end CHARACTERISTIC
/begin CHARACTERISTIC CalC_hIPLGServoTrig_cnt "" VALUE 0xB00071F2 Scalar_UWORD 0 RDM_DetTrunkMoveReq_CM_uint16 0 65535 /end CHARACTERISTIC
/begin CHARACTERISTIC CalEn_FIN_KeyTrnkRqst "" VALUE 0xB0007289 Scalar_UBYTE 0 RDM_FITIn_CM_uint8 0 255 /end CHARACTERISTIC
/begin CHARACTERISTIC CalEn_FIN_TrnkRelsDrvSw "" VALUE 0xB000728A Scalar_UBYTE 0 RDM_FITIn_CM_uint8 0 255 /end CHARACTERISTIC
/begin CHARACTERISTIC CalEn_FIN_TrnkRelsExtSw "" VALUE 0xB000728B Scalar_UBYTE 0 RDM_FITIn_CM_uint8 0 255 /end CHARACTERISTIC
/begin CHARACTERISTIC CalEn_FIN_TrnkRelsIntSw "" VALUE 0xB000728C Scalar_UBYTE 0 RDM_FITIn_CM_uint8 0 255 /end CHARACTERISTIC
/begin CHARACTERISTIC CalVal_FIN_KeyTrnkRqst "" VALUE 0xB000728D Scalar_UBYTE 0 RDM_FITIn_CM_uint8 0 255 /end CHARACTERISTIC
/begin CHARACTERISTIC CalVal_FIN_TrnkRelsDrvSw "" VALUE 0xB000728E Scalar_UBYTE 0 RDM_FITIn_CM_uint8 0 255 /end CHARACTERISTIC
/begin CHARACTERISTIC CalVal_FIN_TrnkRelsExtSw "" VALUE 0xB000728F Scalar_UBYTE 0 RDM_FITIn_CM_uint8 0 255 /end CHARACTERISTIC
/begin CHARACTERISTIC CalVal_FIN_TrnkRelsIntSw "" VALUE 0xB0007290 Scalar_UBYTE 0 RDM_FITIn_CM_uint8 0 255 /end CHARACTERISTIC
/begin CHARACTERISTIC K_ADP_Value_ErrPositionDiffMin "" VALUE 0xB0006D14 Scalar_FLOAT32_IEEE 0 POD_AntiPinch_CM_single -3.4e+38 3.4e+38 /end CHARACTERISTIC
/begin CHARACTERISTIC K_TTR_Value_RoadManualCloseIMUFactor "" CURVE 0xB0006F78 Lookup1D_FLOAT32_IEEE 0 POD_TipToRun_CM_single -3.4e+38 3.4e+38
 /begin AXIS_DESCR COM_AXIS monr_VfSHM_FrntIncinAgLTTR_deg POD_TipToRun_CM_single 11 -3.4e+38 3.4e+38 DEPOSIT ABSOLUTE AXIS_PTS_REF K_TTR_Value_SectorForIMURollAndRoad /end AXIS_DESCR
/end CHARACTERISTIC
/begin CHARACTERISTIC K_TTR_Value_RoadManualOpenIMUFactor "" CURVE 0xB0006FA4 Lookup1D_FLOAT32_IEEE 0 POD_TipToRun_CM_single -3.4e+38 3.4e+38
 /begin AXIS_DESCR COM_AXIS monr_VfSHM_FrntIncinAgLTTR_deg POD_TipToRun_CM_single 11 -3.4e+38 3.4e+38 DEPOSIT ABSOLUTE AXIS_PTS_REF K_TTR_Value_SectorForIMURollAndRoad /end AXIS_DESCR
/end CHARACTERISTIC
/begin CHARACTERISTIC K_TTR_Value_RollManualCloseIMUFactor "" CURVE 0xB0006FD0 Lookup1D_FLOAT32_IEEE 0 POD_TipToRun_CM_single -3.4e+38 3.4e+38
 /begin AXIS_DESCR COM_AXIS monr_VfSHM_FrntIncinAgLTTR_deg POD_TipToRun_CM_single 11 -3.4e+38 3.4e+38 DEPOSIT ABSOLUTE AXIS_PTS_REF K_TTR_Value_SectorForIMURollAndRoad /end AXIS_DESCR
/end CHARACTERISTIC
/begin CHARACTERISTIC K_TTR_Value_RollManualOpenIMUFactor "" CURVE 0xB0006FFC Lookup1D_FLOAT32_IEEE 0 POD_TipToRun_CM_single -3.4e+38 3.4e+38
 /begin AXIS_DESCR COM_AXIS monr_VfSHM_FrntIncinAgLTTR_deg POD_TipToRun_CM_single 11 -3.4e+38 3.4e+38 DEPOSIT ABSOLUTE AXIS_PTS_REF K_TTR_Value_SectorForIMURollAndRoad /end AXIS_DESCR
/end CHARACTERISTIC
/begin AXIS_PTS K_TTR_Value_SectorForIMURollAndRoad "" 0x80774028 monr_VfSHM_FrntIncinAgLTTR_deg Lookup1D_X_FLOAT32_IEEE 0 POD_TipToRun_CM_single 11 -3.4e+38 3.4e+38 DEPOSIT ABSOLUTE /end AXIS_PTS
/begin CHARACTERISTIC KuLVM_DoorHallChgDebTi_s "" VALUE 0xB0007054 Scalar_UWORD 0 POD_FaultHandle_CM_uint16_s 0 65535 /end CHARACTERISTIC
/begin MEASUREMENT Monr_FIN_KeyTrnkRqst "" UBYTE RDM_FITIn_CM_UINT8 0 0 0 255 ECU_ADDRESS 0xB005635C /end MEASUREMENT
/begin MEASUREMENT Monr_FIN_TrnkRelsDrvSw "" UBYTE RDM_FITIn_CM_UINT8 0 0 0 255 ECU_ADDRESS 0xB005635D /end MEASUREMENT
/begin MEASUREMENT Monr_FIN_TrnkRelsExtSw "" UBYTE RDM_FITIn_CM_UINT8 0 0 0 255 ECU_ADDRESS 0xB005635E /end MEASUREMENT
/begin MEASUREMENT Monr_FIN_TrnkRelsIntSw "" UBYTE RDM_FITIn_CM_UINT8 0 0 0 255 ECU_ADDRESS 0xB005635F /end MEASUREMENT
/begin CHARACTERISTIC k_ADCH_Fac_FilterForMaiMotCurr "" VALUE 0xB0006490 Scalar_FLOAT32_IEEE 0 POD_SignalHandModule_T_CM_single -3.4e+38 3.4e+38 /end CHARACTERISTIC
/begin CHARACTERISTIC k_ADP_Boolean_AntiPlayValue "" VALUE 0xB000639D Scalar_BOOLEAN 0 POD_FaultHandle_CM_boolean 0 1 /end CHARACTERISTIC
/begin CHARACTERISTIC k_ADP_Boolean_AntiPlayflg "" VALUE 0xB000639C Scalar_BOOLEAN 0 POD_FaultHandle_CM_boolean 0 1 /end CHARACTERISTIC
/begin CHARACTERISTIC k_ADP_Ti_AntiPinchCloseSpeedPerStartTimer "" VALUE 0xB0006104 Scalar_FLOAT32_IEEE 0 POD_AntiPinch_CM_single -3.4e+38 3.4e+38 /end CHARACTERISTIC
/begin CHARACTERISTIC k_ADP_Ti_AntiPinchHoldingTimer "" VALUE 0xB000610C Scalar_FLOAT32_IEEE 0 POD_AntiPinch_CM_single -3.4e+38 3.4e+38 /end CHARACTERISTIC
/begin CHARACTERISTIC k_ADP_Ti_AntiPinchOpenSpeedPerStartTimer "" VALUE 0xB0006114 Scalar_FLOAT32_IEEE 0 POD_AntiPinch_CM_single -3.4e+38 3.4e+38 /end CHARACTERISTIC
/begin CHARACTERISTIC k_ADP_Ti_AntiPinchSequenceTimer "" VALUE 0xB0006118 Scalar_FLOAT32_IEEE 0 POD_AntiPinch_CM_single -3.4e+38 3.4e+38 /end CHARACTERISTIC
/begin CHARACTERISTIC k_ADP_Ti_AntiPinchforMinErrPositionDelayTimer "" VALUE 0xB0006108 Scalar_FLOAT32_IEEE 0 POD_AntiPinch_CM_single -3.4e+38 3.4e+38 /end CHARACTERISTIC
/begin CHARACTERISTIC k_ADP_Ti_AntiPlaySequenceTimer "" VALUE 0xB00063A0 Scalar_FLOAT32_IEEE 0 POD_FaultHandle_CM_single -3.4e+38 3.4e+38 /end CHARACTERISTIC
/begin CHARACTERISTIC k_ADP_Ti_CurAntiPinchforMinPntCloseDelayTimer "" VALUE 0xB0006120 Scalar_FLOAT32_IEEE 0 POD_AntiPinch_CM_single -3.4e+38 3.4e+38 /end CHARACTERISTIC
/begin CHARACTERISTIC k_ADP_Ti_CurAntiPinchforMinPntCloseStartTimer "" VALUE 0xB0006124 Scalar_FLOAT32_IEEE 0 POD_AntiPinch_CM_single -3.4e+38 3.4e+38 /end CHARACTERISTIC
/begin CHARACTERISTIC k_ADP_Ti_CurrentIncreaseTimer "" VALUE 0xB0006128 Scalar_FLOAT32_IEEE 0 POD_AntiPinch_CM_single -3.4e+38 3.4e+38 /end CHARACTERISTIC
/begin CHARACTERISTIC k_ADP_Ti_DieMinimumSpeedJudgeTimer "" VALUE 0xB000612C Scalar_FLOAT32_IEEE 0 POD_AntiPinch_CM_single -3.4e+38 3.4e+38 /end CHARACTERISTIC
/begin CHARACTERISTIC k_ADP_Ti_MinPositionDelayTimer "" VALUE 0xB0006130 Scalar_FLOAT32_IEEE 0 POD_AntiPinch_CM_single -3.4e+38 3.4e+38 /end CHARACTERISTIC
/begin CHARACTERISTIC k_ADP_Ti_RefCurrResTimer "" VALUE 0xB0006134 Scalar_FLOAT32_IEEE 0 POD_AntiPinch_CM_single -3.4e+38 3.4e+38 /end CHARACTERISTIC
/begin CHARACTERISTIC k_ADP_Ti_StateRunDelayTimer "" VALUE 0xB0006138 Scalar_FLOAT32_IEEE 0 POD_AntiPinch_CM_single -3.4e+38 3.4e+38 /end CHARACTERISTIC
/begin CHARACTERISTIC k_ADP_Ti_TimeActiveProtectionThreshold "防玩禁用电动功能的时间(ms)" VALUE 0xB00063A4 Scalar_FLOAT32_IEEE 0 POD_FaultHandle_CM_single_ms -3.4e+38 3.4e+38 /end CHARACTERISTIC
/begin CHARACTERISTIC k_ADP_Value_CurrentIncMinRateforAntiPinch "" VALUE 0xB0006148 Scalar_FLOAT32_IEEE 0 POD_AntiPinch_CM_single -3.4e+38 3.4e+38 /end CHARACTERISTIC
/begin AXIS_PTS k_ADP_Value_ElecComBreakPoints "" 0x80773314 monr_VfMCM_ldlToAntipinchLAP_MA Lookup1D_X_FLOAT32_IEEE 0 POD_AntiPinch_CM_single 8 -3.4e+38 3.4e+38 DEPOSIT ABSOLUTE /end AXIS_PTS
/begin CHARACTERISTIC k_ADP_Value_ErrPosCurMinRateforAntiPinch "" VALUE 0xB0006160 Scalar_FLOAT32_IEEE 0 POD_AntiPinch_CM_single -3.4e+38 3.4e+38 /end CHARACTERISTIC
/begin CHARACTERISTIC k_ADP_Value_PosErrHoldRateforAntiPinch "" CURVE 0xB0006334 Lookup1D_FLOAT32_IEEE 0 POD_AntiPinch_CM_single -3.4e+38 3.4e+38
 /begin AXIS_DESCR COM_AXIS monr_VfMCM_ldlToAntipinchLAP_MA POD_AntiPinch_CM_single 8 -3.4e+38 3.4e+38 DEPOSIT ABSOLUTE AXIS_PTS_REF k_ADP_Value_ElecComBreakPoints /end AXIS_DESCR
/end CHARACTERISTIC
/begin CHARACTERISTIC k_HHM_Deg_MaxOpenPosition "" VAL_BLK 0xB000646C Scalar_FLOAT32_IEEE 0 POD_HallHandleModule_TZCU_CM_single -3.4e+38 3.4e+38 MATRIX_DIM 2 /end CHARACTERISTIC
/begin CHARACTERISTIC k_HHM_Deg_MinOpenAngSwt "" VALUE 0xB00063B0 Scalar_FLOAT32_IEEE 0 POD_HallHandleModule_TZCU_CM_single -3.4e+38 3.4e+38 /end CHARACTERISTIC
/begin CHARACTERISTIC k_HHM_Pluse_FilterMinHallPosition "" VALUE 0xB00063B4 Scalar_SWORD 0 POD_HallHandleModule_TZCU_CM_int16 -32768 32767 /end CHARACTERISTIC
/begin CHARACTERISTIC k_HHM_Ti_CloseDoorHallIncTi "" VALUE 0xB00063B8 Scalar_FLOAT32_IEEE 0 POD_HallHandleModule_TZCU_CM_single -3.4e+38 3.4e+38 /end CHARACTERISTIC
/begin CHARACTERISTIC k_HHM_Ti_CloseDoorHallPWMStaticTi "" VALUE 0xB00063BC Scalar_FLOAT32_IEEE 0 POD_HallHandleModule_TZCU_CM_single -3.4e+38 3.4e+38 /end CHARACTERISTIC
/begin CHARACTERISTIC k_HHM_Ti_ECUWakeUpJudgeMinTi "" VALUE 0xB00063C0 Scalar_FLOAT32_IEEE 0 POD_HallHandleModule_TZCU_CM_single -3.4e+38 3.4e+38 /end CHARACTERISTIC
/begin CHARACTERISTIC k_HHM_Ti_HallAErrorConTi "" VALUE 0xB00063C4 Scalar_FLOAT32_IEEE 0 POD_HallHandleModule_TZCU_CM_single -3.4e+38 3.4e+38 /end CHARACTERISTIC
/begin CHARACTERISTIC k_HHM_Ti_HallDirAErrorTi "" VALUE 0xB00063C8 Scalar_FLOAT32_IEEE 0 POD_HallHandleModule_TZCU_CM_single -3.4e+38 3.4e+38 /end CHARACTERISTIC
/begin CHARACTERISTIC k_HHM_Ti_HallNumAStaticTi "" VALUE 0xB00063CC Scalar_FLOAT32_IEEE 0 POD_HallHandleModule_TZCU_CM_single -3.4e+38 3.4e+38 /end CHARACTERISTIC
/begin CHARACTERISTIC k_HHM_Ti_HallPWMErrTi "" VALUE 0xB00063DC Scalar_FLOAT32_IEEE 0 POD_HallHandleModule_TZCU_CM_single -3.4e+38 3.4e+38 /end CHARACTERISTIC
/begin CHARACTERISTIC k_HHM_Ti_HallPWMErrorAbsPosSpdJudgeTi "" VALUE 0xB00063D0 Scalar_FLOAT32_IEEE 0 POD_HallHandleModule_TZCU_CM_single -3.4e+38 3.4e+38 /end CHARACTERISTIC
/begin CHARACTERISTIC k_HHM_Ti_HallPWMErrorConTi "" VALUE 0xB00063D4 Scalar_FLOAT32_IEEE 0 POD_HallHandleModule_TZCU_CM_single -3.4e+38 3.4e+38 /end CHARACTERISTIC
/begin CHARACTERISTIC k_HHM_Ti_HallPWMErrorJudgeTi "" VALUE 0xB00063D8 Scalar_FLOAT32_IEEE 0 POD_HallHandleModule_TZCU_CM_single -3.4e+38 3.4e+38 /end CHARACTERISTIC
/begin CHARACTERISTIC k_HHM_Ti_HallReveMaxTi "" VALUE 0xB00063E0 Scalar_FLOAT32_IEEE 0 POD_HallHandleModule_TZCU_CM_single -3.4e+38 3.4e+38 /end CHARACTERISTIC
/begin CHARACTERISTIC k_HHM_Ti_OpenDoorHallDecTi "" VALUE 0xB00063E4 Scalar_FLOAT32_IEEE 0 POD_HallHandleModule_TZCU_CM_single -3.4e+38 3.4e+38 /end CHARACTERISTIC
/begin CHARACTERISTIC k_HHM_Ti_OpenDoorHallPWMStaticTi "" VALUE 0xB00063E8 Scalar_FLOAT32_IEEE 0 POD_HallHandleModule_TZCU_CM_single -3.4e+38 3.4e+38 /end CHARACTERISTIC
/begin CHARACTERISTIC k_HHM_Ti_TimeClosingInLockHoldMovSts "" VALUE 0xB00063F0 Scalar_FLOAT32_IEEE 0 POD_HallHandleModule_TZCU_CM_single -3.4e+38 3.4e+38 /end CHARACTERISTIC
/begin CHARACTERISTIC k_HHM_Ti_TimeHalfClsdDelay "" VALUE 0xB00063F4 Scalar_FLOAT32_IEEE 0 POD_HallHandleModule_TZCU_CM_single -3.4e+38 3.4e+38 /end CHARACTERISTIC
/begin CHARACTERISTIC k_HHM_Ti_TimeHallInitDelay "" VALUE 0xB00063F8 Scalar_FLOAT32_IEEE 0 POD_HallHandleModule_TZCU_CM_single -3.4e+38 3.4e+38 /end CHARACTERISTIC
/begin CHARACTERISTIC k_HHM_Ti_TimeHallSpdNoMov "" VALUE 0xB00063FC Scalar_FLOAT32_IEEE 0 POD_HallHandleModule_TZCU_CM_single -3.4e+38 3.4e+38 /end CHARACTERISTIC
/begin CHARACTERISTIC k_HHM_Ti_TimeHallStatic "" VALUE 0xB0006400 Scalar_FLOAT32_IEEE 0 POD_HallHandleModule_TZCU_CM_single -3.4e+38 3.4e+38 /end CHARACTERISTIC
/begin CHARACTERISTIC k_HHM_Ti_TimeHoldDoorErrorMovSts "" VALUE 0xB0006404 Scalar_FLOAT32_IEEE 0 POD_HallHandleModule_TZCU_CM_single -3.4e+38 3.4e+38 /end CHARACTERISTIC
/begin CHARACTERISTIC k_HHM_Ti_TimeHoldDoorStopMovSts "" VALUE 0xB0006408 Scalar_FLOAT32_IEEE 0 POD_HallHandleModule_TZCU_CM_single -3.4e+38 3.4e+38 /end CHARACTERISTIC
/begin CHARACTERISTIC k_HHM_Ti_TimeHoldManualDoorStopMovSts "" VAL_BLK 0xB0006474 Scalar_FLOAT32_IEEE 0 POD_HallHandleModule_TZCU_CM_single -3.4e+38 3.4e+38 MATRIX_DIM 2 /end CHARACTERISTIC
/begin CHARACTERISTIC k_HHM_Ti_TimeIMUDoorStopMovSts "" VALUE 0xB000640C Scalar_FLOAT32_IEEE 0 POD_HallHandleModule_TZCU_CM_single -3.4e+38 3.4e+38 /end CHARACTERISTIC
/begin CHARACTERISTIC k_HHM_Ti_TimeInsdSetPstnDelay "" VALUE 0xB0006410 Scalar_FLOAT32_IEEE 0 POD_HallHandleModule_TZCU_CM_single -3.4e+38 3.4e+38 /end CHARACTERISTIC
/begin CHARACTERISTIC k_HHM_Ti_TimeWakeUp "" VALUE 0xB000641C Scalar_FLOAT32_IEEE 0 POD_HallHandleModule_TZCU_CM_single -3.4e+38 3.4e+38 /end CHARACTERISTIC
/begin CHARACTERISTIC k_HHM_Value_HallAMovFreqMaxPrt "" VALUE 0xB0006428 Scalar_UWORD 0 POD_HallHandleModule_TZCU_CM_uint16 0 65535 /end CHARACTERISTIC
/begin CHARACTERISTIC k_HHM_Value_HallASenorErrCurrentPrt "" VALUE 0xB000642C Scalar_FLOAT32_IEEE 0 POD_HallHandleModule_TZCU_CM_single -3.4e+38 3.4e+38 /end CHARACTERISTIC
/begin CHARACTERISTIC k_HHM_Value_HallASenorIMUAngSpdPrt "" VALUE 0xB0006430 Scalar_SWORD 0 POD_HallHandleModule_TZCU_CM_int16 -32768 32767 /end CHARACTERISTIC
/begin CHARACTERISTIC k_HHM_Value_HallDirErrMinAbsSpeed "" VALUE 0xB0006432 Scalar_SWORD 0 POD_HallHandleModule_TZCU_CM_int16 -32768 32767 /end CHARACTERISTIC
/begin CHARACTERISTIC k_HHM_Value_HallDirErrMinClsdSpeed "" VALUE 0xB0006434 Scalar_SWORD 0 POD_HallHandleModule_TZCU_CM_int16 -32768 32767 /end CHARACTERISTIC
/begin CHARACTERISTIC k_HHM_Value_HallDirErrMinOpenSpeed "" VALUE 0xB0006436 Scalar_SWORD 0 POD_HallHandleModule_TZCU_CM_int16 -32768 32767 /end CHARACTERISTIC
/begin CHARACTERISTIC k_HHM_Value_HallErrMinSpeed "" VALUE 0xB0006438 Scalar_SWORD 0 POD_HallHandleModule_TZCU_CM_int16 -32768 32767 /end CHARACTERISTIC
/begin CHARACTERISTIC k_HHM_Value_HallErrSlope "" VALUE 0xB000643C Scalar_FLOAT32_IEEE 0 POD_HallHandleModule_TZCU_CM_single -3.4e+38 3.4e+38 /end CHARACTERISTIC
/begin CHARACTERISTIC k_HHM_Value_HallErrSpeedOffset "" VALUE 0xB0006440 Scalar_SWORD 0 POD_HallHandleModule_TZCU_CM_int16 -32768 32767 /end CHARACTERISTIC
/begin CHARACTERISTIC k_HHM_Value_HallPWMErrCurrentPrt "" VALUE 0xB0006444 Scalar_FLOAT32_IEEE 0 POD_HallHandleModule_TZCU_CM_single -3.4e+38 3.4e+38 /end CHARACTERISTIC
/begin CHARACTERISTIC k_HHM_Value_HallPWMIMUAngSpdPrt "" VALUE 0xB0006448 Scalar_SWORD 0 POD_HallHandleModule_TZCU_CM_int16 -32768 32767 /end CHARACTERISTIC
/begin CHARACTERISTIC k_HHM_Value_HallPassCnt "" VALUE 0xB0006442 Scalar_UBYTE 0 POD_HallHandleModule_TZCU_CM_uint8 0 255 /end CHARACTERISTIC
/begin CHARACTERISTIC k_HHM_Value_HallPwmMinValue "" VALUE 0xB000644A Scalar_UWORD 0 POD_HallHandleModule_TZCU_CM_uint16 0 65535 /end CHARACTERISTIC
/begin CHARACTERISTIC k_HHM_Value_ManualCloseHallSpeed "" VALUE 0xB000644C Scalar_SWORD 0 POD_HallHandleModule_TZCU_CM_int16 -32768 32767 /end CHARACTERISTIC
/begin CHARACTERISTIC k_HHM_Value_ManualCloseIMUAngSpdMinSpeed "" VALUE 0xB000644E Scalar_SWORD 0 POD_HallHandleModule_TZCU_CM_int16 -32768 32767 /end CHARACTERISTIC
/begin CHARACTERISTIC k_HHM_Value_ManualHoldIMUAngSpdMinSpeed "" VALUE 0xB0006450 Scalar_SWORD 0 POD_HallHandleModule_TZCU_CM_int16 -32768 32767 /end CHARACTERISTIC
/begin CHARACTERISTIC k_HHM_Value_ManualOpenHallSpeed "" VALUE 0xB0006452 Scalar_SWORD 0 POD_HallHandleModule_TZCU_CM_int16 -32768 32767 /end CHARACTERISTIC
/begin CHARACTERISTIC k_HHM_Value_ManualOpenIMUAngSpdMinSpeed "" VALUE 0xB0006454 Scalar_SWORD 0 POD_HallHandleModule_TZCU_CM_int16 -32768 32767 /end CHARACTERISTIC
/begin CHARACTERISTIC k_HHM_Value_Minus2Sec "" VALUE 0xB0006458 Scalar_FLOAT32_IEEE 0 POD_HallHandleModule_TZCU_CM_single -3.4e+38 3.4e+38 /end CHARACTERISTIC
/begin CHARACTERISTIC k_HHM_Value_Multiple "" VALUE 0xB000645C Scalar_SWORD 0 POD_HallHandleModule_TZCU_CM_int16 -32768 32767 /end CHARACTERISTIC
/begin CHARACTERISTIC k_HHM_Value_Pluse2Deg "" VALUE 0xB0006460 Scalar_FLOAT32_IEEE 0 POD_HallHandleModule_TZCU_CM_single -3.4e+38 3.4e+38 /end CHARACTERISTIC
/begin CHARACTERISTIC k_HHM_Value_PushLockMaxD "" VALUE 0xB0006464 Scalar_SWORD 0 POD_HallHandleModule_TZCU_CM_int16 -32768 32767 /end CHARACTERISTIC
/begin CHARACTERISTIC k_HHM_Value_PushLockMaxF "" VALUE 0xB0006466 Scalar_UWORD 0 POD_HallHandleModule_TZCU_CM_uint16 0 65535 /end CHARACTERISTIC
/begin CHARACTERISTIC k_HHM_Value_Sec2Milsec "" VALUE 0xB0006468 Scalar_FLOAT32_IEEE 0 POD_HallHandleModule_TZCU_CM_single -3.4e+38 3.4e+38 /end CHARACTERISTIC
/begin CHARACTERISTIC k_HHM_Value_SectorForClose "" VAL_BLK 0xB000647C Scalar_SWORD 0 POD_HallHandleModule_TZCU_CM_int16 -32768 32767 MATRIX_DIM 4 /end CHARACTERISTIC
/begin CHARACTERISTIC k_HHM_Value_SectorForOpen "" VAL_BLK 0xB0006484 Scalar_SWORD 0 POD_HallHandleModule_TZCU_CM_int16 -32768 32767 MATRIX_DIM 4 /end CHARACTERISTIC
/begin CHARACTERISTIC k_HHM_Value_cfgHallHandlePeriod "" VALUE 0xB0006420 Scalar_FLOAT32_IEEE 0 POD_HallHandleModule_TZCU_CM_single -3.4e+38 3.4e+38 /end CHARACTERISTIC
/begin CHARACTERISTIC k_HHM_Value_cfgHallPole "" VALUE 0xB0006424 Scalar_FLOAT32_IEEE 0 POD_HallHandleModule_TZCU_CM_single -3.4e+38 3.4e+38 /end CHARACTERISTIC
/begin CHARACTERISTIC k_TTR_Deg_RoadInclnThdAssis "" VALUE 0xB000649C Scalar_FLOAT32_IEEE 0 POD_TipToRun_CM_single -3.4e+38 3.4e+38 /end CHARACTERISTIC
/begin CHARACTERISTIC k_TTR_Deg_RollAgGlbThdAssis "" VALUE 0xB00064A0 Scalar_FLOAT32_IEEE 0 POD_TipToRun_CM_single -3.4e+38 3.4e+38 /end CHARACTERISTIC
/begin CHARACTERISTIC k_TTR_Pluse_ManualAssistMinPos "" VALUE 0xB00064A4 Scalar_SWORD 0 POD_TipToRun_CM_int16 -32768 32767 /end CHARACTERISTIC
/begin CHARACTERISTIC k_TTR_Ti_DoorBrkgToAssistCloseTi "" VAL_BLK 0xB0006538 Scalar_FLOAT32_IEEE 0 POD_TipToRun_CM_single -3.4e+38 3.4e+38 MATRIX_DIM 2 /end CHARACTERISTIC
/begin CHARACTERISTIC k_TTR_Ti_DoorBrkgToAssistOpenTi "" VAL_BLK 0xB0006540 Scalar_FLOAT32_IEEE 0 POD_TipToRun_CM_single -3.4e+38 3.4e+38 MATRIX_DIM 2 /end CHARACTERISTIC
/begin CHARACTERISTIC k_TTR_Ti_DoorCloseACCDecJudgeTi "" VAL_BLK 0xB0006548 Scalar_FLOAT32_IEEE 0 POD_TipToRun_CM_single -3.4e+38 3.4e+38 MATRIX_DIM 2 /end CHARACTERISTIC
/begin CHARACTERISTIC k_TTR_Ti_DoorCloseACCIncJudgeTi "" VAL_BLK 0xB0006550 Scalar_FLOAT32_IEEE 0 POD_TipToRun_CM_single -3.4e+38 3.4e+38 MATRIX_DIM 2 /end CHARACTERISTIC
/begin CHARACTERISTIC k_TTR_Ti_DoorCloseInitialTi "" VALUE 0xB00064A8 Scalar_FLOAT32_IEEE 0 POD_TipToRun_CM_single -3.4e+38 3.4e+38 /end CHARACTERISTIC
/begin CHARACTERISTIC k_TTR_Ti_DoorCloseToAssistAccStateTi "" VALUE 0xB00064AC Scalar_FLOAT32_IEEE 0 POD_TipToRun_CM_single -3.4e+38 3.4e+38 /end CHARACTERISTIC
/begin CHARACTERISTIC k_TTR_Ti_DoorOpenACCDecJudgeTi "" VAL_BLK 0xB0006558 Scalar_FLOAT32_IEEE 0 POD_TipToRun_CM_single -3.4e+38 3.4e+38 MATRIX_DIM 2 /end CHARACTERISTIC
/begin CHARACTERISTIC k_TTR_Ti_DoorOpenACCIncJudgeTi "" VAL_BLK 0xB0006560 Scalar_FLOAT32_IEEE 0 POD_TipToRun_CM_single -3.4e+38 3.4e+38 MATRIX_DIM 2 /end CHARACTERISTIC
/begin CHARACTERISTIC k_TTR_Ti_DoorOpenBrkgToAssistAgSpdDelayTi "" VALUE 0xB00064B0 Scalar_FLOAT32_IEEE 0 POD_TipToRun_CM_single -3.4e+38 3.4e+38 /end CHARACTERISTIC
/begin CHARACTERISTIC k_TTR_Ti_DoorOpenDecToAssistAccStateTi "" VALUE 0xB00064B4 Scalar_FLOAT32_IEEE 0 POD_TipToRun_CM_single -3.4e+38 3.4e+38 /end CHARACTERISTIC
/begin CHARACTERISTIC k_TTR_Ti_DoorOpenInitialTi "" VALUE 0xB00064B8 Scalar_FLOAT32_IEEE 0 POD_TipToRun_CM_single -3.4e+38 3.4e+38 /end CHARACTERISTIC
/begin CHARACTERISTIC k_TTR_Ti_DoorOpenStartTimer "" VALUE 0xB00064BC Scalar_FLOAT32_IEEE 0 POD_TipToRun_CM_single -3.4e+38 3.4e+38 /end CHARACTERISTIC
/begin CHARACTERISTIC k_TTR_Ti_DoorOpenToAssistAccStateTi "" VALUE 0xB00064C0 Scalar_FLOAT32_IEEE 0 POD_TipToRun_CM_single -3.4e+38 3.4e+38 /end CHARACTERISTIC
/begin CHARACTERISTIC k_TTR_Ti_ErrorSpeedDelayTi "" VALUE 0xB00064C4 Scalar_FLOAT32_IEEE 0 POD_TipToRun_CM_single -3.4e+38 3.4e+38 /end CHARACTERISTIC
/begin CHARACTERISTIC k_TTR_Ti_LowSpeedManualCloseTi "" VALUE 0xB00064C8 Scalar_FLOAT32_IEEE 0 POD_TipToRun_CM_single -3.4e+38 3.4e+38 /end CHARACTERISTIC
/begin CHARACTERISTIC k_TTR_Ti_LowSpeedManualOpenTi "" VALUE 0xB00064CC Scalar_FLOAT32_IEEE 0 POD_TipToRun_CM_single -3.4e+38 3.4e+38 /end CHARACTERISTIC
/begin CHARACTERISTIC k_TTR_Ti_ManualAssistJudgeCnt "" VALUE 0xB00064D0 Scalar_FLOAT32_IEEE 0 POD_TipToRun_CM_single -3.4e+38 3.4e+38 /end CHARACTERISTIC
/begin CHARACTERISTIC k_TTR_Ti_ManualCloseDistanceMaxJudgeTi "" VALUE 0xB00064D4 Scalar_FLOAT32_IEEE 0 POD_TipToRun_CM_single -3.4e+38 3.4e+38 /end CHARACTERISTIC
/begin CHARACTERISTIC k_TTR_Ti_ManualCloseSpdAccDelayTi "" VALUE 0xB00064D8 Scalar_FLOAT32_IEEE 0 POD_TipToRun_CM_single -3.4e+38 3.4e+38 /end CHARACTERISTIC
/begin CHARACTERISTIC k_TTR_Ti_ManualOpenMaxPosJudgeTi "" VALUE 0xB00064DC Scalar_FLOAT32_IEEE 0 POD_TipToRun_CM_single -3.4e+38 3.4e+38 /end CHARACTERISTIC
/begin CHARACTERISTIC k_TTR_Ti_ManualOpenSpdAccDelayTi "" VALUE 0xB00064E0 Scalar_FLOAT32_IEEE 0 POD_TipToRun_CM_single -3.4e+38 3.4e+38 /end CHARACTERISTIC
/begin CHARACTERISTIC k_TTR_Ti_SequenceTimer "" VALUE 0xB00064E4 Scalar_FLOAT32_IEEE 0 POD_TipToRun_CM_single -3.4e+38 3.4e+38 /end CHARACTERISTIC
/begin CHARACTERISTIC k_TTR_Value_ElecCloseDoorMinAcc "" VALUE 0xB00064E8 Scalar_SWORD 0 POD_TipToRun_CM_int16 -32768 32767 /end CHARACTERISTIC
/begin CHARACTERISTIC k_TTR_Value_ElecOpenDoorMinAcc "" VALUE 0xB00064EA Scalar_SWORD 0 POD_TipToRun_CM_int16 -32768 32767 /end CHARACTERISTIC
/begin CHARACTERISTIC k_TTR_Value_ElecToManualCloseMinSpeed "" VALUE 0xB00064EC Scalar_SWORD 0 POD_TipToRun_CM_int16 -32768 32767 /end CHARACTERISTIC
/begin CHARACTERISTIC k_TTR_Value_ElecToManualOpenMinSpeed "" VALUE 0xB00064EE Scalar_SWORD 0 POD_TipToRun_CM_int16 -32768 32767 /end CHARACTERISTIC
/begin CHARACTERISTIC k_TTR_Value_HoldHallPosExit "" VALUE 0xB00064F0 Scalar_SWORD 0 POD_TipToRun_CM_int16 -32768 32767 /end CHARACTERISTIC
/begin CHARACTERISTIC k_TTR_Value_HoldModeIMURisTimer "" VALUE 0xB00064F4 Scalar_FLOAT32_IEEE 0 POD_TipToRun_CM_single -3.4e+38 3.4e+38 /end CHARACTERISTIC
/begin CHARACTERISTIC k_TTR_Value_HoldModePosOnTimer "" VALUE 0xB00064F8 Scalar_FLOAT32_IEEE 0 POD_TipToRun_CM_single -3.4e+38 3.4e+38 /end CHARACTERISTIC
/begin CHARACTERISTIC k_TTR_Value_HoldModeRisTimer "" VALUE 0xB00064FC Scalar_FLOAT32_IEEE 0 POD_TipToRun_CM_single -3.4e+38 3.4e+38 /end CHARACTERISTIC
/begin CHARACTERISTIC k_TTR_Value_IMUAngSpdAccDecRate "" VALUE 0xB0006500 Scalar_FLOAT32_IEEE 0 POD_TipToRun_CM_single -3.4e+38 3.4e+38 /end CHARACTERISTIC
/begin CHARACTERISTIC k_TTR_Value_IMUAngSpdAccToCloseDecRate "" VALUE 0xB0006504 Scalar_FLOAT32_IEEE 0 POD_TipToRun_CM_single -3.4e+38 3.4e+38 /end CHARACTERISTIC
/begin CHARACTERISTIC k_TTR_Value_IMUAngSpdProtectMaxRebound "" VALUE 0xB0006508 Scalar_SWORD 0 POD_TipToRun_CM_int16 -32768 32767 /end CHARACTERISTIC
/begin CHARACTERISTIC k_TTR_Value_IMUAngSpdToCloseOffset "" VALUE 0xB000650A Scalar_SWORD 0 POD_TipToRun_CM_int16 -32768 32767 /end CHARACTERISTIC
/begin CHARACTERISTIC k_TTR_Value_IMUAngSpdToOpenOffset "" VALUE 0xB000650C Scalar_SWORD 0 POD_TipToRun_CM_int16 -32768 32767 /end CHARACTERISTIC
/begin CHARACTERISTIC k_TTR_Value_IMUHoldExitMinSpeed "" VALUE 0xB000650E Scalar_SWORD 0 POD_TipToRun_CM_int16 -32768 32767 /end CHARACTERISTIC
/begin CHARACTERISTIC k_TTR_Value_ImuAngAccSpdThdforTTR "" VAL_BLK 0xB0006568 Scalar_SWORD 0 POD_TipToRun_CM_int16 -32768 32767 MATRIX_DIM 2 /end CHARACTERISTIC
/begin CHARACTERISTIC k_TTR_Value_ImuAngSpdThdforTTR "" VAL_BLK 0xB000656C Scalar_SWORD 0 POD_TipToRun_CM_int16 -32768 32767 MATRIX_DIM 2 /end CHARACTERISTIC
/begin CHARACTERISTIC k_TTR_Value_ManualBackMinHallSpeed "" VALUE 0xB0006510 Scalar_SWORD 0 POD_TipToRun_CM_int16 -32768 32767 /end CHARACTERISTIC
/begin CHARACTERISTIC k_TTR_Value_ManualBrkgCloseMaxAcc "" VALUE 0xB0006512 Scalar_SWORD 0 POD_TipToRun_CM_int16 -32768 32767 /end CHARACTERISTIC
/begin CHARACTERISTIC k_TTR_Value_ManualBrkgCloseMinAcc "" VAL_BLK 0xB0006570 Scalar_SWORD 0 POD_TipToRun_CM_int16 -32768 32767 MATRIX_DIM 2 /end CHARACTERISTIC
/begin CHARACTERISTIC k_TTR_Value_ManualBrkgOpenMaxAcc "" VALUE 0xB0006514 Scalar_SWORD 0 POD_TipToRun_CM_int16 -32768 32767 /end CHARACTERISTIC
/begin CHARACTERISTIC k_TTR_Value_ManualBrkgOpenMinAcc "" VALUE 0xB0006516 Scalar_SWORD 0 POD_TipToRun_CM_int16 -32768 32767 /end CHARACTERISTIC
/begin CHARACTERISTIC k_TTR_Value_ManualBrkgToCloseMinPos "" VALUE 0xB0006518 Scalar_SWORD 0 POD_TipToRun_CM_int16 -32768 32767 /end CHARACTERISTIC
/begin CHARACTERISTIC k_TTR_Value_ManualBrkgToOpenMinPos "" VALUE 0xB000651A Scalar_SWORD 0 POD_TipToRun_CM_int16 -32768 32767 /end CHARACTERISTIC
/begin CHARACTERISTIC k_TTR_Value_ManualCloseACCDiff "" VALUE 0xB000651C Scalar_SWORD 0 POD_TipToRun_CM_int16 -32768 32767 /end CHARACTERISTIC
/begin CHARACTERISTIC k_TTR_Value_ManualCloseIMUBaseAngSpd "" VAL_BLK 0xB0006574 Scalar_SWORD 0 POD_TipToRun_CM_int16 -32768 32767 MATRIX_DIM 2 /end CHARACTERISTIC
/begin CHARACTERISTIC k_TTR_Value_ManualCloseIMUBaseAngSpdOffset "" VALUE 0xB000651E Scalar_SWORD 0 POD_TipToRun_CM_int16 -32768 32767 /end CHARACTERISTIC
/begin CHARACTERISTIC k_TTR_Value_ManualCloseMaxAcc "" VALUE 0xB0006520 Scalar_SWORD 0 POD_TipToRun_CM_int16 -32768 32767 /end CHARACTERISTIC
/begin CHARACTERISTIC k_TTR_Value_ManualCloseMaxSpeed "" VALUE 0xB0006522 Scalar_SWORD 0 POD_TipToRun_CM_int16 -32768 32767 /end CHARACTERISTIC
/begin CHARACTERISTIC k_TTR_Value_ManualCloseMinAcc "" VALUE 0xB0006524 Scalar_SWORD 0 POD_TipToRun_CM_int16 -32768 32767 /end CHARACTERISTIC
/begin CHARACTERISTIC k_TTR_Value_ManualCloseMinSpeed "" VALUE 0xB0006526 Scalar_SWORD 0 POD_TipToRun_CM_int16 -32768 32767 /end CHARACTERISTIC
/begin CHARACTERISTIC k_TTR_Value_ManualMaxAcc "" VALUE 0xB0006528 Scalar_SWORD 0 POD_TipToRun_CM_int16 -32768 32767 /end CHARACTERISTIC
/begin CHARACTERISTIC k_TTR_Value_ManualMinAcc "" VALUE 0xB000652A Scalar_SWORD 0 POD_TipToRun_CM_int16 -32768 32767 /end CHARACTERISTIC
/begin CHARACTERISTIC k_TTR_Value_ManualOpenACCDiff "" VAL_BLK 0xB0006578 Scalar_SWORD 0 POD_TipToRun_CM_int16 -32768 32767 MATRIX_DIM 2 /end CHARACTERISTIC
/begin CHARACTERISTIC k_TTR_Value_ManualOpenIMUBaseAngSpd "" VAL_BLK 0xB000657C Scalar_SWORD 0 POD_TipToRun_CM_int16 -32768 32767 MATRIX_DIM 2 /end CHARACTERISTIC
/begin CHARACTERISTIC k_TTR_Value_ManualOpenMaxSpeed "" VALUE 0xB000652C Scalar_SWORD 0 POD_TipToRun_CM_int16 -32768 32767 /end CHARACTERISTIC
/begin CHARACTERISTIC k_TTR_Value_ManualOpenMinSpeed "" VALUE 0xB000652E Scalar_SWORD 0 POD_TipToRun_CM_int16 -32768 32767 /end CHARACTERISTIC
/begin CHARACTERISTIC k_TTR_Value_MovInBrkgToManualCloseMinSpeed "" VAL_BLK 0xB0006580 Scalar_SWORD 0 POD_TipToRun_CM_int16 -32768 32767 MATRIX_DIM 2 /end CHARACTERISTIC
/begin CHARACTERISTIC k_TTR_Value_MovInBrkgToManualCloseOffSetSpeed "" VALUE 0xB0006530 Scalar_SWORD 0 POD_TipToRun_CM_int16 -32768 32767 /end CHARACTERISTIC
/begin CHARACTERISTIC k_TTR_Value_MovOutBrkgToManualOpenMinSpeed "" VAL_BLK 0xB0006584 Scalar_SWORD 0 POD_TipToRun_CM_int16 -32768 32767 MATRIX_DIM 2 /end CHARACTERISTIC
/begin CHARACTERISTIC k_TTR_Value_MovOutBrkgToManualOpenOffSetSpeed "" VAL_BLK 0xB0006588 Scalar_SWORD 0 POD_TipToRun_CM_int16 -32768 32767 MATRIX_DIM 2 /end CHARACTERISTIC
/begin CHARACTERISTIC k_TTR_Value_SpdLowerThdforAsst "辅助转速下限阈值" VALUE 0xB0006532 Scalar_SWORD 0 POD_TipToRun_CM_int16_rpm -9999 9999 /end CHARACTERISTIC
/begin CHARACTERISTIC k_TTR_Value_SpdThdforTTR "TTR转速阈值" VAL_BLK 0xB000658C Scalar_SWORD 0 POD_TipToRun_CM_int16_rpm -9999 9999 MATRIX_DIM 2 /end CHARACTERISTIC
/begin CHARACTERISTIC k_TTR_Value_SpdUpperThdforAsst "辅助转速上限阈值" VALUE 0xB0006534 Scalar_SWORD 0 POD_TipToRun_CM_int16_rpm -9999 9999 /end CHARACTERISTIC
/begin CHARACTERISTIC k_TTR_Value_TTRDegThd "" VAL_BLK 0xB0006590 Scalar_SWORD 0 POD_TipToRun_CM_int16 -32768 32767 MATRIX_DIM 2 /end CHARACTERISTIC
/begin MEASUREMENT monr_ADP_Value_AntiPlayActiveCounterL "" SWORD POD_FaultHandle_CM_int16 0 0 -32768 32767 ECU_ADDRESS 0xB0055B84 /end MEASUREMENT
/begin MEASUREMENT monr_VbAP_AntiPinchStsDspR_flg "" UBYTE POD_AntiPinch_CM_boolean 0 0 0 1 ECU_ADDRESS 0xB00558FD /end MEASUREMENT
/begin MEASUREMENT monr_VbAP_KeepReferenceCurrentLAP_flg "" UBYTE POD_AntiPinch_CM_boolean 0 0 0 1 ECU_ADDRESS 0xB00558AD /end MEASUREMENT
/begin MEASUREMENT monr_VbAP_KeepReferenceCurrentRAP_flg "" UBYTE POD_AntiPinch_CM_boolean 0 0 0 1 ECU_ADDRESS 0xB00558AE /end MEASUREMENT
/begin MEASUREMENT monr_VbAP_ReferenceCurrentResLAP_flg "" UBYTE POD_AntiPinch_CM_boolean 0 0 0 1 ECU_ADDRESS 0xB00558AF /end MEASUREMENT
/begin MEASUREMENT monr_VbAP_ReferenceCurrentSetLAP_flg "" UBYTE POD_AntiPinch_CM_boolean 0 0 0 1 ECU_ADDRESS 0xB00558B1 /end MEASUREMENT
/begin MEASUREMENT monr_VbAP_ReferenceCurrentSetRAP_flg "" UBYTE POD_AntiPinch_CM_boolean 0 0 0 1 ECU_ADDRESS 0xB00558B2 /end MEASUREMENT
/begin MEASUREMENT monr_VbAP_Tip2RunAntiPinchR_flg "" UBYTE POD_AntiPinch_CM_boolean 0 0 0 1 ECU_ADDRESS 0xB00558FF /end MEASUREMENT
/begin MEASUREMENT monr_VbFH_AnptiplayL_flg "" UBYTE POD_FaultHandle_CM_boolean 0 0 0 1 ECU_ADDRESS 0xB0055A9A /end MEASUREMENT
/begin MEASUREMENT monr_VbFH_ECUWakeUpL_flg "" UBYTE POD_FaultHandle_CM_boolean 0 0 0 1 ECU_ADDRESS 0xB0055A9C /end MEASUREMENT
/begin MEASUREMENT monr_VbFH_ECUWakeUpR_flg "" UBYTE POD_FaultHandle_CM_boolean 0 0 0 1 ECU_ADDRESS 0xB0055A9D /end MEASUREMENT
/begin MEASUREMENT monr_VbFH_FrntIncinAgFltR_flg "" UBYTE POD_FaultHandle_CM_boolean 0 0 0 1 ECU_ADDRESS 0xB0055AA3 /end MEASUREMENT
/begin MEASUREMENT monr_VbFH_GyroSigFltR_flg "" UBYTE POD_FaultHandle_CM_boolean 0 0 0 1 ECU_ADDRESS 0xB0055AA5 /end MEASUREMENT
/begin MEASUREMENT monr_VbFH_RdrTioutR_flg "" UBYTE POD_FaultHandle_CM_boolean 0 0 0 1 ECU_ADDRESS 0xB0055AAB /end MEASUREMENT
/begin MEASUREMENT monr_VbFH_SideIncinAgFltR_flg "" UBYTE POD_FaultHandle_CM_boolean 0 0 0 1 ECU_ADDRESS 0xB0055AAD /end MEASUREMENT
/begin MEASUREMENT monr_VbFMS_HallBSCGErrR_flg "" UBYTE POD_FaultHandle_CM_boolean 0 0 0 1 ECU_ADDRESS 0xB0055AC1 /end MEASUREMENT
/begin MEASUREMENT monr_VbFMS_MaiMotOCErrR_flg "" UBYTE POD_FaultHandle_CM_boolean 0 0 0 1 ECU_ADDRESS 0xB0055AC5 /end MEASUREMENT
/begin MEASUREMENT monr_VbFMS_MaiMotSCBErrR_flg "" UBYTE POD_FaultHandle_CM_boolean 0 0 0 1 ECU_ADDRESS 0xB0055AC9 /end MEASUREMENT
/begin MEASUREMENT monr_VbFMS_MaiMotSCGErrR_flg "" UBYTE POD_FaultHandle_CM_boolean 0 0 0 1 ECU_ADDRESS 0xB0055ACD /end MEASUREMENT
/begin MEASUREMENT monr_VbFMS_MaiMotVDSULErrR_flg "" UBYTE POD_FaultHandle_CM_boolean 0 0 0 1 ECU_ADDRESS 0xB0055AD3 /end MEASUREMENT
/begin MEASUREMENT monr_VbFMS_RAMErrR_flg "" UBYTE POD_FaultHandle_CM_boolean 0 0 0 1 ECU_ADDRESS 0xB0055ADB /end MEASUREMENT
/begin MEASUREMENT monr_VbFMS_RdrTimeOutRaw_flg "" UBYTE POD_FaultHandle_CM_boolean 0 0 0 1 ECU_ADDRESS 0xB0055ADF /end MEASUREMENT
/begin MEASUREMENT monr_VbHHM_ASWBSWHallInitL_flg "" UBYTE POD_HallHandleModule_TZCU_CM_boolean 0 0 0 1 ECU_ADDRESS 0xB0055B9C /end MEASUREMENT
/begin MEASUREMENT monr_VbHHM_BooleanDownRHHM_flg "" UBYTE POD_HallHandleModule_TZCU_CM_boolean 0 0 0 1 ECU_ADDRESS 0xB0055B9F /end MEASUREMENT
/begin MEASUREMENT monr_VbHHM_BooleanHoldRHHM_flg "" UBYTE POD_HallHandleModule_TZCU_CM_boolean 0 0 0 1 ECU_ADDRESS 0xB0055BA1 /end MEASUREMENT
/begin MEASUREMENT monr_VbHHM_BooleanManualDownRHHM_flg "" UBYTE POD_HallHandleModule_TZCU_CM_boolean 0 0 0 1 ECU_ADDRESS 0xB0055BA3 /end MEASUREMENT
/begin MEASUREMENT monr_VbHHM_BooleanManualUpRHHM_flg "" UBYTE POD_HallHandleModule_TZCU_CM_boolean 0 0 0 1 ECU_ADDRESS 0xB0055BA5 /end MEASUREMENT
/begin MEASUREMENT monr_VbHHM_BooleanUpRHHM_flg "" UBYTE POD_HallHandleModule_TZCU_CM_boolean 0 0 0 1 ECU_ADDRESS 0xB0055BA7 /end MEASUREMENT
/begin MEASUREMENT monr_VbHHM_CloseTheDoorHallErrRHHM_flg "" UBYTE POD_HallHandleModule_TZCU_CM_boolean 0 0 0 1 ECU_ADDRESS 0xB0055BA9 /end MEASUREMENT
/begin MEASUREMENT monr_VbHHM_DoorAbsPstnInitLHHM_flg "" UBYTE POD_HallHandleModule_TZCU_CM_boolean 0 0 0 1 ECU_ADDRESS 0xB0055BAA /end MEASUREMENT
/begin MEASUREMENT monr_VbHHM_DoorOpenLHHM_flg "" UBYTE POD_HallHandleModule_TZCU_CM_boolean 0 0 0 1 ECU_ADDRESS 0xB0055BAD /end MEASUREMENT
/begin MEASUREMENT monr_VbHHM_DoorOpenR_flg "" UBYTE POD_HallHandleModule_TZCU_CM_boolean 0 0 0 1 ECU_ADDRESS 0xB0055BAE /end MEASUREMENT
/begin MEASUREMENT monr_VbHHM_DoorPstnInitLHHM_flg "" UBYTE POD_HallHandleModule_TZCU_CM_boolean 0 0 0 1 ECU_ADDRESS 0xB0055BB0 /end MEASUREMENT
/begin MEASUREMENT monr_VbHHM_DoorRelPstnInitLHHM_flg "" UBYTE POD_HallHandleModule_TZCU_CM_boolean 0 0 0 1 ECU_ADDRESS 0xB0055BB2 /end MEASUREMENT
/begin MEASUREMENT monr_VbHHM_HALLAErrEnableRHHM_flg "" UBYTE POD_HallHandleModule_TZCU_CM_boolean 0 0 0 1 ECU_ADDRESS 0xB0055BB5 /end MEASUREMENT
/begin MEASUREMENT monr_VbHHM_HALLAFaultRHHM_flg "" UBYTE POD_HallHandleModule_TZCU_CM_boolean 0 0 0 1 ECU_ADDRESS 0xB0055BB7 /end MEASUREMENT
/begin MEASUREMENT monr_VbHHM_HallErrEnableRHHM_flg "" UBYTE POD_HallHandleModule_TZCU_CM_boolean 0 0 0 1 ECU_ADDRESS 0xB0055BB9 /end MEASUREMENT
/begin MEASUREMENT monr_VbHHM_HallErrLHHM_flg "" UBYTE POD_HallHandleModule_TZCU_CM_boolean 0 0 0 1 ECU_ADDRESS 0xB0055BBA /end MEASUREMENT
/begin MEASUREMENT monr_VbHHM_HallErrSpeedLHHM_flg "" UBYTE POD_HallHandleModule_TZCU_CM_boolean 0 0 0 1 ECU_ADDRESS 0xB0055BBC /end MEASUREMENT
/begin MEASUREMENT monr_VbHHM_HallSigFltL_flg "" UBYTE POD_HallHandleModule_TZCU_CM_boolean 0 0 0 1 ECU_ADDRESS 0xB0055BC2 /end MEASUREMENT
/begin MEASUREMENT monr_VbHHM_InitErrorLHHM_flg "" UBYTE POD_HallHandleModule_TZCU_CM_boolean 0 0 0 1 ECU_ADDRESS 0xB0055BC4 /end MEASUREMENT
/begin MEASUREMENT monr_VbHHM_Lck2DrStsErrLHHM_flg "" UBYTE POD_HallHandleModule_TZCU_CM_boolean 0 0 0 1 ECU_ADDRESS 0xB0055BC6 /end MEASUREMENT
/begin MEASUREMENT monr_VbHHM_NVMHallEnableLHHM_flg "" UBYTE POD_HallHandleModule_TZCU_CM_boolean 0 0 0 1 ECU_ADDRESS 0xB0055BC8 /end MEASUREMENT
/begin MEASUREMENT monr_VbHHM_OnlyHallPWMErrRHHM_flg "" UBYTE POD_HallHandleModule_TZCU_CM_boolean 0 0 0 1 ECU_ADDRESS 0xB0055BCB /end MEASUREMENT
/begin MEASUREMENT monr_VbHHM_OpenTheDoorHallErrRHHM_flg "" UBYTE POD_HallHandleModule_TZCU_CM_boolean 0 0 0 1 ECU_ADDRESS 0xB0055BCD /end MEASUREMENT
/begin MEASUREMENT monr_VbHHM_PreClsdRHHM_flg "" UBYTE POD_HallHandleModule_TZCU_CM_boolean 0 0 0 1 ECU_ADDRESS 0xB0055BCF /end MEASUREMENT
/begin MEASUREMENT monr_VbHHM_PreOpenRHHM_flg "" UBYTE POD_HallHandleModule_TZCU_CM_boolean 0 0 0 1 ECU_ADDRESS 0xB0055BD1 /end MEASUREMENT
/begin MEASUREMENT monr_VbSMM_BrkFrcRelsL_flg "" UBYTE POD_SMML_CM_boolean 0 0 0 1 ECU_ADDRESS 0xB0055FEE /end MEASUREMENT
/begin MEASUREMENT monr_VbSMM_BrkFrcRelsR_flg "" UBYTE POD_SMMR_CM_boolean 0 0 0 1 ECU_ADDRESS 0xB00560B8 /end MEASUREMENT
/begin MEASUREMENT monr_VbSMM_BrkMotModCtrlL_flg "" UBYTE POD_SMML_CM_boolean 0 0 0 1 ECU_ADDRESS 0xB0055FEC /end MEASUREMENT
/begin MEASUREMENT monr_VbSMM_BrkMotModCtrlR_flg "" UBYTE POD_SMMR_CM_boolean 0 0 0 1 ECU_ADDRESS 0xB00560B7 /end MEASUREMENT
/begin MEASUREMENT monr_VbSMM_DoorFreeMovgL_flg "" UBYTE POD_SMML_CM_boolean 0 0 0 1 ECU_ADDRESS 0xB0055FE7 /end MEASUREMENT
/begin MEASUREMENT monr_VbSMM_DoorFreeMovgR_flg "" UBYTE POD_SMMR_CM_boolean 0 0 0 1 ECU_ADDRESS 0xB00560B2 /end MEASUREMENT
/begin MEASUREMENT monr_VbSMM_ElecDoorClsReqL_flg "" UBYTE POD_SMML_CM_boolean 0 0 0 1 ECU_ADDRESS 0xB0055FF0 /end MEASUREMENT
/begin MEASUREMENT monr_VbSMM_ElecDoorClsReqR_flg "" UBYTE POD_SMMR_CM_boolean 0 0 0 1 ECU_ADDRESS 0xB00560BC /end MEASUREMENT
/begin MEASUREMENT monr_VbSMM_ElecDoorOpenReqL_flg "" UBYTE POD_SMML_CM_boolean 0 0 0 1 ECU_ADDRESS 0xB0055FF3 /end MEASUREMENT
/begin MEASUREMENT monr_VbSMM_ElecDoorOpenReqR_flg "" UBYTE POD_SMMR_CM_boolean 0 0 0 1 ECU_ADDRESS 0xB00560BD /end MEASUREMENT
/begin MEASUREMENT monr_VbSMM_HoldModeL_flg "" UBYTE POD_SMML_CM_boolean 0 0 0 1 ECU_ADDRESS 0xB0055FF2 /end MEASUREMENT
/begin MEASUREMENT monr_VbSMM_HoldModeR_flg "" UBYTE POD_SMMR_CM_boolean 0 0 0 1 ECU_ADDRESS 0xB00560BE /end MEASUREMENT
/begin MEASUREMENT monr_VbSMM_ManAsstEnableL_flg "" UBYTE POD_SMML_CM_boolean 0 0 0 1 ECU_ADDRESS 0xB0055FE8 /end MEASUREMENT
/begin MEASUREMENT monr_VbSMM_ManAsstEnableR_flg "" UBYTE POD_SMMR_CM_boolean 0 0 0 1 ECU_ADDRESS 0xB00560B5 /end MEASUREMENT
/begin MEASUREMENT monr_VbSMM_RdrWrkReqByCEML_flg "" UBYTE POD_SMML_CM_boolean 0 0 0 1 ECU_ADDRESS 0xB0055FEA /end MEASUREMENT
/begin MEASUREMENT monr_VbSMM_RdrWrkReqByCEMR_flg "" UBYTE POD_SMMR_CM_boolean 0 0 0 1 ECU_ADDRESS 0xB00560BB /end MEASUREMENT
/begin MEASUREMENT monr_VbSMM_RdrWrkReqL_flg "" UBYTE POD_SMML_CM_boolean 0 0 0 1 ECU_ADDRESS 0xB0055FE9 /end MEASUREMENT
/begin MEASUREMENT monr_VbSMM_RdrWrkReqR_flg "" UBYTE POD_SMMR_CM_boolean 0 0 0 1 ECU_ADDRESS 0xB00560B9 /end MEASUREMENT
/begin MEASUREMENT monr_VbSMM_TiptoRunEnableL_flg "" UBYTE POD_SMML_CM_boolean 0 0 0 1 ECU_ADDRESS 0xB0056052 /end MEASUREMENT
/begin MEASUREMENT monr_VbSMM_TiptoRunEnableR_flg "" UBYTE POD_SMMR_CM_boolean 0 0 0 1 ECU_ADDRESS 0xB00560B3 /end MEASUREMENT
/begin MEASUREMENT monr_VbTTR_BanCloseIMUErrorJudgeLTTR_flg "" UBYTE POD_TipToRun_CM_boolean 0 0 0 1 ECU_ADDRESS 0xB00560C2 /end MEASUREMENT
/begin MEASUREMENT monr_VbTTR_BanCloseIMUErrorJudgeRTTR_flg "" UBYTE POD_TipToRun_CM_boolean 0 0 0 1 ECU_ADDRESS 0xB00560C3 /end MEASUREMENT
/begin MEASUREMENT monr_VbTTR_BanOpenIMUErrorJudgeLTTR_flg "" UBYTE POD_TipToRun_CM_boolean 0 0 0 1 ECU_ADDRESS 0xB00560C4 /end MEASUREMENT
/begin MEASUREMENT monr_VbTTR_BanOpenIMUErrorJudgeRTTR_flg "" UBYTE POD_TipToRun_CM_boolean 0 0 0 1 ECU_ADDRESS 0xB00560C5 /end MEASUREMENT
/begin MEASUREMENT monr_VbTTR_ElecBrkgToAssistCloseLTTR_flg "" UBYTE POD_TipToRun_CM_boolean 0 0 0 1 ECU_ADDRESS 0xB00560C6 /end MEASUREMENT
/begin MEASUREMENT monr_VbTTR_ElecBrkgToAssistCloseRTTR_flg "" UBYTE POD_TipToRun_CM_boolean 0 0 0 1 ECU_ADDRESS 0xB00560C7 /end MEASUREMENT
/begin MEASUREMENT monr_VbTTR_ElecBrkgToAssistOpenLTTR_flg "" UBYTE POD_TipToRun_CM_boolean 0 0 0 1 ECU_ADDRESS 0xB00560C8 /end MEASUREMENT
/begin MEASUREMENT monr_VbTTR_ElecBrkgToAssistOpenRTTR_flg "" UBYTE POD_TipToRun_CM_boolean 0 0 0 1 ECU_ADDRESS 0xB00560C9 /end MEASUREMENT
/begin MEASUREMENT monr_VbTTR_ElecToAssistCloseLTTR_flg "" UBYTE POD_TipToRun_CM_boolean 0 0 0 1 ECU_ADDRESS 0xB00560CA /end MEASUREMENT
/begin MEASUREMENT monr_VbTTR_ElecToAssistCloseSpeedLTTR_flg "" UBYTE POD_TipToRun_CM_boolean 0 0 0 1 ECU_ADDRESS 0xB00560CB /end MEASUREMENT
/begin MEASUREMENT monr_VbTTR_ElecToAssistCloseSpeedRTTR_flg "" UBYTE POD_TipToRun_CM_boolean 0 0 0 1 ECU_ADDRESS 0xB00560CC /end MEASUREMENT
/begin MEASUREMENT monr_VbTTR_ElecToAssistClose_flg "" UBYTE POD_TipToRun_CM_boolean 0 0 0 1 ECU_ADDRESS 0xB00561B4 /end MEASUREMENT
/begin MEASUREMENT monr_VbTTR_ElecToAssistOpenLTTR_flg "" UBYTE POD_TipToRun_CM_boolean 0 0 0 1 ECU_ADDRESS 0xB00560CD /end MEASUREMENT
/begin MEASUREMENT monr_VbTTR_ElecToAssistOpenSpeedLTTR_flg "" UBYTE POD_TipToRun_CM_boolean 0 0 0 1 ECU_ADDRESS 0xB00560CE /end MEASUREMENT
/begin MEASUREMENT monr_VbTTR_ElecToAssistOpenSpeedRTTR_flg "" UBYTE POD_TipToRun_CM_boolean 0 0 0 1 ECU_ADDRESS 0xB00560CF /end MEASUREMENT
/begin MEASUREMENT monr_VbTTR_ElecToAssistOpen_flg "" UBYTE POD_TipToRun_CM_boolean 0 0 0 1 ECU_ADDRESS 0xB00561B5 /end MEASUREMENT
/begin MEASUREMENT monr_VbTTR_HoldModeManAssistRTTR_flg "" UBYTE POD_TipToRun_CM_boolean 0 0 0 1 ECU_ADDRESS 0xB00560D1 /end MEASUREMENT
/begin MEASUREMENT monr_VbTTR_HoldPosExitRTTR_flg "" UBYTE POD_TipToRun_CM_boolean 0 0 0 1 ECU_ADDRESS 0xB00560D3 /end MEASUREMENT
/begin MEASUREMENT monr_VbTTR_IMUAngSpdAccToCloseLTTR_flg "" UBYTE POD_TipToRun_CM_boolean 0 0 0 1 ECU_ADDRESS 0xB00560D4 /end MEASUREMENT
/begin MEASUREMENT monr_VbTTR_IMUAngSpdToCloseLTTR_flg "" UBYTE POD_TipToRun_CM_boolean 0 0 0 1 ECU_ADDRESS 0xB00560DC /end MEASUREMENT
/begin MEASUREMENT monr_VbTTR_IMUAngSpdToCloseRTTR_flg "" UBYTE POD_TipToRun_CM_boolean 0 0 0 1 ECU_ADDRESS 0xB00560DD /end MEASUREMENT
/begin MEASUREMENT monr_VbTTR_IMUAngSpdToOpenLTTR_flg "" UBYTE POD_TipToRun_CM_boolean 0 0 0 1 ECU_ADDRESS 0xB00560DE /end MEASUREMENT
/begin MEASUREMENT monr_VbTTR_IMUAngSpdToOpenRTTR_flg "" UBYTE POD_TipToRun_CM_boolean 0 0 0 1 ECU_ADDRESS 0xB00560DF /end MEASUREMENT
/begin MEASUREMENT monr_VbTTR_IMUToManualCloseLTTR_flg "" UBYTE POD_TipToRun_CM_boolean 0 0 0 1 ECU_ADDRESS 0xB00560E0 /end MEASUREMENT
/begin MEASUREMENT monr_VbTTR_IMUToManualCloseRTTR_flg "" UBYTE POD_TipToRun_CM_boolean 0 0 0 1 ECU_ADDRESS 0xB00560E1 /end MEASUREMENT
/begin MEASUREMENT monr_VbTTR_ImuAngSpdCloseAccLTTR_flg "" UBYTE POD_TipToRun_CM_boolean 0 0 0 1 ECU_ADDRESS 0xB00560D8 /end MEASUREMENT
/begin MEASUREMENT monr_VbTTR_ImuAngSpdCloseAccRTTR_flg "" UBYTE POD_TipToRun_CM_boolean 0 0 0 1 ECU_ADDRESS 0xB00560D9 /end MEASUREMENT
/begin MEASUREMENT monr_VbTTR_ImuAngSpdOpenAccLTTR_flg "" UBYTE POD_TipToRun_CM_boolean 0 0 0 1 ECU_ADDRESS 0xB00560DA /end MEASUREMENT
/begin MEASUREMENT monr_VbTTR_ImuAngSpdOpenAccRTTR_flg "" UBYTE POD_TipToRun_CM_boolean 0 0 0 1 ECU_ADDRESS 0xB00560DB /end MEASUREMENT
/begin MEASUREMENT monr_VbTTR_ManualAssistCloseLTTR_flg "" UBYTE POD_TipToRun_CM_boolean 0 0 0 1 ECU_ADDRESS 0xB00560E2 /end MEASUREMENT
/begin MEASUREMENT monr_VbTTR_ManualAssistCloseRTTR_flg "" UBYTE POD_TipToRun_CM_boolean 0 0 0 1 ECU_ADDRESS 0xB00560E3 /end MEASUREMENT
/begin MEASUREMENT monr_VbTTR_ManualAssistOpenLTTR_flg "" UBYTE POD_TipToRun_CM_boolean 0 0 0 1 ECU_ADDRESS 0xB00560E4 /end MEASUREMENT
/begin MEASUREMENT monr_VbTTR_ManualAssistOpenRTTR_flg "" UBYTE POD_TipToRun_CM_boolean 0 0 0 1 ECU_ADDRESS 0xB00560E5 /end MEASUREMENT
/begin MEASUREMENT monr_VbTTR_ManualCloseMovMinPosJudgeLTTR_flg "" UBYTE POD_TipToRun_CM_boolean 0 0 0 1 ECU_ADDRESS 0xB00560E6 /end MEASUREMENT
/begin MEASUREMENT monr_VbTTR_ManualCloseMovMinPosJudgeRTTR_flg "" UBYTE POD_TipToRun_CM_boolean 0 0 0 1 ECU_ADDRESS 0xB00560E7 /end MEASUREMENT
/begin MEASUREMENT monr_VbTTR_ManualHallSpeedBackLTTR_flg "" UBYTE POD_TipToRun_CM_boolean 0 0 0 1 ECU_ADDRESS 0xB00560E8 /end MEASUREMENT
/begin MEASUREMENT monr_VbTTR_ManualHallSpeedBackRTTR_flg "" UBYTE POD_TipToRun_CM_boolean 0 0 0 1 ECU_ADDRESS 0xB00560E9 /end MEASUREMENT
/begin MEASUREMENT monr_VbTTR_ManualOpenMaxHallPosDecLTTR_flg "" UBYTE POD_TipToRun_CM_boolean 0 0 0 1 ECU_ADDRESS 0xB00560EA /end MEASUREMENT
/begin MEASUREMENT monr_VbTTR_ManualOpenMaxHallPosDecRTTR_flg "" UBYTE POD_TipToRun_CM_boolean 0 0 0 1 ECU_ADDRESS 0xB00560EB /end MEASUREMENT
/begin MEASUREMENT monr_VbTTR_ManualOpenMaxHallPosNoWaitLTTR_flg "" UBYTE POD_TipToRun_CM_boolean 0 0 0 1 ECU_ADDRESS 0xB00560EC /end MEASUREMENT
/begin MEASUREMENT monr_VbTTR_ManualOpenMaxHallPosNoWaitRTTR_flg "" UBYTE POD_TipToRun_CM_boolean 0 0 0 1 ECU_ADDRESS 0xB00560ED /end MEASUREMENT
/begin MEASUREMENT monr_VbTTR_ManualOpenToCloseMaxRangeLTTR_flg "" UBYTE POD_TipToRun_CM_boolean 0 0 0 1 ECU_ADDRESS 0xB00560EE /end MEASUREMENT
/begin MEASUREMENT monr_VbTTR_ManualOpenToCloseMaxRangeRTTR_flg "" UBYTE POD_TipToRun_CM_boolean 0 0 0 1 ECU_ADDRESS 0xB00560EF /end MEASUREMENT
/begin MEASUREMENT monr_VbTTR_MuanBrkgZeroDistanceLTTR_flg "" UBYTE POD_TipToRun_CM_boolean 0 0 0 1 ECU_ADDRESS 0xB00560F0 /end MEASUREMENT
/begin MEASUREMENT monr_VbTTR_MuanBrkgZeroDistanceRTTR_flg "" UBYTE POD_TipToRun_CM_boolean 0 0 0 1 ECU_ADDRESS 0xB00560F1 /end MEASUREMENT
/begin MEASUREMENT monr_VbTTR_StopToAssistClose_flg "" UBYTE POD_TipToRun_CM_boolean 0 0 0 1 ECU_ADDRESS 0xB00561B7 /end MEASUREMENT
/begin MEASUREMENT monr_VbTTR_StopToAssistOpen_flg "" UBYTE POD_TipToRun_CM_boolean 0 0 0 1 ECU_ADDRESS 0xB00561B6 /end MEASUREMENT
/begin MEASUREMENT monr_VeFH_DoorLckPstnR_enum "" UBYTE POD_FaultHandle_CM_uint8 0 0 0 255 ECU_ADDRESS 0xB0055B05 /end MEASUREMENT
/begin MEASUREMENT monr_VeFMS_MaiMotErrR_NULL "" UBYTE POD_FaultHandle_CM_uint8 0 0 0 255 ECU_ADDRESS 0xB0055B0C /end MEASUREMENT
/begin MEASUREMENT monr_VeHHM_DoorMovStsR_NULL "" UBYTE POD_HallHandleModule_TZCU_CM_uint8 0 0 0 255 ECU_ADDRESS 0xB0055BD5 /end MEASUREMENT
/begin MEASUREMENT monr_VeHHM_UsrSetMaxPstnR_pct "" UBYTE POD_HallHandleModule_TZCU_CM_uint8 0 0 0 255 ECU_ADDRESS 0xB0055BD9 /end MEASUREMENT
/begin MEASUREMENT monr_VeSHM_DoorWrkReqL_enum "" UBYTE POD_SignalHandModule_T_CM_uint8 0 0 0 255 ECU_ADDRESS 0xB0055EE2 /end MEASUREMENT
/begin MEASUREMENT monr_VeSHM_DoorWrkReqR_enum "" UBYTE POD_SignalHandModule_T_CM_uint8 0 0 0 255 ECU_ADDRESS 0xB0055EE3 /end MEASUREMENT
/begin MEASUREMENT monr_VeSMM_DOPFcnStateL_enum "" UBYTE POD_SMML_CM_uint8 0 0 0 255 ECU_ADDRESS 0xB0055FEB /end MEASUREMENT
/begin MEASUREMENT monr_VeSMM_DOPFcnStateR_enum "" UBYTE POD_SMMR_CM_uint8 0 0 0 255 ECU_ADDRESS 0xB00560A5 /end MEASUREMENT
/begin MEASUREMENT monr_VeSMM_DoorLatPosnL_enum "" UBYTE POD_SMML_CM_uint8 0 0 0 255 ECU_ADDRESS 0xB0056007 /end MEASUREMENT
/begin MEASUREMENT monr_VeSMM_DoorLatPosnR_enum "" UBYTE POD_SMMR_CM_uint8 0 0 0 255 ECU_ADDRESS 0xB00560A9 /end MEASUREMENT
/begin MEASUREMENT monr_VeSMM_HoverModCtrlL_enum "" UBYTE POD_SMML_CM_uint8 0 0 0 255 ECU_ADDRESS 0xB0055FED /end MEASUREMENT
/begin MEASUREMENT monr_VeSMM_HoverModCtrlR_enum "" UBYTE POD_SMMR_CM_uint8 0 0 0 255 ECU_ADDRESS 0xB00560B6 /end MEASUREMENT
/begin MEASUREMENT monr_VeSMM_MotorCtrlModeL_enum "" UBYTE POD_SMML_CM_uint8 0 0 0 255 ECU_ADDRESS 0xB0055FE6 /end MEASUREMENT
/begin MEASUREMENT monr_VeSMM_MotorCtrlModeR_enum "" UBYTE POD_SMMR_CM_uint8 0 0 0 255 ECU_ADDRESS 0xB00560A7 /end MEASUREMENT
/begin MEASUREMENT monr_VeSMM_MotorCtrlStateL_enum "" UBYTE POD_SMML_CM_uint8 0 0 0 255 ECU_ADDRESS 0xB0055FF1 /end MEASUREMENT
/begin MEASUREMENT monr_VeSMM_MotorCtrlStateR_enum "" UBYTE POD_SMMR_CM_uint8 0 0 0 255 ECU_ADDRESS 0xB00560A8 /end MEASUREMENT
/begin MEASUREMENT monr_VeSMM_OpenDoorCmdL_enum "" UBYTE POD_SMML_CM_uint8 0 0 0 255 ECU_ADDRESS 0xB0055FFC /end MEASUREMENT
/begin MEASUREMENT monr_VeSMM_OpenDoorCmdR_enum "" UBYTE POD_SMMR_CM_uint8 0 0 0 255 ECU_ADDRESS 0xB00560AA /end MEASUREMENT
/begin MEASUREMENT monr_VeSMM_PushLockL_NULL "" UBYTE POD_SMML_CM_uint8 0 0 0 255 ECU_ADDRESS 0xB0056024 /end MEASUREMENT
/begin MEASUREMENT monr_VeSMM_PushLockR_NULL "" UBYTE POD_SMMR_CM_uint8 0 0 0 255 ECU_ADDRESS 0xB00560AB /end MEASUREMENT
/begin MEASUREMENT monr_VeSMM_StopEventL_enum "" UBYTE POD_SMML_CM_uint8 0 0 0 255 ECU_ADDRESS 0xB005603C /end MEASUREMENT
/begin MEASUREMENT monr_VeSMM_StopEventR_enum "" UBYTE POD_SMMR_CM_uint8 0 0 0 255 ECU_ADDRESS 0xB00560B0 /end MEASUREMENT
/begin MEASUREMENT monr_VeSMM_VehModStsL_enum "" UBYTE POD_SMML_CM_uint8 0 0 0 255 ECU_ADDRESS 0xB0056051 /end MEASUREMENT
/begin MEASUREMENT monr_VeSMM_VehModStsR_enum "" UBYTE POD_SMMR_CM_uint8 0 0 0 255 ECU_ADDRESS 0xB00560B1 /end MEASUREMENT
/begin MEASUREMENT monr_VfAP_ValueBrkgCompenLAP_MA "" FLOAT32_IEEE POD_AntiPinch_CM_single 0 0 -3.4e+38 3.4e+38 ECU_ADDRESS 0xB00558BC /end MEASUREMENT
/begin MEASUREMENT monr_VfAP_ValueReferenceCurrentCmpLAP_MA "" FLOAT32_IEEE POD_AntiPinch_CM_single 0 0 -3.4e+38 3.4e+38 ECU_ADDRESS 0xB00558D4 /end MEASUREMENT
/begin MEASUREMENT monr_VfAP_ValueReferenceCurrentLAP_MA "" FLOAT32_IEEE POD_AntiPinch_CM_single 0 0 -3.4e+38 3.4e+38 ECU_ADDRESS 0xB00558DC /end MEASUREMENT
/begin MEASUREMENT monr_VfAP_ValueSlopeCompenLAP_MA "" FLOAT32_IEEE POD_AntiPinch_CM_single 0 0 -3.4e+38 3.4e+38 ECU_ADDRESS 0xB00558EC /end MEASUREMENT
/begin MEASUREMENT monr_VfHHM_AswHallPositionR_deg "" FLOAT32_IEEE POD_HallHandleModule_TZCU_CM_single 0 0 -3.4e+38 3.4e+38 ECU_ADDRESS 0xB0055BF4 /end MEASUREMENT
/begin MEASUREMENT monr_VfHHM_DoorPstnR_pct "" FLOAT32_IEEE POD_HallHandleModule_TZCU_CM_single 0 0 -3.4e+38 3.4e+38 ECU_ADDRESS 0xB0055BFC /end MEASUREMENT
/begin MEASUREMENT monr_VfHHM_HallFixedTiOffsetLHHM_NULL "" FLOAT32_IEEE POD_HallHandleModule_TZCU_CM_single 0 0 -3.4e+38 3.4e+38 ECU_ADDRESS 0xB0055C00 /end MEASUREMENT
/begin MEASUREMENT monr_VfHHM_HallSpeedDirectionLHHM_NULL "" FLOAT32_IEEE POD_HallHandleModule_TZCU_CM_single 0 0 -3.4e+38 3.4e+38 ECU_ADDRESS 0xB0055C08 /end MEASUREMENT
/begin MEASUREMENT monr_VfHHM_MaxOpenPositionR_deg "" FLOAT32_IEEE POD_HallHandleModule_TZCU_CM_single 0 0 -3.4e+38 3.4e+38 ECU_ADDRESS 0xB0055C14 /end MEASUREMENT
/begin MEASUREMENT monr_VfSHM_FrntIncinAgL_deg "" FLOAT32_IEEE POD_SignalHandModule_T_CM_single 0 0 -3.4e+38 3.4e+38 ECU_ADDRESS 0xB0055F8C /end MEASUREMENT
/begin MEASUREMENT monr_VfSHM_SideIncinAgL_deg "" FLOAT32_IEEE POD_SignalHandModule_T_CM_single 0 0 -3.4e+38 3.4e+38 ECU_ADDRESS 0xB0055FAC /end MEASUREMENT
/begin MEASUREMENT monr_VfSHM_VehSpdLgt_mps "" FLOAT32_IEEE POD_SignalHandModule_T_CM_single 0 0 -3.4e+38 3.4e+38 ECU_ADDRESS 0xB0055FB8 /end MEASUREMENT
/begin MEASUREMENT monr_VfSMM_TopDegforDoorOpenL_NULL "" FLOAT32_IEEE POD_SMML_CM_single 0 0 -3.4e+38 3.4e+38 ECU_ADDRESS 0xB005604C /end MEASUREMENT
/begin MEASUREMENT monr_VfSMM_TopDegforDoorOpenR_NULL "" FLOAT32_IEEE POD_SMMR_CM_single 0 0 -3.4e+38 3.4e+38 ECU_ADDRESS 0xB00560AC /end MEASUREMENT
/begin MEASUREMENT monr_VsHHM_AntiPinchHallPositionL_NULL "" SWORD POD_HallHandleModule_TZCU_CM_int16 0 0 -32768 32767 ECU_ADDRESS 0xB0055C38 /end MEASUREMENT
/begin MEASUREMENT monr_VsHHM_AswHallAccL_g "" SWORD POD_HallHandleModule_TZCU_CM_int16 0 0 -32768 32767 ECU_ADDRESS 0xB0055C3C /end MEASUREMENT
/begin MEASUREMENT monr_VsHHM_AswHallPosSpeedLHHM_rpm "" SWORD POD_HallHandleModule_TZCU_CM_int16 0 0 -32768 32767 ECU_ADDRESS 0xB0055C44 /end MEASUREMENT
/begin MEASUREMENT monr_VsHHM_AswHallPositionR_NULL "" SWORD POD_HallHandleModule_TZCU_CM_int16 0 0 -32768 32767 ECU_ADDRESS 0xB0055C42 /end MEASUREMENT
/begin MEASUREMENT monr_VsHHM_AswHallSpeedL_rpm "" SWORD POD_HallHandleModule_TZCU_CM_int16 0 0 -32768 32767 ECU_ADDRESS 0xB0055C48 /end MEASUREMENT
/begin MEASUREMENT monr_VsHHM_HallCntrR_NULL "" SWORD POD_HallHandleModule_TZCU_CM_int16 0 0 -32768 32767 ECU_ADDRESS 0xB0055C4E /end MEASUREMENT
/begin MEASUREMENT monr_VsHHM_OrigValueAntiPinchHallPositionLHHM_NULL "" SWORD POD_HallHandleModule_TZCU_CM_int16 0 0 -32768 32767 ECU_ADDRESS 0xB0055C54 /end MEASUREMENT
/begin MEASUREMENT monr_VsHHM_OrigValueHallPositionLHHM_NULL "" SWORD POD_HallHandleModule_TZCU_CM_int16 0 0 -32768 32767 ECU_ADDRESS 0xB0055C58 /end MEASUREMENT
/begin MEASUREMENT monr_VsTTR_PluseHoldPosRTTR_deg "" SWORD POD_TipToRun_CM_int16 0 0 -32768 32767 ECU_ADDRESS 0xB005614E /end MEASUREMENT
/begin MEASUREMENT monr_VsTTR_ValueManualCloseMinHallPosLTTR_deg "" SWORD POD_TipToRun_CM_int16 0 0 -32768 32767 ECU_ADDRESS 0xB0056150 /end MEASUREMENT
/begin MEASUREMENT monr_VsTTR_ValueManualCloseMinHallPosRTTR_deg "" SWORD POD_TipToRun_CM_int16 0 0 -32768 32767 ECU_ADDRESS 0xB0056152 /end MEASUREMENT
/begin MEASUREMENT monr_VsTTR_ValueManualOpenMaxHallPosLTTR_deg "" SWORD POD_TipToRun_CM_int16 0 0 -32768 32767 ECU_ADDRESS 0xB0056154 /end MEASUREMENT
/begin MEASUREMENT monr_VsTTR_ValueManualOpenMaxHallPosRTTR_deg "" SWORD POD_TipToRun_CM_int16 0 0 -32768 32767 ECU_ADDRESS 0xB0056156 /end MEASUREMENT
/begin MEASUREMENT monr_VsTTR_ValueMovInBrkgInitPositionLTTR_deg "" SWORD POD_TipToRun_CM_int16 0 0 -32768 32767 ECU_ADDRESS 0xB0056158 /end MEASUREMENT
/begin MEASUREMENT monr_VsTTR_ValueMovInBrkgInitPositionRTTR_deg "" SWORD POD_TipToRun_CM_int16 0 0 -32768 32767 ECU_ADDRESS 0xB005615A /end MEASUREMENT
/begin MEASUREMENT monr_VsTTR_ValueMovOutBrkgInitPositionLTTR_deg "" SWORD POD_TipToRun_CM_int16 0 0 -32768 32767 ECU_ADDRESS 0xB005615C /end MEASUREMENT
/begin MEASUREMENT monr_VsTTR_ValueMovOutBrkgInitPositionRTTR_deg "" SWORD POD_TipToRun_CM_int16 0 0 -32768 32767 ECU_ADDRESS 0xB005615E /end MEASUREMENT
/begin MEASUREMENT monr_VsTTR_ValueOriManualOpenMaxHallPosLTTR_deg "" SWORD POD_TipToRun_CM_int16 0 0 -32768 32767 ECU_ADDRESS 0xB0056160 /end MEASUREMENT
/begin MEASUREMENT monr_VsTTR_ValueOriManualOpenMaxHallPosRTTR_deg "" SWORD POD_TipToRun_CM_int16 0 0 -32768 32767 ECU_ADDRESS 0xB0056162 /end MEASUREMENT
/begin MEASUREMENT monr_VsTTR_VauleManualCloseBaseAngSpdLTTR_degps "" SWORD POD_TipToRun_CM_int16 0 0 -32768 32767 ECU_ADDRESS 0xB0056164 /end MEASUREMENT
/begin GROUP S109_ReferenceCurrentSet "POD_AntiPinch/POD_AntiPinch/AntiPinch/AntiPinchR/AntiPinchCurOffset/ReferenceCurrent/KeepReferenceCurrentFlag/ReferenceCurrentSet" /begin SUB_GROUP S114_Rising_Debounce S114_Rising_Debounce2 /end SUB_GROUP
 /begin REF_CHARACTERISTIC K_ADP_Value_ErrPositionDiffMin k_ADP_Value_CurrentIncMinRateforAntiPinch k_ADP_Value_ErrPosCurMinRateforAntiPinch k_ADP_Value_PosErrHoldRateforAntiPinch /end REF_CHARACTERISTIC
 /begin REF_MEASUREMENT monr_VbAP_ReferenceCurrentSetRAP_flg /end REF_MEASUREMENT
/end GROUP
/begin GROUP S109_RS "POD_AntiPinch/POD_AntiPinch/AntiPinch/AntiPinchR/AntiPinchCurOffset/ReferenceCurrent/KeepReferenceCurrentFlag/RS" /begin SUB_GROUP S112_Switch1 /end SUB_GROUP /end GROUP
/begin GROUP S10_INPL "POD_SignalHandModule_T/POD_SignalHandModule/SignalHandModule/INP/INPL" /begin SUB_GROUP S22_CEM /end SUB_GROUP /end GROUP
/begin GROUP S10_INPR "POD_SignalHandModule_T/POD_SignalHandModule/SignalHandModule/INP/INPR" /begin SUB_GROUP S23_ADCHandleModule S23_CEM S23_DIO /end SUB_GROUP /end GROUP
/begin GROUP S110_Rising_Debounce "POD_AntiPinch/POD_AntiPinch/AntiPinch/AntiPinchR/AntiPinchCurOffset/ReferenceCurrent/ReferenceCurrent/Rising Debounce"
 /begin REF_CHARACTERISTIC k_ADP_Ti_AntiPinchSequenceTimer k_ADP_Ti_MinPositionDelayTimer /end REF_CHARACTERISTIC
/end GROUP
/begin GROUP S112_Switch1 "POD_AntiPinch/POD_AntiPinch/AntiPinch/AntiPinchR/AntiPinchCurOffset/ReferenceCurrent/KeepReferenceCurrentFlag/RS/Switch1" /begin REF_MEASUREMENT monr_VbAP_KeepReferenceCurrentRAP_flg /end REF_MEASUREMENT /end GROUP
/begin GROUP S113_Rising_Debounce1 "POD_AntiPinch/POD_AntiPinch/AntiPinch/AntiPinchR/AntiPinchCurOffset/ReferenceCurrent/KeepReferenceCurrentFlag/ReferenceCurrentRes/Rising Debounce1" ROOT /begin REF_CHARACTERISTIC k_ADP_Ti_AntiPinchSequenceTimer k_ADP_Ti_RefCurrResTimer /end REF_CHARACTERISTIC /end GROUP
/begin GROUP S113_Rising_Debounce1 "POD_TipToRun/POD_TipToRun/TipToRun/TipToRunL/ManAsstRqst/ManualSpdBack/ManualCloseToOpenJudge/Rising Debounce1" ROOT /begin REF_CHARACTERISTIC k_TTR_Ti_ManualOpenSpdAccDelayTi k_TTR_Ti_SequenceTimer /end REF_CHARACTERISTIC /end GROUP
/begin GROUP S113_Rising_Debounce2 "POD_TipToRun/POD_TipToRun/TipToRun/TipToRunL/ManAsstRqst/ManualSpdBack/ManualCloseToOpenJudge/Rising Debounce2"
 /begin REF_CHARACTERISTIC k_TTR_Ti_ManualCloseDistanceMaxJudgeTi k_TTR_Ti_SequenceTimer /end REF_CHARACTERISTIC
/end GROUP
/begin GROUP S114_Rising_Debounce "POD_AntiPinch/POD_AntiPinch/AntiPinch/AntiPinchR/AntiPinchCurOffset/ReferenceCurrent/KeepReferenceCurrentFlag/ReferenceCurrentSet/Rising Debounce" ROOT
 /begin REF_CHARACTERISTIC k_ADP_Ti_AntiPinchSequenceTimer k_ADP_Ti_CurrentIncreaseTimer /end REF_CHARACTERISTIC
/end GROUP
/begin GROUP S114_Rising_Debounce "POD_TipToRun/POD_TipToRun/TipToRun/TipToRunL/ManAsstRqst/ManualSpdBack/ManualOpenOrCloseMaxPos/Rising Debounce" ROOT /begin REF_CHARACTERISTIC k_TTR_Ti_ManualOpenMaxPosJudgeTi k_TTR_Ti_SequenceTimer /end REF_CHARACTERISTIC /end GROUP
/begin GROUP S114_Rising_Debounce2 "POD_AntiPinch/POD_AntiPinch/AntiPinch/AntiPinchR/AntiPinchCurOffset/ReferenceCurrent/KeepReferenceCurrentFlag/ReferenceCurrentSet/Rising Debounce2"
 /begin REF_CHARACTERISTIC k_ADP_Ti_AntiPinchSequenceTimer k_ADP_Ti_AntiPinchforMinErrPositionDelayTimer /end REF_CHARACTERISTIC
/end GROUP
/begin GROUP S115_Rising_Debounce1 "POD_TipToRun/POD_TipToRun/TipToRun/TipToRunL/ManAsstRqst/ManualSpdBack/ManualOpenToCloseJudge/Rising Debounce1" /begin REF_CHARACTERISTIC k_TTR_Ti_ManualCloseSpdAccDelayTi k_TTR_Ti_SequenceTimer /end REF_CHARACTERISTIC /end GROUP
/begin GROUP S115_Rising_Debounce2 "POD_TipToRun/POD_TipToRun/TipToRun/TipToRunL/ManAsstRqst/ManualSpdBack/ManualOpenToCloseJudge/Rising Debounce2"
 /begin REF_CHARACTERISTIC k_TTR_Ti_ManualCloseDistanceMaxJudgeTi k_TTR_Ti_SequenceTimer /end REF_CHARACTERISTIC
/end GROUP
/begin GROUP S124_CalPos "RDM_GetTrunkPos/RDM_GetTrunkPos_Main_sys/LearnPos/DetLvrPos/DetLvrPos/CalPos" /begin REF_CHARACTERISTIC CalC_TrnkHallSeriesDir /end REF_CHARACTERISTIC /end GROUP
/begin GROUP S124_DetVldStlHallPosRange "RDM_GetTrunkPos/RDM_GetTrunkPos_Main_sys/LearnPos/DetLvrPos/DetLvrPos/DetVldStlHallPosRange" /begin REF_CHARACTERISTIC CalC_TrnkOpnVldMaxHallPos CalC_hIPLGMechHighHall_cnt /end REF_CHARACTERISTIC /end GROUP
/begin GROUP S127_Byte1 "POD_FaultHandle/POD_FaultHandle/FaultHandle/FMS/FMSR/ArrayProces1/Byte1"
 /begin REF_MEASUREMENT monr_VbFMS_MaiMotOCErrR_flg monr_VbFMS_MaiMotSCBErrR_flg monr_VbFMS_MaiMotSCGErrR_flg monr_VbFMS_MaiMotVDSULErrR_flg /end REF_MEASUREMENT
/end GROUP
/begin GROUP S127_Byte2 "POD_FaultHandle/POD_FaultHandle/FaultHandle/FMS/FMSR/ArrayProces1/Byte2" /begin REF_MEASUREMENT monr_VbFMS_HallBSCGErrR_flg monr_VbFMS_RAMErrR_flg /end REF_MEASUREMENT /end GROUP
/begin GROUP S127_Byte4 "POD_FaultHandle/POD_FaultHandle/FaultHandle/FMS/FMSR/ArrayProces1/Byte4" /begin REF_MEASUREMENT monr_VeFMS_MaiMotErrR_NULL /end REF_MEASUREMENT /end GROUP
/begin GROUP S128_CEM "POD_FaultHandle/POD_FaultHandle/FaultHandle/FMS/FMSR/Event/CEM"
 /begin REF_MEASUREMENT monr_VbFH_FrntIncinAgFltR_flg monr_VbFH_SideIncinAgFltR_flg /end REF_MEASUREMENT
/end GROUP
/begin GROUP S128_System "POD_FaultHandle/POD_FaultHandle/FaultHandle/FMS/FMSR/Event/System" /begin REF_MEASUREMENT monr_VbFH_GyroSigFltR_flg /end REF_MEASUREMENT /end GROUP
/begin GROUP S129_RdrTimeout "POD_FaultHandle/POD_FaultHandle/FaultHandle/FMS/FMSR/Event1/RdrTimeout" /begin REF_MEASUREMENT monr_VbFH_RdrTioutR_flg monr_VbFMS_RdrTimeOutRaw_flg /end REF_MEASUREMENT /end GROUP
/begin GROUP S132_ASWHallInit "POD_HallHandleModule_TZCU/POD_HallHandleModule/HallHandleModule/HallHandleModuleL/HallCntrHandle/HallPosition/ASWHallInit" /begin SUB_GROUP S134_Rising_Debounce S134_Timer_Debounce /end SUB_GROUP /begin REF_MEASUREMENT monr_VbHHM_ASWBSWHallInitL_flg /end REF_MEASUREMENT /end GROUP
/begin GROUP S132_DrvHallNum "POD_HallHandleModule_TZCU/POD_HallHandleModule/HallHandleModule/HallHandleModuleL/HallCntrHandle/HallPosition/DrvHallNum" /begin REF_CHARACTERISTIC k_HHM_Value_Multiple /end REF_CHARACTERISTIC
 /begin REF_MEASUREMENT monr_VsHHM_AntiPinchHallPositionL_NULL monr_VsHHM_OrigValueAntiPinchHallPositionLHHM_NULL monr_VsHHM_OrigValueHallPositionLHHM_NULL /end REF_MEASUREMENT
/end GROUP
/begin GROUP S132_HallInitialization "POD_HallHandleModule_TZCU/POD_HallHandleModule/HallHandleModule/HallHandleModuleL/HallCntrHandle/HallPosition/HallInitialization" /begin SUB_GROUP S136_ErrInitVerify S136_LckState /end SUB_GROUP
 /begin REF_MEASUREMENT monr_VbHHM_DoorAbsPstnInitLHHM_flg monr_VbHHM_DoorOpenLHHM_flg monr_VbHHM_DoorPstnInitLHHM_flg monr_VbHHM_DoorRelPstnInitLHHM_flg monr_VbHHM_NVMHallEnableLHHM_flg /end REF_MEASUREMENT
/end GROUP
/begin GROUP S133_DirectionJudge "POD_HallHandleModule_TZCU/POD_HallHandleModule/HallHandleModule/HallHandleModuleL/HallCntrHandle/HallSpeed/DirectionJudge" /begin REF_MEASUREMENT monr_VfHHM_HallSpeedDirectionLHHM_NULL /end REF_MEASUREMENT /end GROUP
/begin GROUP S133_HallFixedTiOffset "POD_HallHandleModule_TZCU/POD_HallHandleModule/HallHandleModule/HallHandleModuleL/HallCntrHandle/HallSpeed/HallFixedTiOffset" /begin SUB_GROUP S167_Rising_Debounce1 /end SUB_GROUP /begin REF_MEASUREMENT monr_VfHHM_HallFixedTiOffsetLHHM_NULL /end REF_MEASUREMENT /end GROUP
/begin GROUP S133_HallSpeedJudge "POD_HallHandleModule_TZCU/POD_HallHandleModule/HallHandleModule/HallHandleModuleL/HallCntrHandle/HallSpeed/HallSpeedJudge"
 /begin REF_CHARACTERISTIC k_HHM_Value_Minus2Sec k_HHM_Value_Sec2Milsec k_HHM_Value_cfgHallHandlePeriod k_HHM_Value_cfgHallPole /end REF_CHARACTERISTIC
 /begin REF_MEASUREMENT monr_VsHHM_AswHallAccL_g monr_VsHHM_AswHallPosSpeedLHHM_rpm monr_VsHHM_AswHallSpeedL_rpm /end REF_MEASUREMENT
/end GROUP
/begin GROUP S134_Rising_Debounce "POD_HallHandleModule_TZCU/POD_HallHandleModule/HallHandleModule/HallHandleModuleL/HallCntrHandle/HallPosition/ASWHallInit/Rising Debounce" /begin REF_CHARACTERISTIC k_HHM_Ti_TimeHallInitDelay /end REF_CHARACTERISTIC /end GROUP
/begin GROUP S135_Rising_Debounce "POD_AntiPinch/POD_AntiPinch/AntiPinch/AntiPinchR/AntiPinchTrig/AntiPinchConditions_Current/Rising Debounce"
 /begin REF_CHARACTERISTIC k_ADP_Ti_AntiPinchOpenSpeedPerStartTimer k_ADP_Ti_AntiPinchSequenceTimer /end REF_CHARACTERISTIC
/end GROUP
/begin GROUP S135_Rising_Debounce1 "POD_AntiPinch/POD_AntiPinch/AntiPinch/AntiPinchR/AntiPinchTrig/AntiPinchConditions_Current/Rising Debounce1"
 /begin REF_CHARACTERISTIC k_ADP_Ti_AntiPinchCloseSpeedPerStartTimer k_ADP_Ti_AntiPinchSequenceTimer /end REF_CHARACTERISTIC
/end GROUP
/begin GROUP S135_Rising_Debounce2 "POD_AntiPinch/POD_AntiPinch/AntiPinch/AntiPinchR/AntiPinchTrig/AntiPinchConditions_Current/Rising Debounce2"
 /begin REF_CHARACTERISTIC k_ADP_Ti_AntiPinchCloseSpeedPerStartTimer k_ADP_Ti_AntiPinchSequenceTimer /end REF_CHARACTERISTIC
/end GROUP
/begin GROUP S135_Rising_Debounce3 "POD_AntiPinch/POD_AntiPinch/AntiPinch/AntiPinchR/AntiPinchTrig/AntiPinchConditions_Current/Rising Debounce3"
 /begin REF_CHARACTERISTIC k_ADP_Ti_AntiPinchSequenceTimer k_ADP_Ti_CurAntiPinchforMinPntCloseStartTimer /end REF_CHARACTERISTIC
/end GROUP
/begin GROUP S136_ErrInitVerify "POD_HallHandleModule_TZCU/POD_HallHandleModule/HallHandleModule/HallHandleModuleL/HallCntrHandle/HallPosition/HallInitialization/ErrInitVerify" /begin REF_MEASUREMENT monr_VbHHM_HallErrLHHM_flg monr_VbHHM_InitErrorLHHM_flg /end REF_MEASUREMENT /end GROUP
/begin GROUP S136_LckState "POD_HallHandleModule_TZCU/POD_HallHandleModule/HallHandleModule/HallHandleModuleL/HallCntrHandle/HallPosition/HallInitialization/LckState" /begin SUB_GROUP S152_Rising_Debounce1 S152_RS /end SUB_GROUP /begin REF_CHARACTERISTIC k_HHM_Value_PushLockMaxD k_HHM_Value_PushLockMaxF /end REF_CHARACTERISTIC /end GROUP
/begin GROUP S136_Rising_Debounce4 "POD_AntiPinch/POD_AntiPinch/AntiPinch/AntiPinchR/AntiPinchTrig/AntiPinchConditions_Speed/Rising Debounce4"
 /begin REF_CHARACTERISTIC k_ADP_Ti_AntiPinchSequenceTimer k_ADP_Ti_DieMinimumSpeedJudgeTimer /end REF_CHARACTERISTIC
/end GROUP
/begin GROUP S13_AntiPlayActiveCounter "POD_FaultHandle/POD_FaultHandle/FaultHandle/AntiPlay/AntiPlayL/AntiplayStatus/AntiPlayState/AntiPlayActiveCounter" /begin REF_MEASUREMENT monr_ADP_Value_AntiPlayActiveCounterL /end REF_MEASUREMENT /end GROUP
/begin GROUP S13_Signal_Override "POD_FaultHandle/POD_FaultHandle/FaultHandle/AntiPlay/AntiPlayL/AntiplayStatus/AntiPlayState/Signal_Override" /begin SUB_GROUP S27_Switch /end SUB_GROUP /begin REF_CHARACTERISTIC k_ADP_Boolean_AntiPlayValue k_ADP_Boolean_AntiPlayflg /end REF_CHARACTERISTIC /end GROUP
/begin GROUP S13_Time_Holding_Boolean "POD_AntiPinch/POD_AntiPinch/AntiPinch/AntiPinchL/Tip2RunAntiPinch/Time Holding Boolean" ROOT /begin SUB_GROUP S87_Signal_Holding_Boolean S87_Timer_Debounce /end SUB_GROUP /end GROUP
/begin GROUP S13_Time_Holding_Boolean "POD_FaultHandle/POD_FaultHandle/FaultHandle/AntiPlay/AntiPlayL/AntiplayStatus/AntiPlayState/Time Holding Boolean" ROOT /begin SUB_GROUP S28_Timer_Debounce /end SUB_GROUP /end GROUP
/begin GROUP S152_Rising_Debounce1 "POD_HallHandleModule_TZCU/POD_HallHandleModule/HallHandleModule/HallHandleModuleL/HallCntrHandle/HallPosition/HallInitialization/LckState/Rising Debounce1" /begin REF_CHARACTERISTIC k_HHM_Ti_TimeHalfClsdDelay /end REF_CHARACTERISTIC /end GROUP
/begin GROUP S152_RS "POD_HallHandleModule_TZCU/POD_HallHandleModule/HallHandleModule/HallHandleModuleL/HallCntrHandle/HallPosition/HallInitialization/LckState/RS" /begin SUB_GROUP S155_Switch1 /end SUB_GROUP /end GROUP
/begin GROUP S154_Rising_Debounce "POD_AntiPinch/POD_AntiPinch/AntiPinch/AntiPinchR/AntiPinch_Detection/AntiPinchEvent/Rising Debounce"
 /begin REF_CHARACTERISTIC k_ADP_Ti_AntiPinchSequenceTimer k_ADP_Ti_StateRunDelayTimer /end REF_CHARACTERISTIC
/end GROUP
/begin GROUP S154_Rising_Debounce1 "POD_AntiPinch/POD_AntiPinch/AntiPinch/AntiPinchR/AntiPinch_Detection/AntiPinchEvent/Rising Debounce1"
 /begin REF_CHARACTERISTIC k_ADP_Ti_AntiPinchSequenceTimer k_ADP_Ti_CurAntiPinchforMinPntCloseDelayTimer /end REF_CHARACTERISTIC
/end GROUP
/begin GROUP S155_Switch1 "POD_HallHandleModule_TZCU/POD_HallHandleModule/HallHandleModule/HallHandleModuleL/HallCntrHandle/HallPosition/HallInitialization/LckState/RS/Switch1" /begin REF_MEASUREMENT monr_VbHHM_Lck2DrStsErrLHHM_flg /end REF_MEASUREMENT /end GROUP
/begin GROUP S157_Signal_Holding_Boolean "POD_AntiPinch/POD_AntiPinch/AntiPinch/AntiPinchR/AntiPinch_Detection/Time Holding Boolean/Signal Holding Boolean" /begin REF_MEASUREMENT monr_VbAP_AntiPinchStsDspR_flg /end REF_MEASUREMENT /end GROUP
/begin GROUP S157_Timer_Debounce "POD_AntiPinch/POD_AntiPinch/AntiPinch/AntiPinchR/AntiPinch_Detection/Time Holding Boolean/Timer Debounce"
 /begin REF_CHARACTERISTIC k_ADP_Ti_AntiPinchHoldingTimer k_ADP_Ti_AntiPinchSequenceTimer /end REF_CHARACTERISTIC
/end GROUP
/begin GROUP S15_ElecMovInBrkgIMUSpdJudge "POD_TipToRun/POD_TipToRun/TipToRun/TipToRunL/ManAsstRqst/ElecToAssist/ElecMovInBrkgIMUSpdJudge" /begin SUB_GROUP S19_RisingDelay /end SUB_GROUP
 /begin REF_CHARACTERISTIC k_TTR_Ti_SequenceTimer k_TTR_Value_MovInBrkgToManualCloseOffSetSpeed /end REF_CHARACTERISTIC
 /begin REF_MEASUREMENT monr_VbTTR_IMUAngSpdToCloseLTTR_flg /end REF_MEASUREMENT
/end GROUP
/begin GROUP S15_ElecMovOutBrkgIMUSpdJudge "POD_TipToRun/POD_TipToRun/TipToRun/TipToRunL/ManAsstRqst/ElecToAssist/ElecMovOutBrkgIMUSpdJudge" /begin SUB_GROUP S20_Rising_Debounce1 S20_RisingDelay /end SUB_GROUP /begin REF_CHARACTERISTIC k_TTR_Ti_SequenceTimer /end REF_CHARACTERISTIC /begin REF_MEASUREMENT monr_VbTTR_IMUAngSpdToOpenLTTR_flg /end REF_MEASUREMENT /end GROUP
/begin GROUP S15_ElecToAssistCloseJudge "POD_TipToRun/POD_TipToRun/TipToRun/TipToRunL/ManAsstRqst/ElecToAssist/ElecToAssistCloseJudge" /begin REF_CHARACTERISTIC k_TTR_Value_ElecToManualCloseMinSpeed /end REF_CHARACTERISTIC /begin REF_MEASUREMENT monr_VbTTR_ElecToAssistCloseLTTR_flg /end REF_MEASUREMENT /end GROUP
/begin GROUP S15_ElecToAssistIMUErrorSpdOrAccJudge "POD_TipToRun/POD_TipToRun/TipToRun/TipToRunL/ManAsstRqst/ElecToAssist/ElecToAssistIMUErrorSpdOrAccJudge" /begin SUB_GROUP S23_Falling_Debounce S23_Falling_Debounce1 /end SUB_GROUP
 /begin REF_CHARACTERISTIC k_TTR_Ti_SequenceTimer k_TTR_Value_ElecCloseDoorMinAcc k_TTR_Value_ElecOpenDoorMinAcc /end REF_CHARACTERISTIC
 /begin REF_MEASUREMENT monr_VbTTR_BanCloseIMUErrorJudgeLTTR_flg monr_VbTTR_BanOpenIMUErrorJudgeLTTR_flg /end REF_MEASUREMENT
/end GROUP
/begin GROUP S15_ElecToAssistIMUSpdJudge "POD_TipToRun/POD_TipToRun/TipToRun/TipToRunL/ManAsstRqst/ElecToAssist/ElecToAssistIMUSpdJudge" /begin SUB_GROUP S24_Rising_Debounce S24_Rising_Debounce1 /end SUB_GROUP
 /begin REF_CHARACTERISTIC k_TTR_Value_ElecToManualCloseMinSpeed k_TTR_Value_ElecToManualOpenMinSpeed /end REF_CHARACTERISTIC
 /begin REF_MEASUREMENT monr_VbTTR_ElecToAssistCloseSpeedLTTR_flg monr_VbTTR_ElecToAssistOpenSpeedLTTR_flg /end REF_MEASUREMENT
/end GROUP
/begin GROUP S15_ElecToAssistOpenJudge "POD_TipToRun/POD_TipToRun/TipToRun/TipToRunL/ManAsstRqst/ElecToAssist/ElecToAssistOpenJudge" /begin REF_CHARACTERISTIC k_TTR_Value_ElecToManualOpenMinSpeed /end REF_CHARACTERISTIC /begin REF_MEASUREMENT monr_VbTTR_ElecToAssistOpenLTTR_flg /end REF_MEASUREMENT /end GROUP
/begin GROUP S15_ElecToManualCloseIMUAccJudge "POD_TipToRun/POD_TipToRun/TipToRun/TipToRunL/ManAsstRqst/ElecToAssist/ElecToManualCloseIMUAccJudge" /begin SUB_GROUP S26_Rising_Debounce2 S26_Rising_Debounce4 /end SUB_GROUP
 /begin REF_CHARACTERISTIC k_TTR_Pluse_ManualAssistMinPos k_TTR_Value_ManualCloseACCDiff k_TTR_Value_ManualCloseMaxAcc k_TTR_Value_ManualCloseMinAcc /end REF_CHARACTERISTIC
 /begin REF_MEASUREMENT monr_VbTTR_ImuAngSpdCloseAccLTTR_flg /end REF_MEASUREMENT
/end GROUP
/begin GROUP S15_ElecToManualOpenIMUAccJudge "POD_TipToRun/POD_TipToRun/TipToRun/TipToRunL/ManAsstRqst/ElecToAssist/ElecToManualOpenIMUAccJudge"
 /begin SUB_GROUP S27_Rising_Debounce1 S27_Rising_Debounce2 S27_Rising_Debounce3 /end SUB_GROUP
 /begin REF_CHARACTERISTIC k_TTR_Deg_RoadInclnThdAssis k_TTR_Deg_RollAgGlbThdAssis k_TTR_Pluse_ManualAssistMinPos k_TTR_Value_ManualMaxAcc k_TTR_Value_ManualMinAcc /end REF_CHARACTERISTIC
 /begin REF_MEASUREMENT monr_VbTTR_ImuAngSpdOpenAccLTTR_flg /end REF_MEASUREMENT
/end GROUP
/begin GROUP S15_ForR_Para "POD_TipToRun/POD_TipToRun/TipToRun/TipToRunL/ManAsstRqst/ElecToAssist/ForR_Para"
 /begin REF_CHARACTERISTIC k_TTR_Ti_DoorBrkgToAssistCloseTi k_TTR_Ti_DoorBrkgToAssistOpenTi k_TTR_Ti_DoorCloseACCDecJudgeTi k_TTR_Ti_DoorCloseACCIncJudgeTi k_TTR_Ti_DoorOpenACCDecJudgeTi k_TTR_Ti_DoorOpenACCIncJudgeTi k_TTR_Value_ManualOpenACCDiff k_TTR_Value_MovInBrkgToManualCloseMinSpeed k_TTR_Value_MovOutBrkgToManualOpenMinSpeed k_TTR_Value_MovOutBrkgToManualOpenOffSetSpeed /end REF_CHARACTERISTIC
/end GROUP
/begin GROUP S15_Switch1 "POD_SignalHandModule_T/POD_SignalHandModule/SignalHandModule/VehSpd/Switch1" /begin REF_MEASUREMENT monr_VfSHM_VehSpdLgt_mps /end REF_MEASUREMENT /end GROUP
/begin GROUP S165_State "POD_FaultHandle/POD_FaultHandle/FaultHandle/LVM/LVML/State" /begin SUB_GROUP S169_DoorMove /end SUB_GROUP /begin REF_MEASUREMENT monr_VbFH_ECUWakeUpL_flg /end REF_MEASUREMENT /end GROUP
/begin GROUP S166_LockState "POD_FaultHandle/POD_FaultHandle/FaultHandle/LVM/LVMR/LockState" /begin REF_MEASUREMENT monr_VeFH_DoorLckPstnR_enum /end REF_MEASUREMENT /end GROUP
/begin GROUP S166_State "POD_FaultHandle/POD_FaultHandle/FaultHandle/LVM/LVMR/State" /begin SUB_GROUP S214_DoorMove /end SUB_GROUP /begin REF_MEASUREMENT monr_VbFH_ECUWakeUpR_flg /end REF_MEASUREMENT /end GROUP
/begin GROUP S169_DoorMove "POD_FaultHandle/POD_FaultHandle/FaultHandle/LVM/LVML/State/DoorMove" /begin REF_CHARACTERISTIC KuLVM_DoorHallChgDebTi_s /end REF_CHARACTERISTIC /end GROUP
/begin GROUP S16_KeepReferenceCurrentFlag "POD_AntiPinch/POD_AntiPinch/AntiPinch/AntiPinchL/AntiPinchCurOffset/ReferenceCurrent/KeepReferenceCurrentFlag" /begin SUB_GROUP S21_ReferenceCurrentRes S21_ReferenceCurrentSet S21_RS /end SUB_GROUP /end GROUP
/begin GROUP S16_ReferenceCurrent "POD_AntiPinch/POD_AntiPinch/AntiPinch/AntiPinchL/AntiPinchCurOffset/ReferenceCurrent/ReferenceCurrent" /begin SUB_GROUP S22_Rising_Debounce /end SUB_GROUP /begin REF_MEASUREMENT monr_VfAP_ValueReferenceCurrentLAP_MA /end REF_MEASUREMENT /end GROUP
/begin GROUP S16_ReferenceCurrentCompensation "POD_AntiPinch/POD_AntiPinch/AntiPinch/AntiPinchL/AntiPinchCurOffset/ReferenceCurrent/ReferenceCurrentCompensation"
 /begin REF_MEASUREMENT monr_VfAP_ValueBrkgCompenLAP_MA monr_VfAP_ValueReferenceCurrentCmpLAP_MA monr_VfAP_ValueSlopeCompenLAP_MA /end REF_MEASUREMENT
/end GROUP
/begin GROUP S174_Rising_Debounce "POD_TipToRun/POD_TipToRun/TipToRun/TipToRunR/IMU/Rising Debounce" /begin REF_CHARACTERISTIC k_TTR_Ti_DoorOpenStartTimer k_TTR_Ti_SequenceTimer /end REF_CHARACTERISTIC /end GROUP
/begin GROUP S174_Rising_Debounce1 "POD_TipToRun/POD_TipToRun/TipToRun/TipToRunR/IMU/Rising Debounce1" /begin REF_CHARACTERISTIC k_TTR_Ti_SequenceTimer /end REF_CHARACTERISTIC /end GROUP
/begin GROUP S175_ElecToAssist "POD_TipToRun/POD_TipToRun/TipToRun/TipToRunR/ManAsstRqst/ElecToAssist"
 /begin SUB_GROUP S183_ElecMovInBrkgIMUSpdJudge S183_ElecMovOutBrkgIMUSpdJudge S183_ElecToAssistCloseJudge S183_ElecToAssistIMUErrorSpdOrAccJudge S183_ElecToAssistIMUSpdJudge S183_ElecToAssistOpenJudge S183_ElecToManualCloseIMUAccJudge S183_ElecToManualOpenIMUAccJudge S183_ForR_Para /end SUB_GROUP
/end GROUP
/begin GROUP S175_ManualSpdBack "POD_TipToRun/POD_TipToRun/TipToRun/TipToRunR/ManAsstRqst/ManualSpdBack"
 /begin SUB_GROUP S185_ForR_Para S185_ManualAssistJudge S185_ManualCloseToOpenJudge S185_ManualOpenOrCloseMaxPos S185_ManualOpenToCloseJudge /end SUB_GROUP
/end GROUP
/begin GROUP S175_Signal_Holding_Boolean "POD_AntiPinch/POD_AntiPinch/AntiPinch/AntiPinchR/Tip2RunAntiPinch/Time Holding Boolean/Signal Holding Boolean" /begin REF_MEASUREMENT monr_VbAP_Tip2RunAntiPinchR_flg /end REF_MEASUREMENT /end GROUP
/begin GROUP S175_StopToAssist "POD_TipToRun/POD_TipToRun/TipToRun/TipToRunR/ManAsstRqst/StopToAssist"
 /begin SUB_GROUP S186_Rising_Debounce S186_Rising_Debounce1 S186_Rising_Debounce2 S186_Rising_Debounce3 /end SUB_GROUP
 /begin REF_CHARACTERISTIC k_TTR_Deg_RoadInclnThdAssis k_TTR_Deg_RollAgGlbThdAssis k_TTR_Value_HoldHallPosExit k_TTR_Value_IMUHoldExitMinSpeed k_TTR_Value_SpdLowerThdforAsst k_TTR_Value_SpdUpperThdforAsst /end REF_CHARACTERISTIC
 /begin REF_MEASUREMENT monr_VbTTR_HoldModeManAssistRTTR_flg monr_VbTTR_HoldPosExitRTTR_flg monr_VbTTR_StopToAssistClose_flg monr_VbTTR_StopToAssistOpen_flg monr_VsTTR_PluseHoldPosRTTR_deg /end REF_MEASUREMENT
/end GROUP
/begin GROUP S175_Timer_Debounce "POD_AntiPinch/POD_AntiPinch/AntiPinch/AntiPinchR/Tip2RunAntiPinch/Time Holding Boolean/Timer Debounce"
 /begin REF_CHARACTERISTIC k_ADP_Ti_AntiPinchHoldingTimer k_ADP_Ti_AntiPinchSequenceTimer /end REF_CHARACTERISTIC
/end GROUP
/begin GROUP S176_ForR_Para "POD_TipToRun/POD_TipToRun/TipToRun/TipToRunR/TipToRunRqst/ForR_Para"
 /begin REF_CHARACTERISTIC k_TTR_Value_ImuAngAccSpdThdforTTR k_TTR_Value_ImuAngSpdThdforTTR k_TTR_Value_SpdThdforTTR k_TTR_Value_TTRDegThd /end REF_CHARACTERISTIC
/end GROUP
/begin GROUP S176_Rising_Debounce "POD_HallHandleModule_TZCU/POD_HallHandleModule/HallHandleModule/HallHandleModuleL/HallErrorProcess/HALL_AFault/Rising Debounce" /begin REF_CHARACTERISTIC k_HHM_Ti_HallAErrorConTi /end REF_CHARACTERISTIC /end GROUP
/begin GROUP S176_Rising_Debounce1 "POD_HallHandleModule_TZCU/POD_HallHandleModule/HallHandleModule/HallHandleModuleL/HallErrorProcess/HALL_AFault/Rising Debounce1" /begin REF_CHARACTERISTIC k_HHM_Ti_HallAErrorConTi /end REF_CHARACTERISTIC /end GROUP
/begin GROUP S176_Rising_Debounce2 "POD_HallHandleModule_TZCU/POD_HallHandleModule/HallHandleModule/HallHandleModuleL/HallErrorProcess/HALL_AFault/Rising Debounce2" /begin REF_CHARACTERISTIC k_HHM_Ti_HallNumAStaticTi /end REF_CHARACTERISTIC /end GROUP
/begin GROUP S176_Rising_Debounce3 "POD_HallHandleModule_TZCU/POD_HallHandleModule/HallHandleModule/HallHandleModuleL/HallErrorProcess/HALL_AFault/Rising Debounce3" /begin REF_CHARACTERISTIC k_HHM_Ti_HallDirAErrorTi /end REF_CHARACTERISTIC /end GROUP
/begin GROUP S177_Falling_Debounce "POD_HallHandleModule_TZCU/POD_HallHandleModule/HallHandleModule/HallHandleModuleL/HallErrorProcess/HALL_BFault/Falling Debounce" /begin REF_CHARACTERISTIC k_HHM_Ti_HallReveMaxTi /end REF_CHARACTERISTIC /end GROUP
/begin GROUP S177_Falling_Debounce1 "POD_HallHandleModule_TZCU/POD_HallHandleModule/HallHandleModule/HallHandleModuleL/HallErrorProcess/HALL_BFault/Falling Debounce1" /begin REF_CHARACTERISTIC k_HHM_Ti_HallReveMaxTi /end REF_CHARACTERISTIC /end GROUP
/begin GROUP S177_Rising_Debounce "POD_HallHandleModule_TZCU/POD_HallHandleModule/HallHandleModule/HallHandleModuleL/HallErrorProcess/HALL_BFault/Rising Debounce" /begin REF_CHARACTERISTIC k_HHM_Ti_HallPWMErrorConTi /end REF_CHARACTERISTIC /end GROUP
/begin GROUP S177_Rising_Debounce1 "POD_HallHandleModule_TZCU/POD_HallHandleModule/HallHandleModule/HallHandleModuleL/HallErrorProcess/HALL_BFault/Rising Debounce1" /begin REF_CHARACTERISTIC k_HHM_Ti_OpenDoorHallPWMStaticTi /end REF_CHARACTERISTIC /end GROUP
/begin GROUP S177_Rising_Debounce2 "POD_HallHandleModule_TZCU/POD_HallHandleModule/HallHandleModule/HallHandleModuleL/HallErrorProcess/HALL_BFault/Rising Debounce2" /begin REF_CHARACTERISTIC k_HHM_Ti_OpenDoorHallDecTi /end REF_CHARACTERISTIC /end GROUP
/begin GROUP S177_Rising_Debounce3 "POD_HallHandleModule_TZCU/POD_HallHandleModule/HallHandleModule/HallHandleModuleL/HallErrorProcess/HALL_BFault/Rising Debounce3" /begin REF_CHARACTERISTIC k_HHM_Ti_CloseDoorHallIncTi /end REF_CHARACTERISTIC /end GROUP
/begin GROUP S177_Rising_Debounce4 "POD_HallHandleModule_TZCU/POD_HallHandleModule/HallHandleModule/HallHandleModuleL/HallErrorProcess/HALL_BFault/Rising Debounce4" /begin REF_CHARACTERISTIC k_HHM_Ti_CloseDoorHallPWMStaticTi /end REF_CHARACTERISTIC /end GROUP
/begin GROUP S177_Rising_Debounce5 "POD_HallHandleModule_TZCU/POD_HallHandleModule/HallHandleModule/HallHandleModuleL/HallErrorProcess/HALL_BFault/Rising Debounce5" /begin REF_CHARACTERISTIC k_HHM_Ti_HallPWMErrorConTi /end REF_CHARACTERISTIC /end GROUP
/begin GROUP S177_Rising_Debounce6 "POD_HallHandleModule_TZCU/POD_HallHandleModule/HallHandleModule/HallHandleModuleL/HallErrorProcess/HALL_BFault/Rising Debounce6" /begin REF_CHARACTERISTIC k_HHM_Ti_HallPWMErrorJudgeTi /end REF_CHARACTERISTIC /end GROUP
/begin GROUP S177_Rising_Debounce7 "POD_HallHandleModule_TZCU/POD_HallHandleModule/HallHandleModule/HallHandleModuleL/HallErrorProcess/HALL_BFault/Rising Debounce7" /begin REF_CHARACTERISTIC k_HHM_Ti_HallPWMErrorAbsPosSpdJudgeTi /end REF_CHARACTERISTIC /end GROUP
/begin GROUP S178_Rising_Debounce "POD_HallHandleModule_TZCU/POD_HallHandleModule/HallHandleModule/HallHandleModuleL/HallErrorProcess/HallJudgeCondition/Rising Debounce" /begin REF_CHARACTERISTIC k_HHM_Ti_ECUWakeUpJudgeMinTi /end REF_CHARACTERISTIC /end GROUP
/begin GROUP S178_Rising_Debounce1 "POD_HallHandleModule_TZCU/POD_HallHandleModule/HallHandleModule/HallHandleModuleL/HallErrorProcess/HallJudgeCondition/Rising Debounce1" /begin REF_CHARACTERISTIC k_HHM_Ti_HallPWMErrTi /end REF_CHARACTERISTIC /begin REF_MEASUREMENT monr_VbHHM_HallErrSpeedLHHM_flg /end REF_MEASUREMENT /end GROUP
/begin GROUP S179_RS "POD_HallHandleModule_TZCU/POD_HallHandleModule/HallHandleModule/HallHandleModuleL/HallErrorProcess/SenorErr/RS" /begin SUB_GROUP S235_Switch1 /end SUB_GROUP /end GROUP
/begin GROUP S17_ForR_Para "POD_TipToRun/POD_TipToRun/TipToRun/TipToRunL/ManAsstRqst/ManualSpdBack/ForR_Para"
 /begin REF_CHARACTERISTIC k_TTR_Value_ManualBrkgCloseMinAcc k_TTR_Value_ManualCloseIMUBaseAngSpd k_TTR_Value_ManualOpenIMUBaseAngSpd /end REF_CHARACTERISTIC
/end GROUP
/begin GROUP S17_ManualAssistJudge "POD_TipToRun/POD_TipToRun/TipToRun/TipToRunL/ManAsstRqst/ManualSpdBack/ManualAssistJudge" /begin REF_CHARACTERISTIC k_TTR_Pluse_ManualAssistMinPos /end REF_CHARACTERISTIC
 /begin REF_MEASUREMENT monr_VbTTR_ManualAssistCloseLTTR_flg monr_VbTTR_ManualAssistOpenLTTR_flg /end REF_MEASUREMENT
/end GROUP
/begin GROUP S17_ManualCloseToOpenJudge "POD_TipToRun/POD_TipToRun/TipToRun/TipToRunL/ManAsstRqst/ManualSpdBack/ManualCloseToOpenJudge" /begin SUB_GROUP S113_Rising_Debounce1 S113_Rising_Debounce2 /end SUB_GROUP
 /begin REF_CHARACTERISTIC K_TTR_Value_RoadManualOpenIMUFactor K_TTR_Value_RollManualOpenIMUFactor k_TTR_Value_IMUAngSpdAccDecRate k_TTR_Value_IMUAngSpdToOpenOffset k_TTR_Value_ManualBrkgOpenMaxAcc k_TTR_Value_ManualBrkgOpenMinAcc k_TTR_Value_ManualBrkgToOpenMinPos k_TTR_Value_ManualOpenMaxSpeed k_TTR_Value_ManualOpenMinSpeed /end REF_CHARACTERISTIC
/end GROUP
/begin GROUP S17_ManualOpenOrCloseMaxPos "POD_TipToRun/POD_TipToRun/TipToRun/TipToRunL/ManAsstRqst/ManualSpdBack/ManualOpenOrCloseMaxPos" /begin SUB_GROUP S114_Rising_Debounce /end SUB_GROUP
 /begin REF_CHARACTERISTIC k_TTR_Value_IMUAngSpdProtectMaxRebound k_TTR_Value_ManualBackMinHallSpeed /end REF_CHARACTERISTIC
 /begin REF_MEASUREMENT monr_VbTTR_ManualHallSpeedBackLTTR_flg monr_VbTTR_ManualOpenMaxHallPosDecLTTR_flg monr_VbTTR_ManualOpenMaxHallPosNoWaitLTTR_flg monr_VbTTR_ManualOpenToCloseMaxRangeLTTR_flg monr_VbTTR_MuanBrkgZeroDistanceLTTR_flg monr_VsTTR_ValueManualCloseMinHallPosLTTR_deg monr_VsTTR_ValueManualOpenMaxHallPosLTTR_deg monr_VsTTR_ValueMovInBrkgInitPositionLTTR_deg monr_VsTTR_ValueMovOutBrkgInitPositionLTTR_deg monr_VsTTR_ValueOriManualOpenMaxHallPosLTTR_deg /end REF_MEASUREMENT
/end GROUP
/begin GROUP S17_ManualOpenToCloseJudge "POD_TipToRun/POD_TipToRun/TipToRun/TipToRunL/ManAsstRqst/ManualSpdBack/ManualOpenToCloseJudge" /begin SUB_GROUP S115_Rising_Debounce1 S115_Rising_Debounce2 /end SUB_GROUP
 /begin REF_CHARACTERISTIC K_TTR_Value_RoadManualCloseIMUFactor K_TTR_Value_RollManualCloseIMUFactor k_TTR_Value_IMUAngSpdAccToCloseDecRate k_TTR_Value_IMUAngSpdToCloseOffset k_TTR_Value_ManualBrkgCloseMaxAcc k_TTR_Value_ManualBrkgToCloseMinPos k_TTR_Value_ManualCloseIMUBaseAngSpdOffset k_TTR_Value_ManualCloseMaxSpeed k_TTR_Value_ManualCloseMinSpeed /end REF_CHARACTERISTIC
 /begin REF_MEASUREMENT monr_VbTTR_IMUAngSpdAccToCloseLTTR_flg monr_VbTTR_IMUToManualCloseLTTR_flg monr_VbTTR_ManualCloseMovMinPosJudgeLTTR_flg monr_VsTTR_VauleManualCloseBaseAngSpdLTTR_degps /end REF_MEASUREMENT
/end GROUP
/begin GROUP S180_cnt "POD_HallHandleModule_TZCU/POD_HallHandleModule/HallHandleModule/HallHandleModuleL/HallErrorProcess/SenorErr_Reset/cnt" /begin REF_CHARACTERISTIC k_HHM_Value_HallPassCnt /end REF_CHARACTERISTIC /end GROUP
/begin GROUP S180_MovReset "POD_HallHandleModule_TZCU/POD_HallHandleModule/HallHandleModule/HallHandleModuleL/HallErrorProcess/SenorErr_Reset/MovReset" /begin SUB_GROUP S242_Rising_Debounce1 /end SUB_GROUP /end GROUP
/begin GROUP S180_Rising_Debounce2 "POD_HallHandleModule_TZCU/POD_HallHandleModule/HallHandleModule/HallHandleModuleL/HallErrorProcess/SenorErr_Reset/Rising Debounce2" /begin REF_CHARACTERISTIC k_HHM_Ti_TimeHallStatic /end REF_CHARACTERISTIC /end GROUP
/begin GROUP S183_ElecMovInBrkgIMUSpdJudge "POD_TipToRun/POD_TipToRun/TipToRun/TipToRunR/ManAsstRqst/ElecToAssist/ElecMovInBrkgIMUSpdJudge" /begin SUB_GROUP S187_RisingDelay /end SUB_GROUP
 /begin REF_CHARACTERISTIC k_TTR_Ti_SequenceTimer k_TTR_Value_MovInBrkgToManualCloseOffSetSpeed /end REF_CHARACTERISTIC
 /begin REF_MEASUREMENT monr_VbTTR_IMUAngSpdToCloseRTTR_flg /end REF_MEASUREMENT
/end GROUP
/begin GROUP S183_ElecMovOutBrkgIMUSpdJudge "POD_TipToRun/POD_TipToRun/TipToRun/TipToRunR/ManAsstRqst/ElecToAssist/ElecMovOutBrkgIMUSpdJudge" /begin SUB_GROUP S188_Rising_Debounce1 S188_RisingDelay /end SUB_GROUP /begin REF_CHARACTERISTIC k_TTR_Ti_SequenceTimer /end REF_CHARACTERISTIC /begin REF_MEASUREMENT monr_VbTTR_IMUAngSpdToOpenRTTR_flg /end REF_MEASUREMENT /end GROUP
/begin GROUP S183_ElecToAssistCloseJudge "POD_TipToRun/POD_TipToRun/TipToRun/TipToRunR/ManAsstRqst/ElecToAssist/ElecToAssistCloseJudge" /begin REF_CHARACTERISTIC k_TTR_Value_ElecToManualCloseMinSpeed /end REF_CHARACTERISTIC /begin REF_MEASUREMENT monr_VbTTR_ElecToAssistClose_flg /end REF_MEASUREMENT /end GROUP
/begin GROUP S183_ElecToAssistIMUErrorSpdOrAccJudge "POD_TipToRun/POD_TipToRun/TipToRun/TipToRunR/ManAsstRqst/ElecToAssist/ElecToAssistIMUErrorSpdOrAccJudge" /begin SUB_GROUP S191_Falling_Debounce S191_Falling_Debounce1 /end SUB_GROUP
 /begin REF_CHARACTERISTIC k_TTR_Ti_SequenceTimer k_TTR_Value_ElecCloseDoorMinAcc k_TTR_Value_ElecOpenDoorMinAcc /end REF_CHARACTERISTIC
 /begin REF_MEASUREMENT monr_VbTTR_BanCloseIMUErrorJudgeRTTR_flg monr_VbTTR_BanOpenIMUErrorJudgeRTTR_flg /end REF_MEASUREMENT
/end GROUP
/begin GROUP S183_ElecToAssistIMUSpdJudge "POD_TipToRun/POD_TipToRun/TipToRun/TipToRunR/ManAsstRqst/ElecToAssist/ElecToAssistIMUSpdJudge" /begin SUB_GROUP S192_Rising_Debounce S192_Rising_Debounce1 /end SUB_GROUP
 /begin REF_CHARACTERISTIC k_TTR_Value_ElecToManualCloseMinSpeed k_TTR_Value_ElecToManualOpenMinSpeed /end REF_CHARACTERISTIC
 /begin REF_MEASUREMENT monr_VbTTR_ElecToAssistCloseSpeedRTTR_flg monr_VbTTR_ElecToAssistOpenSpeedRTTR_flg /end REF_MEASUREMENT
/end GROUP
/begin GROUP S183_ElecToAssistOpenJudge "POD_TipToRun/POD_TipToRun/TipToRun/TipToRunR/ManAsstRqst/ElecToAssist/ElecToAssistOpenJudge" /begin REF_CHARACTERISTIC k_TTR_Value_ElecToManualOpenMinSpeed /end REF_CHARACTERISTIC /begin REF_MEASUREMENT monr_VbTTR_ElecToAssistOpen_flg /end REF_MEASUREMENT /end GROUP
/begin GROUP S183_ElecToManualCloseIMUAccJudge "POD_TipToRun/POD_TipToRun/TipToRun/TipToRunR/ManAsstRqst/ElecToAssist/ElecToManualCloseIMUAccJudge" /begin SUB_GROUP S194_Rising_Debounce2 S194_Rising_Debounce4 /end SUB_GROUP
 /begin REF_CHARACTERISTIC k_TTR_Pluse_ManualAssistMinPos k_TTR_Value_ManualCloseACCDiff k_TTR_Value_ManualCloseMaxAcc k_TTR_Value_ManualCloseMinAcc /end REF_CHARACTERISTIC
 /begin REF_MEASUREMENT monr_VbTTR_ImuAngSpdCloseAccRTTR_flg /end REF_MEASUREMENT
/end GROUP
/begin GROUP S183_ElecToManualOpenIMUAccJudge "POD_TipToRun/POD_TipToRun/TipToRun/TipToRunR/ManAsstRqst/ElecToAssist/ElecToManualOpenIMUAccJudge"
 /begin SUB_GROUP S195_Rising_Debounce1 S195_Rising_Debounce2 S195_Rising_Debounce3 /end SUB_GROUP
 /begin REF_CHARACTERISTIC k_TTR_Deg_RoadInclnThdAssis k_TTR_Deg_RollAgGlbThdAssis k_TTR_Pluse_ManualAssistMinPos k_TTR_Value_ManualMaxAcc k_TTR_Value_ManualMinAcc /end REF_CHARACTERISTIC
 /begin REF_MEASUREMENT monr_VbTTR_ImuAngSpdOpenAccRTTR_flg /end REF_MEASUREMENT
/end GROUP
/begin GROUP S183_ForR_Para "POD_TipToRun/POD_TipToRun/TipToRun/TipToRunR/ManAsstRqst/ElecToAssist/ForR_Para"
 /begin REF_CHARACTERISTIC k_TTR_Ti_DoorBrkgToAssistCloseTi k_TTR_Ti_DoorBrkgToAssistOpenTi k_TTR_Ti_DoorCloseACCDecJudgeTi k_TTR_Ti_DoorCloseACCIncJudgeTi k_TTR_Ti_DoorOpenACCDecJudgeTi k_TTR_Ti_DoorOpenACCIncJudgeTi k_TTR_Value_ManualOpenACCDiff k_TTR_Value_MovInBrkgToManualCloseMinSpeed k_TTR_Value_MovOutBrkgToManualOpenMinSpeed k_TTR_Value_MovOutBrkgToManualOpenOffSetSpeed /end REF_CHARACTERISTIC
/end GROUP
/begin GROUP S185_ForR_Para "POD_TipToRun/POD_TipToRun/TipToRun/TipToRunR/ManAsstRqst/ManualSpdBack/ForR_Para"
 /begin REF_CHARACTERISTIC k_TTR_Value_ManualBrkgCloseMinAcc k_TTR_Value_ManualCloseIMUBaseAngSpd k_TTR_Value_ManualOpenIMUBaseAngSpd /end REF_CHARACTERISTIC
/end GROUP
/begin GROUP S185_ManualAssistJudge "POD_TipToRun/POD_TipToRun/TipToRun/TipToRunR/ManAsstRqst/ManualSpdBack/ManualAssistJudge" /begin REF_CHARACTERISTIC k_TTR_Pluse_ManualAssistMinPos /end REF_CHARACTERISTIC
 /begin REF_MEASUREMENT monr_VbTTR_ManualAssistCloseRTTR_flg monr_VbTTR_ManualAssistOpenRTTR_flg /end REF_MEASUREMENT
/end GROUP
/begin GROUP S185_ManualCloseToOpenJudge "POD_TipToRun/POD_TipToRun/TipToRun/TipToRunR/ManAsstRqst/ManualSpdBack/ManualCloseToOpenJudge" /begin SUB_GROUP S281_Rising_Debounce1 S281_Rising_Debounce2 /end SUB_GROUP
 /begin REF_CHARACTERISTIC K_TTR_Value_RoadManualOpenIMUFactor K_TTR_Value_RollManualOpenIMUFactor k_TTR_Value_IMUAngSpdAccDecRate k_TTR_Value_IMUAngSpdToOpenOffset k_TTR_Value_ManualBrkgOpenMaxAcc k_TTR_Value_ManualBrkgOpenMinAcc k_TTR_Value_ManualBrkgToOpenMinPos k_TTR_Value_ManualOpenMaxSpeed k_TTR_Value_ManualOpenMinSpeed /end REF_CHARACTERISTIC
/end GROUP
/begin GROUP S185_ManualOpenOrCloseMaxPos "POD_TipToRun/POD_TipToRun/TipToRun/TipToRunR/ManAsstRqst/ManualSpdBack/ManualOpenOrCloseMaxPos" /begin SUB_GROUP S282_Rising_Debounce /end SUB_GROUP
 /begin REF_CHARACTERISTIC k_TTR_Value_IMUAngSpdProtectMaxRebound k_TTR_Value_ManualBackMinHallSpeed /end REF_CHARACTERISTIC
 /begin REF_MEASUREMENT monr_VbTTR_ManualHallSpeedBackRTTR_flg monr_VbTTR_ManualOpenMaxHallPosDecRTTR_flg monr_VbTTR_ManualOpenMaxHallPosNoWaitRTTR_flg monr_VbTTR_ManualOpenToCloseMaxRangeRTTR_flg monr_VbTTR_MuanBrkgZeroDistanceRTTR_flg monr_VsTTR_ValueManualCloseMinHallPosRTTR_deg monr_VsTTR_ValueManualOpenMaxHallPosRTTR_deg monr_VsTTR_ValueMovInBrkgInitPositionRTTR_deg monr_VsTTR_ValueMovOutBrkgInitPositionRTTR_deg monr_VsTTR_ValueOriManualOpenMaxHallPosRTTR_deg /end REF_MEASUREMENT
/end GROUP
/begin GROUP S185_ManualOpenToCloseJudge "POD_TipToRun/POD_TipToRun/TipToRun/TipToRunR/ManAsstRqst/ManualSpdBack/ManualOpenToCloseJudge" /begin SUB_GROUP S283_Rising_Debounce1 S283_Rising_Debounce2 /end SUB_GROUP
 /begin REF_CHARACTERISTIC K_TTR_Value_RoadManualCloseIMUFactor K_TTR_Value_RollManualCloseIMUFactor k_TTR_Value_IMUAngSpdAccToCloseDecRate k_TTR_Value_IMUAngSpdToCloseOffset k_TTR_Value_ManualBrkgCloseMaxAcc k_TTR_Value_ManualBrkgToCloseMinPos k_TTR_Value_ManualCloseIMUBaseAngSpdOffset k_TTR_Value_ManualCloseMaxSpeed k_TTR_Value_ManualCloseMinSpeed /end REF_CHARACTERISTIC
 /begin REF_MEASUREMENT monr_VbTTR_IMUToManualCloseRTTR_flg monr_VbTTR_ManualCloseMovMinPosJudgeRTTR_flg /end REF_MEASUREMENT
/end GROUP
/begin GROUP S186_Rising_Debounce "POD_TipToRun/POD_TipToRun/TipToRun/TipToRunR/ManAsstRqst/StopToAssist/Rising Debounce" /begin REF_CHARACTERISTIC k_TTR_Ti_SequenceTimer k_TTR_Value_HoldModeRisTimer /end REF_CHARACTERISTIC /end GROUP
/begin GROUP S186_Rising_Debounce1 "POD_TipToRun/POD_TipToRun/TipToRun/TipToRunR/ManAsstRqst/StopToAssist/Rising Debounce1" /begin REF_CHARACTERISTIC k_TTR_Ti_SequenceTimer k_TTR_Value_HoldModeIMURisTimer /end REF_CHARACTERISTIC /end GROUP
/begin GROUP S186_Rising_Debounce2 "POD_TipToRun/POD_TipToRun/TipToRun/TipToRunR/ManAsstRqst/StopToAssist/Rising Debounce2" /begin REF_CHARACTERISTIC k_TTR_Ti_SequenceTimer k_TTR_Value_HoldModePosOnTimer /end REF_CHARACTERISTIC /end GROUP
/begin GROUP S186_Rising_Debounce3 "POD_TipToRun/POD_TipToRun/TipToRun/TipToRunR/ManAsstRqst/StopToAssist/Rising Debounce3" /begin REF_CHARACTERISTIC k_TTR_Ti_ManualAssistJudgeCnt k_TTR_Ti_SequenceTimer /end REF_CHARACTERISTIC /end GROUP
/begin GROUP S187_RisingDelay "POD_TipToRun/POD_TipToRun/TipToRun/TipToRunR/ManAsstRqst/ElecToAssist/ElecMovInBrkgIMUSpdJudge/RisingDelay" /begin REF_MEASUREMENT monr_VbTTR_ElecBrkgToAssistCloseRTTR_flg /end REF_MEASUREMENT /end GROUP
/begin GROUP S188_Rising_Debounce1 "POD_TipToRun/POD_TipToRun/TipToRun/TipToRunR/ManAsstRqst/ElecToAssist/ElecMovOutBrkgIMUSpdJudge/Rising Debounce1"
 /begin REF_CHARACTERISTIC k_TTR_Ti_DoorOpenBrkgToAssistAgSpdDelayTi k_TTR_Ti_SequenceTimer /end REF_CHARACTERISTIC
/end GROUP
/begin GROUP S188_RisingDelay "POD_TipToRun/POD_TipToRun/TipToRun/TipToRunR/ManAsstRqst/ElecToAssist/ElecMovOutBrkgIMUSpdJudge/RisingDelay" /begin REF_MEASUREMENT monr_VbTTR_ElecBrkgToAssistOpenRTTR_flg /end REF_MEASUREMENT /end GROUP
/begin GROUP S18_Rising_Debounce "POD_TipToRun/POD_TipToRun/TipToRun/TipToRunL/ManAsstRqst/StopToAssist/Rising Debounce" /begin REF_CHARACTERISTIC k_TTR_Ti_SequenceTimer k_TTR_Value_HoldModeRisTimer /end REF_CHARACTERISTIC /end GROUP
/begin GROUP S18_Rising_Debounce1 "POD_TipToRun/POD_TipToRun/TipToRun/TipToRunL/ManAsstRqst/StopToAssist/Rising Debounce1" /begin REF_CHARACTERISTIC k_TTR_Ti_SequenceTimer k_TTR_Value_HoldModeIMURisTimer /end REF_CHARACTERISTIC /end GROUP
/begin GROUP S18_Rising_Debounce2 "POD_TipToRun/POD_TipToRun/TipToRun/TipToRunL/ManAsstRqst/StopToAssist/Rising Debounce2" /begin REF_CHARACTERISTIC k_TTR_Ti_SequenceTimer k_TTR_Value_HoldModePosOnTimer /end REF_CHARACTERISTIC /end GROUP
/begin GROUP S18_Rising_Debounce3 "POD_TipToRun/POD_TipToRun/TipToRun/TipToRunL/ManAsstRqst/StopToAssist/Rising Debounce3" /begin REF_CHARACTERISTIC k_TTR_Ti_ManualAssistJudgeCnt k_TTR_Ti_SequenceTimer /end REF_CHARACTERISTIC /end GROUP
/begin GROUP S191_Falling_Debounce "POD_TipToRun/POD_TipToRun/TipToRun/TipToRunR/ManAsstRqst/ElecToAssist/ElecToAssistIMUErrorSpdOrAccJudge/Falling Debounce" /begin REF_CHARACTERISTIC k_TTR_Ti_ErrorSpeedDelayTi k_TTR_Ti_SequenceTimer /end REF_CHARACTERISTIC /end GROUP
/begin GROUP S191_Falling_Debounce1 "POD_TipToRun/POD_TipToRun/TipToRun/TipToRunR/ManAsstRqst/ElecToAssist/ElecToAssistIMUErrorSpdOrAccJudge/Falling Debounce1" /begin REF_CHARACTERISTIC k_TTR_Ti_ErrorSpeedDelayTi k_TTR_Ti_SequenceTimer /end REF_CHARACTERISTIC /end GROUP
/begin GROUP S192_Rising_Debounce "POD_TipToRun/POD_TipToRun/TipToRun/TipToRunR/ManAsstRqst/ElecToAssist/ElecToAssistIMUSpdJudge/Rising Debounce" /begin REF_CHARACTERISTIC k_TTR_Ti_LowSpeedManualOpenTi k_TTR_Ti_SequenceTimer /end REF_CHARACTERISTIC /end GROUP
/begin GROUP S192_Rising_Debounce1 "POD_TipToRun/POD_TipToRun/TipToRun/TipToRunR/ManAsstRqst/ElecToAssist/ElecToAssistIMUSpdJudge/Rising Debounce1" /begin REF_CHARACTERISTIC k_TTR_Ti_LowSpeedManualCloseTi k_TTR_Ti_SequenceTimer /end REF_CHARACTERISTIC /end GROUP
/begin GROUP S194_Rising_Debounce2 "POD_TipToRun/POD_TipToRun/TipToRun/TipToRunR/ManAsstRqst/ElecToAssist/ElecToManualCloseIMUAccJudge/Rising Debounce2"
 /begin REF_CHARACTERISTIC k_TTR_Ti_DoorCloseToAssistAccStateTi k_TTR_Ti_SequenceTimer /end REF_CHARACTERISTIC
/end GROUP
/begin GROUP S194_Rising_Debounce4 "POD_TipToRun/POD_TipToRun/TipToRun/TipToRunR/ManAsstRqst/ElecToAssist/ElecToManualCloseIMUAccJudge/Rising Debounce4" /begin REF_CHARACTERISTIC k_TTR_Ti_DoorCloseInitialTi k_TTR_Ti_SequenceTimer /end REF_CHARACTERISTIC /end GROUP
/begin GROUP S195_Rising_Debounce1 "POD_TipToRun/POD_TipToRun/TipToRun/TipToRunR/ManAsstRqst/ElecToAssist/ElecToManualOpenIMUAccJudge/Rising Debounce1" /begin REF_CHARACTERISTIC k_TTR_Ti_DoorOpenToAssistAccStateTi k_TTR_Ti_SequenceTimer /end REF_CHARACTERISTIC /end GROUP
/begin GROUP S195_Rising_Debounce2 "POD_TipToRun/POD_TipToRun/TipToRun/TipToRunR/ManAsstRqst/ElecToAssist/ElecToManualOpenIMUAccJudge/Rising Debounce2"
 /begin REF_CHARACTERISTIC k_TTR_Ti_DoorOpenDecToAssistAccStateTi k_TTR_Ti_SequenceTimer /end REF_CHARACTERISTIC
/end GROUP
/begin GROUP S195_Rising_Debounce3 "POD_TipToRun/POD_TipToRun/TipToRun/TipToRunR/ManAsstRqst/ElecToAssist/ElecToManualOpenIMUAccJudge/Rising Debounce3" /begin REF_CHARACTERISTIC k_TTR_Ti_DoorOpenInitialTi k_TTR_Ti_SequenceTimer /end REF_CHARACTERISTIC /end GROUP
/begin GROUP S19_DetClsPWMLim "RDM_DetTrunkMoveReq/RDM_DetTrunkMoveReq_Main_sys/DetPWMRqst/DetClsPWMLim" /begin REF_CHARACTERISTIC CalC_TrnkMtrPWMUpLim /end REF_CHARACTERISTIC /end GROUP
/begin GROUP S19_DetOpnStartStepTgtSpd "RDM_DetTrunkMoveReq/RDM_DetTrunkMoveReq_Main_sys/DetPWMRqst/DetOpnStartStepTgtSpd"
 /begin REF_CHARACTERISTIC CalC_TrnkOpnMtrStartStepCfg CalC_TrnkOpnSpdCtrKd CalC_TrnkOpnSpdCtrKi CalC_TrnkOpnSpdCtrKp /end REF_CHARACTERISTIC
/end GROUP
/begin GROUP S19_RisingDelay "POD_TipToRun/POD_TipToRun/TipToRun/TipToRunL/ManAsstRqst/ElecToAssist/ElecMovInBrkgIMUSpdJudge/RisingDelay" /begin REF_MEASUREMENT monr_VbTTR_ElecBrkgToAssistCloseLTTR_flg /end REF_MEASUREMENT /end GROUP
/begin GROUP S1_POD_StateManageMduleL "POD_SMML/POD_StateManageMduleL_Step_sys/POD_StateManageMduleL"
 /begin REF_MEASUREMENT monr_VbSMM_BrkFrcRelsL_flg monr_VbSMM_BrkMotModCtrlL_flg monr_VbSMM_DoorFreeMovgL_flg monr_VbSMM_ElecDoorClsReqL_flg monr_VbSMM_ElecDoorOpenReqL_flg monr_VbSMM_HoldModeL_flg monr_VbSMM_ManAsstEnableL_flg monr_VbSMM_RdrWrkReqByCEML_flg monr_VbSMM_RdrWrkReqL_flg monr_VbSMM_TiptoRunEnableL_flg monr_VeSMM_DOPFcnStateL_enum monr_VeSMM_DoorLatPosnL_enum monr_VeSMM_HoverModCtrlL_enum monr_VeSMM_MotorCtrlModeL_enum monr_VeSMM_MotorCtrlStateL_enum monr_VeSMM_OpenDoorCmdL_enum monr_VeSMM_PushLockL_NULL monr_VeSMM_StopEventL_enum monr_VeSMM_VehModStsL_enum monr_VfSMM_TopDegforDoorOpenL_NULL /end REF_MEASUREMENT
/end GROUP
/begin GROUP S1_POD_StateManageMduleR "POD_SMMR/POD_StateManageMduleR_Step_sys/POD_StateManageMduleR"
 /begin REF_MEASUREMENT monr_VbSMM_BrkFrcRelsR_flg monr_VbSMM_BrkMotModCtrlR_flg monr_VbSMM_DoorFreeMovgR_flg monr_VbSMM_ElecDoorClsReqR_flg monr_VbSMM_ElecDoorOpenReqR_flg monr_VbSMM_HoldModeR_flg monr_VbSMM_ManAsstEnableR_flg monr_VbSMM_RdrWrkReqByCEMR_flg monr_VbSMM_RdrWrkReqR_flg monr_VbSMM_TiptoRunEnableR_flg monr_VeSMM_DOPFcnStateR_enum monr_VeSMM_DoorLatPosnR_enum monr_VeSMM_HoverModCtrlR_enum monr_VeSMM_MotorCtrlModeR_enum monr_VeSMM_MotorCtrlStateR_enum monr_VeSMM_OpenDoorCmdR_enum monr_VeSMM_PushLockR_NULL monr_VeSMM_StopEventR_enum monr_VeSMM_VehModStsR_enum monr_VfSMM_TopDegforDoorOpenR_NULL /end REF_MEASUREMENT
/end GROUP
/begin GROUP S20_Rising_Debounce1 "POD_TipToRun/POD_TipToRun/TipToRun/TipToRunL/ManAsstRqst/ElecToAssist/ElecMovOutBrkgIMUSpdJudge/Rising Debounce1"
 /begin REF_CHARACTERISTIC k_TTR_Ti_DoorOpenBrkgToAssistAgSpdDelayTi k_TTR_Ti_SequenceTimer /end REF_CHARACTERISTIC
/end GROUP
/begin GROUP S20_RisingDelay "POD_TipToRun/POD_TipToRun/TipToRun/TipToRunL/ManAsstRqst/ElecToAssist/ElecMovOutBrkgIMUSpdJudge/RisingDelay" /begin REF_MEASUREMENT monr_VbTTR_ElecBrkgToAssistOpenLTTR_flg /end REF_MEASUREMENT /end GROUP
/begin GROUP S214_DoorMove "POD_FaultHandle/POD_FaultHandle/FaultHandle/LVM/LVMR/State/DoorMove" /begin REF_CHARACTERISTIC KuLVM_DoorHallChgDebTi_s /end REF_CHARACTERISTIC /end GROUP
/begin GROUP S21_ReferenceCurrentRes "POD_AntiPinch/POD_AntiPinch/AntiPinch/AntiPinchL/AntiPinchCurOffset/ReferenceCurrent/KeepReferenceCurrentFlag/ReferenceCurrentRes" /begin SUB_GROUP S25_Rising_Debounce1 /end SUB_GROUP /begin REF_MEASUREMENT monr_VbAP_ReferenceCurrentResLAP_flg /end REF_MEASUREMENT /end GROUP
/begin GROUP S21_ReferenceCurrentSet "POD_AntiPinch/POD_AntiPinch/AntiPinch/AntiPinchL/AntiPinchCurOffset/ReferenceCurrent/KeepReferenceCurrentFlag/ReferenceCurrentSet" /begin SUB_GROUP S26_Rising_Debounce S26_Rising_Debounce2 /end SUB_GROUP
 /begin REF_CHARACTERISTIC K_ADP_Value_ErrPositionDiffMin k_ADP_Value_CurrentIncMinRateforAntiPinch k_ADP_Value_ErrPosCurMinRateforAntiPinch k_ADP_Value_PosErrHoldRateforAntiPinch /end REF_CHARACTERISTIC
 /begin REF_MEASUREMENT monr_VbAP_ReferenceCurrentSetLAP_flg /end REF_MEASUREMENT
/end GROUP
/begin GROUP S21_RS "POD_AntiPinch/POD_AntiPinch/AntiPinch/AntiPinchL/AntiPinchCurOffset/ReferenceCurrent/KeepReferenceCurrentFlag/RS" /begin SUB_GROUP S24_Switch1 /end SUB_GROUP /end GROUP
/begin GROUP S22_CEM "POD_SignalHandModule_T/POD_SignalHandModule/SignalHandModule/INP/INPL/CEM" /begin SUB_GROUP S24_FrontInclineAngle S24_SideInclineAngle /end SUB_GROUP /begin REF_MEASUREMENT monr_VeSHM_DoorWrkReqL_enum /end REF_MEASUREMENT /end GROUP
/begin GROUP S22_Rising_Debounce "POD_AntiPinch/POD_AntiPinch/AntiPinch/AntiPinchL/AntiPinchCurOffset/ReferenceCurrent/ReferenceCurrent/Rising Debounce"
 /begin REF_CHARACTERISTIC k_ADP_Ti_AntiPinchSequenceTimer k_ADP_Ti_MinPositionDelayTimer /end REF_CHARACTERISTIC
/end GROUP
/begin GROUP S235_Switch1 "POD_HallHandleModule_TZCU/POD_HallHandleModule/HallHandleModule/HallHandleModuleL/HallErrorProcess/SenorErr/RS/Switch1" /begin REF_MEASUREMENT monr_VbHHM_HallSigFltL_flg /end REF_MEASUREMENT /end GROUP
/begin GROUP S237_Enabled_Subsystem "RDM_DetTrunkMoveReq/RDM_DetTrunkMoveReq_Main_sys/RqstPreProcess/DetManualPushTrig/Enabled Subsystem" /begin REF_CHARACTERISTIC CalC_TrnkPshMvStMinPosDist CalC_hIPLGServoTrig_cnt /end REF_CHARACTERISTIC /end GROUP
/begin GROUP S23_ADCHandleModule "POD_SignalHandModule_T/POD_SignalHandModule/SignalHandModule/INP/INPR/ADCHandleModule" /begin SUB_GROUP S39_1stOrderFilter4 /end SUB_GROUP /begin REF_CHARACTERISTIC k_ADCH_Fac_FilterForMaiMotCurr /end REF_CHARACTERISTIC /end GROUP
/begin GROUP S23_CEM "POD_SignalHandModule_T/POD_SignalHandModule/SignalHandModule/INP/INPR/CEM" /begin SUB_GROUP S40_FrontInclineAngle S40_SideInclineAngle /end SUB_GROUP /end GROUP
/begin GROUP S23_DIO "POD_SignalHandModule_T/POD_SignalHandModule/SignalHandModule/INP/INPR/DIO" /begin REF_MEASUREMENT monr_VeSHM_DoorWrkReqR_enum /end REF_MEASUREMENT /end GROUP
/begin GROUP S23_Falling_Debounce "POD_TipToRun/POD_TipToRun/TipToRun/TipToRunL/ManAsstRqst/ElecToAssist/ElecToAssistIMUErrorSpdOrAccJudge/Falling Debounce" /begin REF_CHARACTERISTIC k_TTR_Ti_ErrorSpeedDelayTi k_TTR_Ti_SequenceTimer /end REF_CHARACTERISTIC /end GROUP
/begin GROUP S23_Falling_Debounce1 "POD_TipToRun/POD_TipToRun/TipToRun/TipToRunL/ManAsstRqst/ElecToAssist/ElecToAssistIMUErrorSpdOrAccJudge/Falling Debounce1" /begin REF_CHARACTERISTIC k_TTR_Ti_ErrorSpeedDelayTi k_TTR_Ti_SequenceTimer /end REF_CHARACTERISTIC /end GROUP
/begin GROUP S242_Rising_Debounce1 "POD_HallHandleModule_TZCU/POD_HallHandleModule/HallHandleModule/HallHandleModuleL/HallErrorProcess/SenorErr_Reset/MovReset/Rising Debounce1" /begin REF_CHARACTERISTIC k_HHM_Ti_TimeWakeUp /end REF_CHARACTERISTIC /end GROUP
/begin GROUP S24_FrontInclineAngle "POD_SignalHandModule_T/POD_SignalHandModule/SignalHandModule/INP/INPL/CEM/FrontInclineAngle" /begin REF_MEASUREMENT monr_VfSHM_FrntIncinAgL_deg /end REF_MEASUREMENT /end GROUP
/begin GROUP S24_Rising_Debounce "POD_TipToRun/POD_TipToRun/TipToRun/TipToRunL/ManAsstRqst/ElecToAssist/ElecToAssistIMUSpdJudge/Rising Debounce" /begin REF_CHARACTERISTIC k_TTR_Ti_LowSpeedManualOpenTi k_TTR_Ti_SequenceTimer /end REF_CHARACTERISTIC /end GROUP
/begin GROUP S24_Rising_Debounce1 "POD_TipToRun/POD_TipToRun/TipToRun/TipToRunL/ManAsstRqst/ElecToAssist/ElecToAssistIMUSpdJudge/Rising Debounce1" /begin REF_CHARACTERISTIC k_TTR_Ti_LowSpeedManualCloseTi k_TTR_Ti_SequenceTimer /end REF_CHARACTERISTIC /end GROUP
/begin GROUP S24_SideInclineAngle "POD_SignalHandModule_T/POD_SignalHandModule/SignalHandModule/INP/INPL/CEM/SideInclineAngle" /begin REF_MEASUREMENT monr_VfSHM_SideIncinAgL_deg /end REF_MEASUREMENT /end GROUP
/begin GROUP S24_Switch1 "POD_AntiPinch/POD_AntiPinch/AntiPinch/AntiPinchL/AntiPinchCurOffset/ReferenceCurrent/KeepReferenceCurrentFlag/RS/Switch1" /begin REF_MEASUREMENT monr_VbAP_KeepReferenceCurrentLAP_flg /end REF_MEASUREMENT /end GROUP
/begin GROUP S250_DoorHallPosition "POD_HallHandleModule_TZCU/POD_HallHandleModule/HallHandleModule/HallHandleModuleR/AngleConversion/DoorHallPosition"
 /begin REF_MEASUREMENT monr_VbHHM_DoorOpenR_flg monr_VsHHM_AswHallPositionR_NULL monr_VsHHM_HallCntrR_NULL /end REF_MEASUREMENT
/end GROUP
/begin GROUP S250_DoorOpenTargetPosition "POD_HallHandleModule_TZCU/POD_HallHandleModule/HallHandleModule/HallHandleModuleR/AngleConversion/DoorOpenTargetPosition" /begin SUB_GROUP S257_Rising_Debounce /end SUB_GROUP /begin REF_CHARACTERISTIC k_HHM_Deg_MinOpenAngSwt /end REF_CHARACTERISTIC /begin REF_MEASUREMENT monr_VeHHM_UsrSetMaxPstnR_pct /end REF_MEASUREMENT /end GROUP
/begin GROUP S250_PercPosn2AndPosn2 "POD_HallHandleModule_TZCU/POD_HallHandleModule/HallHandleModule/HallHandleModuleR/AngleConversion/PercPosn2AndPosn2" /begin REF_CHARACTERISTIC k_HHM_Value_Pluse2Deg /end REF_CHARACTERISTIC /begin REF_MEASUREMENT monr_VfHHM_AswHallPositionR_deg monr_VfHHM_DoorPstnR_pct /end REF_MEASUREMENT /end GROUP
/begin GROUP S250_TopDegforDoorOpen "POD_HallHandleModule_TZCU/POD_HallHandleModule/HallHandleModule/HallHandleModuleR/AngleConversion/TopDegforDoorOpen" /begin REF_CHARACTERISTIC k_HHM_Deg_MaxOpenPosition /end REF_CHARACTERISTIC /begin REF_MEASUREMENT monr_VfHHM_MaxOpenPositionR_deg /end REF_MEASUREMENT /end GROUP
/begin GROUP S252_DoorMovSts_Chart "POD_HallHandleModule_TZCU/POD_HallHandleModule/HallHandleModule/HallHandleModuleR/DoorMovSts/DoorMovSts_Chart" /begin REF_MEASUREMENT monr_VeHHM_DoorMovStsR_NULL /end REF_MEASUREMENT /end GROUP
/begin GROUP S252_ElecMov "POD_HallHandleModule_TZCU/POD_HallHandleModule/HallHandleModule/HallHandleModuleR/DoorMovSts/ElecMov"
 /begin REF_MEASUREMENT monr_VbHHM_BooleanDownRHHM_flg monr_VbHHM_BooleanUpRHHM_flg /end REF_MEASUREMENT
/end GROUP
/begin GROUP S252_Hold "POD_HallHandleModule_TZCU/POD_HallHandleModule/HallHandleModule/HallHandleModuleR/DoorMovSts/Hold"
 /begin SUB_GROUP S273_ClosingInLock S273_DoorStateErrorJudge S273_DooStop S273_ElecDoorStop S273_ManualDoorStop /end SUB_GROUP
 /begin REF_MEASUREMENT monr_VbHHM_BooleanHoldRHHM_flg /end REF_MEASUREMENT
/end GROUP
/begin GROUP S252_IMUseMinAge "POD_HallHandleModule_TZCU/POD_HallHandleModule/HallHandleModule/HallHandleModuleR/DoorMovSts/IMUseMinAge" /begin REF_CHARACTERISTIC k_HHM_Pluse_FilterMinHallPosition /end REF_CHARACTERISTIC /end GROUP
/begin GROUP S252_ManualMov "POD_HallHandleModule_TZCU/POD_HallHandleModule/HallHandleModule/HallHandleModuleR/DoorMovSts/ManualMov" /begin SUB_GROUP S275_ManualJudge S275_PerManualMovDoor /end SUB_GROUP /end GROUP
/begin GROUP S252_POD_GetSector "POD_HallHandleModule_TZCU/POD_HallHandleModule/HallHandleModule/HallHandleModuleR/DoorMovSts/POD_GetSector" /begin SUB_GROUP S276_SectorTopClose S276_SectorTopOpen /end SUB_GROUP /end GROUP
/begin GROUP S252_PreOpenOrClsd "POD_HallHandleModule_TZCU/POD_HallHandleModule/HallHandleModule/HallHandleModuleR/DoorMovSts/PreOpenOrClsd" /begin REF_MEASUREMENT monr_VbHHM_PreClsdRHHM_flg monr_VbHHM_PreOpenRHHM_flg /end REF_MEASUREMENT /end GROUP
/begin GROUP S253_HallPosition "POD_HallHandleModule_TZCU/POD_HallHandleModule/HallHandleModule/HallHandleModuleR/HallCntrHandle/HallPosition" /begin SUB_GROUP S331_ASWHallInit S331_DrvHallNum S331_HallInitialization /end SUB_GROUP /end GROUP
/begin GROUP S253_HallSpeed "POD_HallHandleModule_TZCU/POD_HallHandleModule/HallHandleModule/HallHandleModuleR/HallCntrHandle/HallSpeed"
 /begin SUB_GROUP S332_DirectionJudge S332_HallFixedTiOffset S332_HallSpeedJudge /end SUB_GROUP
/end GROUP
/begin GROUP S254_HALL_AFault "POD_HallHandleModule_TZCU/POD_HallHandleModule/HallHandleModule/HallHandleModuleR/HallErrorProcess/HALL_AFault"
 /begin SUB_GROUP S375_Rising_Debounce S375_Rising_Debounce1 S375_Rising_Debounce2 S375_Rising_Debounce3 /end SUB_GROUP
 /begin REF_CHARACTERISTIC k_HHM_Value_HallAMovFreqMaxPrt k_HHM_Value_HallASenorErrCurrentPrt k_HHM_Value_HallASenorIMUAngSpdPrt /end REF_CHARACTERISTIC
 /begin REF_MEASUREMENT monr_VbHHM_HALLAErrEnableRHHM_flg monr_VbHHM_HALLAFaultRHHM_flg /end REF_MEASUREMENT
/end GROUP
/begin GROUP S254_HALL_BFault "POD_HallHandleModule_TZCU/POD_HallHandleModule/HallHandleModule/HallHandleModuleR/HallErrorProcess/HALL_BFault"
 /begin SUB_GROUP S376_Falling_Debounce S376_Falling_Debounce1 S376_Rising_Debounce S376_Rising_Debounce1 S376_Rising_Debounce2 S376_Rising_Debounce3 S376_Rising_Debounce4 S376_Rising_Debounce5 S376_Rising_Debounce6 S376_Rising_Debounce7 /end SUB_GROUP
 /begin REF_CHARACTERISTIC k_HHM_Value_HallDirErrMinAbsSpeed k_HHM_Value_HallDirErrMinClsdSpeed k_HHM_Value_HallDirErrMinOpenSpeed k_HHM_Value_HallPWMErrCurrentPrt k_HHM_Value_HallPWMIMUAngSpdPrt k_HHM_Value_HallPwmMinValue /end REF_CHARACTERISTIC
 /begin REF_MEASUREMENT monr_VbHHM_CloseTheDoorHallErrRHHM_flg monr_VbHHM_OnlyHallPWMErrRHHM_flg monr_VbHHM_OpenTheDoorHallErrRHHM_flg /end REF_MEASUREMENT
/end GROUP
/begin GROUP S254_HallJudgeCondition "POD_HallHandleModule_TZCU/POD_HallHandleModule/HallHandleModule/HallHandleModuleR/HallErrorProcess/HallJudgeCondition" /begin SUB_GROUP S377_Rising_Debounce S377_Rising_Debounce1 /end SUB_GROUP
 /begin REF_CHARACTERISTIC k_HHM_Value_HallErrMinSpeed k_HHM_Value_HallErrSlope k_HHM_Value_HallErrSpeedOffset k_HHM_Value_cfgHallPole /end REF_CHARACTERISTIC
 /begin REF_MEASUREMENT monr_VbHHM_HallErrEnableRHHM_flg /end REF_MEASUREMENT
/end GROUP
/begin GROUP S254_SenorErr "POD_HallHandleModule_TZCU/POD_HallHandleModule/HallHandleModule/HallHandleModuleR/HallErrorProcess/SenorErr" /begin SUB_GROUP S378_RS /end SUB_GROUP /end GROUP
/begin GROUP S254_SenorErr_Reset "POD_HallHandleModule_TZCU/POD_HallHandleModule/HallHandleModule/HallHandleModuleR/HallErrorProcess/SenorErr_Reset" /begin SUB_GROUP S379_cnt S379_MovReset S379_Rising_Debounce2 /end SUB_GROUP /end GROUP
/begin GROUP S257_Rising_Debounce "POD_HallHandleModule_TZCU/POD_HallHandleModule/HallHandleModule/HallHandleModuleR/AngleConversion/DoorOpenTargetPosition/Rising Debounce" /begin REF_CHARACTERISTIC k_HHM_Ti_TimeInsdSetPstnDelay /end REF_CHARACTERISTIC /end GROUP
/begin GROUP S25_Rising_Debounce1 "POD_AntiPinch/POD_AntiPinch/AntiPinch/AntiPinchL/AntiPinchCurOffset/ReferenceCurrent/KeepReferenceCurrentFlag/ReferenceCurrentRes/Rising Debounce1" /begin REF_CHARACTERISTIC k_ADP_Ti_AntiPinchSequenceTimer k_ADP_Ti_RefCurrResTimer /end REF_CHARACTERISTIC /end GROUP
/begin GROUP S26_Rising_Debounce "POD_AntiPinch/POD_AntiPinch/AntiPinch/AntiPinchL/AntiPinchCurOffset/ReferenceCurrent/KeepReferenceCurrentFlag/ReferenceCurrentSet/Rising Debounce"
 /begin REF_CHARACTERISTIC k_ADP_Ti_AntiPinchSequenceTimer k_ADP_Ti_CurrentIncreaseTimer /end REF_CHARACTERISTIC
/end GROUP
/begin GROUP S26_Rising_Debounce2 "POD_AntiPinch/POD_AntiPinch/AntiPinch/AntiPinchL/AntiPinchCurOffset/ReferenceCurrent/KeepReferenceCurrentFlag/ReferenceCurrentSet/Rising Debounce2" ROOT
 /begin REF_CHARACTERISTIC k_ADP_Ti_AntiPinchSequenceTimer k_ADP_Ti_AntiPinchforMinErrPositionDelayTimer /end REF_CHARACTERISTIC
/end GROUP
/begin GROUP S26_Rising_Debounce2 "POD_TipToRun/POD_TipToRun/TipToRun/TipToRunL/ManAsstRqst/ElecToAssist/ElecToManualCloseIMUAccJudge/Rising Debounce2" ROOT
 /begin REF_CHARACTERISTIC k_TTR_Ti_DoorCloseToAssistAccStateTi k_TTR_Ti_SequenceTimer /end REF_CHARACTERISTIC
/end GROUP
/begin GROUP S26_Rising_Debounce4 "POD_TipToRun/POD_TipToRun/TipToRun/TipToRunL/ManAsstRqst/ElecToAssist/ElecToManualCloseIMUAccJudge/Rising Debounce4" /begin REF_CHARACTERISTIC k_TTR_Ti_DoorCloseInitialTi k_TTR_Ti_SequenceTimer /end REF_CHARACTERISTIC /end GROUP
/begin GROUP S273_ClosingInLock "POD_HallHandleModule_TZCU/POD_HallHandleModule/HallHandleModule/HallHandleModuleR/DoorMovSts/Hold/ClosingInLock" /begin SUB_GROUP S279_Rising_Debounce /end SUB_GROUP /end GROUP
/begin GROUP S273_DoorStateErrorJudge "POD_HallHandleModule_TZCU/POD_HallHandleModule/HallHandleModule/HallHandleModuleR/DoorMovSts/Hold/DoorStateErrorJudge" /begin SUB_GROUP S281_Rising_Debounce4 /end SUB_GROUP /end GROUP
/begin GROUP S273_DooStop "POD_HallHandleModule_TZCU/POD_HallHandleModule/HallHandleModule/HallHandleModuleR/DoorMovSts/Hold/DooStop" /begin SUB_GROUP S280_Rising_Debounce S280_Rising_Debounce1 /end SUB_GROUP /begin REF_CHARACTERISTIC k_HHM_Value_ManualHoldIMUAngSpdMinSpeed /end REF_CHARACTERISTIC /end GROUP
/begin GROUP S273_ElecDoorStop "POD_HallHandleModule_TZCU/POD_HallHandleModule/HallHandleModule/HallHandleModuleR/DoorMovSts/Hold/ElecDoorStop" /begin SUB_GROUP S282_Rising_Debounce /end SUB_GROUP /end GROUP
/begin GROUP S273_ManualDoorStop "POD_HallHandleModule_TZCU/POD_HallHandleModule/HallHandleModule/HallHandleModuleR/DoorMovSts/Hold/ManualDoorStop" /begin REF_CHARACTERISTIC k_HHM_Ti_TimeHoldManualDoorStopMovSts /end REF_CHARACTERISTIC /end GROUP
/begin GROUP S275_ManualJudge "POD_HallHandleModule_TZCU/POD_HallHandleModule/HallHandleModule/HallHandleModuleR/DoorMovSts/ManualMov/ManualJudge"
 /begin REF_MEASUREMENT monr_VbHHM_BooleanManualDownRHHM_flg monr_VbHHM_BooleanManualUpRHHM_flg /end REF_MEASUREMENT
/end GROUP
/begin GROUP S275_PerManualMovDoor "POD_HallHandleModule_TZCU/POD_HallHandleModule/HallHandleModule/HallHandleModuleR/DoorMovSts/ManualMov/PerManualMovDoor"
 /begin SUB_GROUP S307_Rising_Debounce S307_Rising_Debounce1 S307_Rising_Debounce2 S307_Rising_Debounce3 /end SUB_GROUP
 /begin REF_CHARACTERISTIC k_HHM_Value_ManualCloseHallSpeed k_HHM_Value_ManualCloseIMUAngSpdMinSpeed k_HHM_Value_ManualOpenHallSpeed k_HHM_Value_ManualOpenIMUAngSpdMinSpeed /end REF_CHARACTERISTIC
/end GROUP
/begin GROUP S276_SectorTopClose "POD_HallHandleModule_TZCU/POD_HallHandleModule/HallHandleModule/HallHandleModuleR/DoorMovSts/POD_GetSector/SectorTopClose" /begin REF_CHARACTERISTIC k_HHM_Value_SectorForClose /end REF_CHARACTERISTIC /end GROUP
/begin GROUP S276_SectorTopOpen "POD_HallHandleModule_TZCU/POD_HallHandleModule/HallHandleModule/HallHandleModuleR/DoorMovSts/POD_GetSector/SectorTopOpen" /begin REF_CHARACTERISTIC k_HHM_Value_SectorForOpen /end REF_CHARACTERISTIC /end GROUP
/begin GROUP S279_Rising_Debounce "POD_HallHandleModule_TZCU/POD_HallHandleModule/HallHandleModule/HallHandleModuleR/DoorMovSts/Hold/ClosingInLock/Rising Debounce" /begin REF_CHARACTERISTIC k_HHM_Ti_TimeClosingInLockHoldMovSts /end REF_CHARACTERISTIC /end GROUP
/begin GROUP S27_Rising_Debounce1 "POD_TipToRun/POD_TipToRun/TipToRun/TipToRunL/ManAsstRqst/ElecToAssist/ElecToManualOpenIMUAccJudge/Rising Debounce1" /begin REF_CHARACTERISTIC k_TTR_Ti_DoorOpenToAssistAccStateTi k_TTR_Ti_SequenceTimer /end REF_CHARACTERISTIC /end GROUP
/begin GROUP S27_Rising_Debounce2 "POD_TipToRun/POD_TipToRun/TipToRun/TipToRunL/ManAsstRqst/ElecToAssist/ElecToManualOpenIMUAccJudge/Rising Debounce2"
 /begin REF_CHARACTERISTIC k_TTR_Ti_DoorOpenDecToAssistAccStateTi k_TTR_Ti_SequenceTimer /end REF_CHARACTERISTIC
/end GROUP
/begin GROUP S27_Rising_Debounce3 "POD_TipToRun/POD_TipToRun/TipToRun/TipToRunL/ManAsstRqst/ElecToAssist/ElecToManualOpenIMUAccJudge/Rising Debounce3" /begin REF_CHARACTERISTIC k_TTR_Ti_DoorOpenInitialTi k_TTR_Ti_SequenceTimer /end REF_CHARACTERISTIC /end GROUP
/begin GROUP S27_Switch "POD_FaultHandle/POD_FaultHandle/FaultHandle/AntiPlay/AntiPlayL/AntiplayStatus/AntiPlayState/Signal_Override/Switch" /begin REF_MEASUREMENT monr_VbFH_AnptiplayL_flg /end REF_MEASUREMENT /end GROUP
/begin GROUP S280_Rising_Debounce "POD_HallHandleModule_TZCU/POD_HallHandleModule/HallHandleModule/HallHandleModuleR/DoorMovSts/Hold/DooStop/Rising Debounce" /begin REF_CHARACTERISTIC k_HHM_Ti_TimeIMUDoorStopMovSts /end REF_CHARACTERISTIC /end GROUP
/begin GROUP S280_Rising_Debounce1 "POD_HallHandleModule_TZCU/POD_HallHandleModule/HallHandleModule/HallHandleModuleR/DoorMovSts/Hold/DooStop/Rising Debounce1" /begin REF_CHARACTERISTIC k_HHM_Ti_TimeHallSpdNoMov /end REF_CHARACTERISTIC /end GROUP
/begin GROUP S281_Rising_Debounce1 "POD_TipToRun/POD_TipToRun/TipToRun/TipToRunR/ManAsstRqst/ManualSpdBack/ManualCloseToOpenJudge/Rising Debounce1" /begin REF_CHARACTERISTIC k_TTR_Ti_ManualOpenSpdAccDelayTi k_TTR_Ti_SequenceTimer /end REF_CHARACTERISTIC /end GROUP
/begin GROUP S281_Rising_Debounce2 "POD_TipToRun/POD_TipToRun/TipToRun/TipToRunR/ManAsstRqst/ManualSpdBack/ManualCloseToOpenJudge/Rising Debounce2"
 /begin REF_CHARACTERISTIC k_TTR_Ti_ManualCloseDistanceMaxJudgeTi k_TTR_Ti_SequenceTimer /end REF_CHARACTERISTIC
/end GROUP
/begin GROUP S281_Rising_Debounce4 "POD_HallHandleModule_TZCU/POD_HallHandleModule/HallHandleModule/HallHandleModuleR/DoorMovSts/Hold/DoorStateErrorJudge/Rising Debounce4" /begin REF_CHARACTERISTIC k_HHM_Ti_TimeHoldDoorErrorMovSts /end REF_CHARACTERISTIC /end GROUP
/begin GROUP S282_Rising_Debounce "POD_HallHandleModule_TZCU/POD_HallHandleModule/HallHandleModule/HallHandleModuleR/DoorMovSts/Hold/ElecDoorStop/Rising Debounce" ROOT /begin REF_CHARACTERISTIC k_HHM_Ti_TimeHoldDoorStopMovSts /end REF_CHARACTERISTIC /end GROUP
/begin GROUP S282_Rising_Debounce "POD_TipToRun/POD_TipToRun/TipToRun/TipToRunR/ManAsstRqst/ManualSpdBack/ManualOpenOrCloseMaxPos/Rising Debounce" ROOT /begin REF_CHARACTERISTIC k_TTR_Ti_ManualOpenMaxPosJudgeTi k_TTR_Ti_SequenceTimer /end REF_CHARACTERISTIC /end GROUP
/begin GROUP S283_Rising_Debounce1 "POD_TipToRun/POD_TipToRun/TipToRun/TipToRunR/ManAsstRqst/ManualSpdBack/ManualOpenToCloseJudge/Rising Debounce1" /begin REF_CHARACTERISTIC k_TTR_Ti_ManualCloseSpdAccDelayTi k_TTR_Ti_SequenceTimer /end REF_CHARACTERISTIC /end GROUP
/begin GROUP S283_Rising_Debounce2 "POD_TipToRun/POD_TipToRun/TipToRun/TipToRunR/ManAsstRqst/ManualSpdBack/ManualOpenToCloseJudge/Rising Debounce2"
 /begin REF_CHARACTERISTIC k_TTR_Ti_ManualCloseDistanceMaxJudgeTi k_TTR_Ti_SequenceTimer /end REF_CHARACTERISTIC
/end GROUP
/begin GROUP S28_DetManualPushTrig "RDM_DetTrunkMoveReq/RDM_DetTrunkMoveReq_Main_sys/RqstPreProcess/DetManualPushTrig" /begin SUB_GROUP S237_Enabled_Subsystem /end SUB_GROUP /end GROUP
/begin GROUP S28_Timer_Debounce "POD_FaultHandle/POD_FaultHandle/FaultHandle/AntiPlay/AntiPlayL/AntiplayStatus/AntiPlayState/Time Holding Boolean/Timer Debounce"
 /begin REF_CHARACTERISTIC k_ADP_Ti_AntiPlaySequenceTimer k_ADP_Ti_TimeActiveProtectionThreshold /end REF_CHARACTERISTIC
/end GROUP
/begin GROUP S2_AntiPinch "POD_AntiPinch/POD_AntiPinch/AntiPinch" /begin SUB_GROUP S3_AntiPinchL S3_AntiPinchR /end SUB_GROUP /end GROUP
/begin GROUP S2_Cal_RDM_FITIn "RDM_FITIn/RDM_FITIn_Main_sys/Cal_RDM_FITIn" /begin SUB_GROUP S3_Subsystem S3_Subsystem1 /end SUB_GROUP
 /begin REF_CHARACTERISTIC CalEn_FIN_KeyTrnkRqst CalEn_FIN_TrnkRelsDrvSw CalEn_FIN_TrnkRelsExtSw CalEn_FIN_TrnkRelsIntSw CalVal_FIN_KeyTrnkRqst CalVal_FIN_TrnkRelsDrvSw CalVal_FIN_TrnkRelsExtSw CalVal_FIN_TrnkRelsIntSw /end REF_CHARACTERISTIC
 /begin REF_MEASUREMENT Monr_FIN_KeyTrnkRqst Monr_FIN_TrnkRelsDrvSw Monr_FIN_TrnkRelsExtSw Monr_FIN_TrnkRelsIntSw /end REF_MEASUREMENT
/end GROUP
/begin GROUP S331_DrvHallNum "POD_HallHandleModule_TZCU/POD_HallHandleModule/HallHandleModule/HallHandleModuleR/HallCntrHandle/HallPosition/DrvHallNum" /begin REF_CHARACTERISTIC k_HHM_Value_Multiple /end REF_CHARACTERISTIC /end GROUP
/begin GROUP S332_HallSpeedJudge "POD_HallHandleModule_TZCU/POD_HallHandleModule/HallHandleModule/HallHandleModuleR/HallCntrHandle/HallSpeed/HallSpeedJudge"
 /begin REF_CHARACTERISTIC k_HHM_Value_Minus2Sec k_HHM_Value_Sec2Milsec k_HHM_Value_cfgHallHandlePeriod k_HHM_Value_cfgHallPole /end REF_CHARACTERISTIC
/end GROUP
/begin GROUP S333_Rising_Debounce "POD_HallHandleModule_TZCU/POD_HallHandleModule/HallHandleModule/HallHandleModuleR/HallCntrHandle/HallPosition/ASWHallInit/Rising Debounce" /begin REF_CHARACTERISTIC k_HHM_Ti_TimeHallInitDelay /end REF_CHARACTERISTIC /end GROUP
/begin GROUP S335_LckState "POD_HallHandleModule_TZCU/POD_HallHandleModule/HallHandleModule/HallHandleModuleR/HallCntrHandle/HallPosition/HallInitialization/LckState" /begin REF_CHARACTERISTIC k_HHM_Value_PushLockMaxD k_HHM_Value_PushLockMaxF /end REF_CHARACTERISTIC /end GROUP
/begin GROUP S351_Rising_Debounce1 "POD_HallHandleModule_TZCU/POD_HallHandleModule/HallHandleModule/HallHandleModuleR/HallCntrHandle/HallPosition/HallInitialization/LckState/Rising Debounce1" /begin REF_CHARACTERISTIC k_HHM_Ti_TimeHalfClsdDelay /end REF_CHARACTERISTIC /end GROUP
/begin GROUP S375_Rising_Debounce "POD_HallHandleModule_TZCU/POD_HallHandleModule/HallHandleModule/HallHandleModuleR/HallErrorProcess/HALL_AFault/Rising Debounce" /begin REF_CHARACTERISTIC k_HHM_Ti_HallAErrorConTi /end REF_CHARACTERISTIC /end GROUP
/begin GROUP S375_Rising_Debounce1 "POD_HallHandleModule_TZCU/POD_HallHandleModule/HallHandleModule/HallHandleModuleR/HallErrorProcess/HALL_AFault/Rising Debounce1" /begin REF_CHARACTERISTIC k_HHM_Ti_HallAErrorConTi /end REF_CHARACTERISTIC /end GROUP
/begin GROUP S375_Rising_Debounce2 "POD_HallHandleModule_TZCU/POD_HallHandleModule/HallHandleModule/HallHandleModuleR/HallErrorProcess/HALL_AFault/Rising Debounce2" /begin REF_CHARACTERISTIC k_HHM_Ti_HallNumAStaticTi /end REF_CHARACTERISTIC /end GROUP
/begin GROUP S375_Rising_Debounce3 "POD_HallHandleModule_TZCU/POD_HallHandleModule/HallHandleModule/HallHandleModuleR/HallErrorProcess/HALL_AFault/Rising Debounce3" /begin REF_CHARACTERISTIC k_HHM_Ti_HallDirAErrorTi /end REF_CHARACTERISTIC /end GROUP
/begin GROUP S376_Falling_Debounce "POD_HallHandleModule_TZCU/POD_HallHandleModule/HallHandleModule/HallHandleModuleR/HallErrorProcess/HALL_BFault/Falling Debounce" /begin REF_CHARACTERISTIC k_HHM_Ti_HallReveMaxTi /end REF_CHARACTERISTIC /end GROUP
/begin GROUP S376_Falling_Debounce1 "POD_HallHandleModule_TZCU/POD_HallHandleModule/HallHandleModule/HallHandleModuleR/HallErrorProcess/HALL_BFault/Falling Debounce1" /begin REF_CHARACTERISTIC k_HHM_Ti_HallReveMaxTi /end REF_CHARACTERISTIC /end GROUP
/begin GROUP S376_Rising_Debounce "POD_HallHandleModule_TZCU/POD_HallHandleModule/HallHandleModule/HallHandleModuleR/HallErrorProcess/HALL_BFault/Rising Debounce" /begin REF_CHARACTERISTIC k_HHM_Ti_HallPWMErrorConTi /end REF_CHARACTERISTIC /end GROUP
/begin GROUP S376_Rising_Debounce1 "POD_HallHandleModule_TZCU/POD_HallHandleModule/HallHandleModule/HallHandleModuleR/HallErrorProcess/HALL_BFault/Rising Debounce1" /begin REF_CHARACTERISTIC k_HHM_Ti_OpenDoorHallPWMStaticTi /end REF_CHARACTERISTIC /end GROUP
/begin GROUP S376_Rising_Debounce2 "POD_HallHandleModule_TZCU/POD_HallHandleModule/HallHandleModule/HallHandleModuleR/HallErrorProcess/HALL_BFault/Rising Debounce2" /begin REF_CHARACTERISTIC k_HHM_Ti_OpenDoorHallDecTi /end REF_CHARACTERISTIC /end GROUP
/begin GROUP S376_Rising_Debounce3 "POD_HallHandleModule_TZCU/POD_HallHandleModule/HallHandleModule/HallHandleModuleR/HallErrorProcess/HALL_BFault/Rising Debounce3" /begin REF_CHARACTERISTIC k_HHM_Ti_CloseDoorHallIncTi /end REF_CHARACTERISTIC /end GROUP
/begin GROUP S376_Rising_Debounce4 "POD_HallHandleModule_TZCU/POD_HallHandleModule/HallHandleModule/HallHandleModuleR/HallErrorProcess/HALL_BFault/Rising Debounce4" /begin REF_CHARACTERISTIC k_HHM_Ti_CloseDoorHallPWMStaticTi /end REF_CHARACTERISTIC /end GROUP
/begin GROUP S376_Rising_Debounce5 "POD_HallHandleModule_TZCU/POD_HallHandleModule/HallHandleModule/HallHandleModuleR/HallErrorProcess/HALL_BFault/Rising Debounce5" /begin REF_CHARACTERISTIC k_HHM_Ti_HallPWMErrorConTi /end REF_CHARACTERISTIC /end GROUP
/begin GROUP S376_Rising_Debounce6 "POD_HallHandleModule_TZCU/POD_HallHandleModule/HallHandleModule/HallHandleModuleR/HallErrorProcess/HALL_BFault/Rising Debounce6" /begin REF_CHARACTERISTIC k_HHM_Ti_HallPWMErrorJudgeTi /end REF_CHARACTERISTIC /end GROUP
/begin GROUP S376_Rising_Debounce7 "POD_HallHandleModule_TZCU/POD_HallHandleModule/HallHandleModule/HallHandleModuleR/HallErrorProcess/HALL_BFault/Rising Debounce7" /begin REF_CHARACTERISTIC k_HHM_Ti_HallPWMErrorAbsPosSpdJudgeTi /end REF_CHARACTERISTIC /end GROUP
/begin GROUP S377_Rising_Debounce "POD_HallHandleModule_TZCU/POD_HallHandleModule/HallHandleModule/HallHandleModuleR/HallErrorProcess/HallJudgeCondition/Rising Debounce" /begin REF_CHARACTERISTIC k_HHM_Ti_ECUWakeUpJudgeMinTi /end REF_CHARACTERISTIC /end GROUP
/begin GROUP S377_Rising_Debounce1 "POD_HallHandleModule_TZCU/POD_HallHandleModule/HallHandleModule/HallHandleModuleR/HallErrorProcess/HallJudgeCondition/Rising Debounce1" /begin REF_CHARACTERISTIC k_HHM_Ti_HallPWMErrTi /end REF_CHARACTERISTIC /end GROUP
/begin GROUP S379_cnt "POD_HallHandleModule_TZCU/POD_HallHandleModule/HallHandleModule/HallHandleModuleR/HallErrorProcess/SenorErr_Reset/cnt" /begin REF_CHARACTERISTIC k_HHM_Value_HallPassCnt /end REF_CHARACTERISTIC /end GROUP
/begin GROUP S379_Rising_Debounce2 "POD_HallHandleModule_TZCU/POD_HallHandleModule/HallHandleModule/HallHandleModuleR/HallErrorProcess/SenorErr_Reset/Rising Debounce2" /begin REF_CHARACTERISTIC k_HHM_Ti_TimeHallStatic /end REF_CHARACTERISTIC /end GROUP
/begin GROUP S3_ADCHandleModule "POD_SignalHandModule_T/POD_SignalHandModule/SignalHandModule/ADCHandleModule" /begin REF_CHARACTERISTIC k_ADCH_Fac_FilterForMaiMotCurr /end REF_CHARACTERISTIC /end GROUP
/begin GROUP S3_DetAutoInitExctCond "RDM_DetTrunkMoveReq/RDM_DetTrunkMoveReq_Main_sys/DetAutoInitExctCond" /begin REF_CHARACTERISTIC CalC_TrnkOpnVldMaxHallPos CalC_hIPLGMechHighHall_cnt /end REF_CHARACTERISTIC /end GROUP
/begin GROUP S3_DetOpnStartStepTgtSpd "RDM_DetTrunkMoveReq/RDM_DetTrunkMoveReq_Main_sys/DetOpnStartStepTgtSpd" /begin REF_CHARACTERISTIC CalC_TrnkOpnMtrStartStepCfg /end REF_CHARACTERISTIC /end GROUP
/begin GROUP S3_DetPWMRqst "RDM_DetTrunkMoveReq/RDM_DetTrunkMoveReq_Main_sys/DetPWMRqst" /begin REF_CHARACTERISTIC CalC_TrnkMtrPWMUpLim /end REF_CHARACTERISTIC /end GROUP
/begin GROUP S3_Subsystem2 "RDM_AntiPinch/RDM_AntiPinch_Main_sys/Subsystem2" /begin REF_CHARACTERISTIC CalC_hIPLGMechHighHall_cnt /end REF_CHARACTERISTIC /end GROUP
/begin GROUP S441_Rising_Debounce1 "POD_HallHandleModule_TZCU/POD_HallHandleModule/HallHandleModule/HallHandleModuleR/HallErrorProcess/SenorErr_Reset/MovReset/Rising Debounce1" /begin REF_CHARACTERISTIC k_HHM_Ti_TimeWakeUp /end REF_CHARACTERISTIC /end GROUP
/begin GROUP S47_ADPPara "POD_FaultHandle/POD_FaultHandle/FaultHandle/AntiPlay/AntiPlayR/AntiplayStatus/ADPPara" /begin REF_CHARACTERISTIC k_ADP_Ti_AntiPlaySequenceTimer /end REF_CHARACTERISTIC /end GROUP
/begin GROUP S47_Rising_Debounce "POD_AntiPinch/POD_AntiPinch/AntiPinch/AntiPinchL/AntiPinchTrig/AntiPinchConditions_Current/Rising Debounce"
 /begin REF_CHARACTERISTIC k_ADP_Ti_AntiPinchOpenSpeedPerStartTimer k_ADP_Ti_AntiPinchSequenceTimer /end REF_CHARACTERISTIC
/end GROUP
/begin GROUP S47_Rising_Debounce1 "POD_AntiPinch/POD_AntiPinch/AntiPinch/AntiPinchL/AntiPinchTrig/AntiPinchConditions_Current/Rising Debounce1"
 /begin REF_CHARACTERISTIC k_ADP_Ti_AntiPinchCloseSpeedPerStartTimer k_ADP_Ti_AntiPinchSequenceTimer /end REF_CHARACTERISTIC
/end GROUP
/begin GROUP S47_Rising_Debounce2 "POD_AntiPinch/POD_AntiPinch/AntiPinch/AntiPinchL/AntiPinchTrig/AntiPinchConditions_Current/Rising Debounce2"
 /begin REF_CHARACTERISTIC k_ADP_Ti_AntiPinchCloseSpeedPerStartTimer k_ADP_Ti_AntiPinchSequenceTimer /end REF_CHARACTERISTIC
/end GROUP
/begin GROUP S47_Rising_Debounce3 "POD_AntiPinch/POD_AntiPinch/AntiPinch/AntiPinchL/AntiPinchTrig/AntiPinchConditions_Current/Rising Debounce3"
 /begin REF_CHARACTERISTIC k_ADP_Ti_AntiPinchSequenceTimer k_ADP_Ti_CurAntiPinchforMinPntCloseStartTimer /end REF_CHARACTERISTIC
/end GROUP
/begin GROUP S48_Rising_Debounce4 "POD_AntiPinch/POD_AntiPinch/AntiPinch/AntiPinchL/AntiPinchTrig/AntiPinchConditions_Speed/Rising Debounce4"
 /begin REF_CHARACTERISTIC k_ADP_Ti_AntiPinchSequenceTimer k_ADP_Ti_DieMinimumSpeedJudgeTimer /end REF_CHARACTERISTIC
/end GROUP
/begin GROUP S51_DoorOpenTargetPosition "POD_HallHandleModule_TZCU/POD_HallHandleModule/HallHandleModule/HallHandleModuleL/AngleConversion/DoorOpenTargetPosition" /begin REF_CHARACTERISTIC k_HHM_Deg_MinOpenAngSwt /end REF_CHARACTERISTIC /end GROUP
/begin GROUP S51_PercPosn2AndPosn2 "POD_HallHandleModule_TZCU/POD_HallHandleModule/HallHandleModule/HallHandleModuleL/AngleConversion/PercPosn2AndPosn2" /begin REF_CHARACTERISTIC k_HHM_Value_Pluse2Deg /end REF_CHARACTERISTIC /end GROUP
/begin GROUP S51_TopDegforDoorOpen "POD_HallHandleModule_TZCU/POD_HallHandleModule/HallHandleModule/HallHandleModuleL/AngleConversion/TopDegforDoorOpen" /begin REF_CHARACTERISTIC k_HHM_Deg_MaxOpenPosition /end REF_CHARACTERISTIC /end GROUP
/begin GROUP S53_IMUseMinAge "POD_HallHandleModule_TZCU/POD_HallHandleModule/HallHandleModule/HallHandleModuleL/DoorMovSts/IMUseMinAge" /begin REF_CHARACTERISTIC k_HHM_Pluse_FilterMinHallPosition /end REF_CHARACTERISTIC /end GROUP
/begin GROUP S55_HALL_AFault "POD_HallHandleModule_TZCU/POD_HallHandleModule/HallHandleModule/HallHandleModuleL/HallErrorProcess/HALL_AFault"
 /begin REF_CHARACTERISTIC k_HHM_Value_HallAMovFreqMaxPrt k_HHM_Value_HallASenorErrCurrentPrt k_HHM_Value_HallASenorIMUAngSpdPrt /end REF_CHARACTERISTIC
/end GROUP
/begin GROUP S55_HALL_BFault "POD_HallHandleModule_TZCU/POD_HallHandleModule/HallHandleModule/HallHandleModuleL/HallErrorProcess/HALL_BFault"
 /begin REF_CHARACTERISTIC k_HHM_Value_HallDirErrMinAbsSpeed k_HHM_Value_HallDirErrMinClsdSpeed k_HHM_Value_HallDirErrMinOpenSpeed k_HHM_Value_HallPWMErrCurrentPrt k_HHM_Value_HallPWMIMUAngSpdPrt k_HHM_Value_HallPwmMinValue /end REF_CHARACTERISTIC
/end GROUP
/begin GROUP S55_HallJudgeCondition "POD_HallHandleModule_TZCU/POD_HallHandleModule/HallHandleModule/HallHandleModuleL/HallErrorProcess/HallJudgeCondition"
 /begin REF_CHARACTERISTIC k_HHM_Value_HallErrMinSpeed k_HHM_Value_HallErrSlope k_HHM_Value_HallErrSpeedOffset k_HHM_Value_cfgHallPole /end REF_CHARACTERISTIC
/end GROUP
/begin GROUP S58_Rising_Debounce "POD_HallHandleModule_TZCU/POD_HallHandleModule/HallHandleModule/HallHandleModuleL/AngleConversion/DoorOpenTargetPosition/Rising Debounce" /begin REF_CHARACTERISTIC k_HHM_Ti_TimeInsdSetPstnDelay /end REF_CHARACTERISTIC /end GROUP
/begin GROUP S65_Timer_Debounce "POD_FaultHandle/POD_FaultHandle/FaultHandle/AntiPlay/AntiPlayR/AntiplayStatus/AntiPlayState/Time Holding Boolean/Timer Debounce"
 /begin REF_CHARACTERISTIC k_ADP_Ti_AntiPlaySequenceTimer k_ADP_Ti_TimeActiveProtectionThreshold /end REF_CHARACTERISTIC
/end GROUP
/begin GROUP S66_Rising_Debounce "POD_AntiPinch/POD_AntiPinch/AntiPinch/AntiPinchL/AntiPinch_Detection/AntiPinchEvent/Rising Debounce"
 /begin REF_CHARACTERISTIC k_ADP_Ti_AntiPinchSequenceTimer k_ADP_Ti_StateRunDelayTimer /end REF_CHARACTERISTIC
/end GROUP
/begin GROUP S66_Rising_Debounce1 "POD_AntiPinch/POD_AntiPinch/AntiPinch/AntiPinchL/AntiPinch_Detection/AntiPinchEvent/Rising Debounce1"
 /begin REF_CHARACTERISTIC k_ADP_Ti_AntiPinchSequenceTimer k_ADP_Ti_CurAntiPinchforMinPntCloseDelayTimer /end REF_CHARACTERISTIC
/end GROUP
/begin GROUP S69_Timer_Debounce "POD_AntiPinch/POD_AntiPinch/AntiPinch/AntiPinchL/AntiPinch_Detection/Time Holding Boolean/Timer Debounce"
 /begin REF_CHARACTERISTIC k_ADP_Ti_AntiPinchHoldingTimer k_ADP_Ti_AntiPinchSequenceTimer /end REF_CHARACTERISTIC
/end GROUP
/begin GROUP S6_Rising_Debounce "POD_TipToRun/POD_TipToRun/TipToRun/TipToRunL/IMU/Rising Debounce" /begin REF_CHARACTERISTIC k_TTR_Ti_DoorOpenStartTimer k_TTR_Ti_SequenceTimer /end REF_CHARACTERISTIC /end GROUP
/begin GROUP S6_Rising_Debounce1 "POD_TipToRun/POD_TipToRun/TipToRun/TipToRunL/IMU/Rising Debounce1" /begin REF_CHARACTERISTIC k_TTR_Ti_SequenceTimer /end REF_CHARACTERISTIC /end GROUP
/begin GROUP S74_DooStop "POD_HallHandleModule_TZCU/POD_HallHandleModule/HallHandleModule/HallHandleModuleL/DoorMovSts/Hold/DooStop" /begin REF_CHARACTERISTIC k_HHM_Value_ManualHoldIMUAngSpdMinSpeed /end REF_CHARACTERISTIC /end GROUP
/begin GROUP S74_ManualDoorStop "POD_HallHandleModule_TZCU/POD_HallHandleModule/HallHandleModule/HallHandleModuleL/DoorMovSts/Hold/ManualDoorStop" /begin REF_CHARACTERISTIC k_HHM_Ti_TimeHoldManualDoorStopMovSts /end REF_CHARACTERISTIC /end GROUP
/begin GROUP S76_PerManualMovDoor "POD_HallHandleModule_TZCU/POD_HallHandleModule/HallHandleModule/HallHandleModuleL/DoorMovSts/ManualMov/PerManualMovDoor"
 /begin REF_CHARACTERISTIC k_HHM_Value_ManualCloseHallSpeed k_HHM_Value_ManualCloseIMUAngSpdMinSpeed k_HHM_Value_ManualOpenHallSpeed k_HHM_Value_ManualOpenIMUAngSpdMinSpeed /end REF_CHARACTERISTIC
/end GROUP
/begin GROUP S77_SectorTopClose "POD_HallHandleModule_TZCU/POD_HallHandleModule/HallHandleModule/HallHandleModuleL/DoorMovSts/POD_GetSector/SectorTopClose" /begin REF_CHARACTERISTIC k_HHM_Value_SectorForClose /end REF_CHARACTERISTIC /end GROUP
/begin GROUP S77_SectorTopOpen "POD_HallHandleModule_TZCU/POD_HallHandleModule/HallHandleModule/HallHandleModuleL/DoorMovSts/POD_GetSector/SectorTopOpen" /begin REF_CHARACTERISTIC k_HHM_Value_SectorForOpen /end REF_CHARACTERISTIC /end GROUP
/begin GROUP S7_DetQuitInitSrc "RDM_GetTrunkPos/RDM_GetTrunkPos_Main_sys/DetInitMode/DetQuitInitSrc" /begin REF_CHARACTERISTIC CalC_TrnkOpnVldMaxHallPos /end REF_CHARACTERISTIC /end GROUP
/begin GROUP S7_StopToAssist "POD_TipToRun/POD_TipToRun/TipToRun/TipToRunL/ManAsstRqst/StopToAssist"
 /begin REF_CHARACTERISTIC k_TTR_Deg_RoadInclnThdAssis k_TTR_Deg_RollAgGlbThdAssis k_TTR_Value_HoldHallPosExit k_TTR_Value_IMUHoldExitMinSpeed k_TTR_Value_SpdLowerThdforAsst k_TTR_Value_SpdUpperThdforAsst /end REF_CHARACTERISTIC
/end GROUP
/begin GROUP S80_Rising_Debounce "POD_HallHandleModule_TZCU/POD_HallHandleModule/HallHandleModule/HallHandleModuleL/DoorMovSts/Hold/ClosingInLock/Rising Debounce" /begin REF_CHARACTERISTIC k_HHM_Ti_TimeClosingInLockHoldMovSts /end REF_CHARACTERISTIC /end GROUP
/begin GROUP S81_Rising_Debounce "POD_HallHandleModule_TZCU/POD_HallHandleModule/HallHandleModule/HallHandleModuleL/DoorMovSts/Hold/DooStop/Rising Debounce" /begin REF_CHARACTERISTIC k_HHM_Ti_TimeIMUDoorStopMovSts /end REF_CHARACTERISTIC /end GROUP
/begin GROUP S81_Rising_Debounce1 "POD_HallHandleModule_TZCU/POD_HallHandleModule/HallHandleModule/HallHandleModuleL/DoorMovSts/Hold/DooStop/Rising Debounce1" /begin REF_CHARACTERISTIC k_HHM_Ti_TimeHallSpdNoMov /end REF_CHARACTERISTIC /end GROUP
/begin GROUP S82_Rising_Debounce4 "POD_HallHandleModule_TZCU/POD_HallHandleModule/HallHandleModule/HallHandleModuleL/DoorMovSts/Hold/DoorStateErrorJudge/Rising Debounce4" /begin REF_CHARACTERISTIC k_HHM_Ti_TimeHoldDoorErrorMovSts /end REF_CHARACTERISTIC /end GROUP
/begin GROUP S83_Rising_Debounce "POD_HallHandleModule_TZCU/POD_HallHandleModule/HallHandleModule/HallHandleModuleL/DoorMovSts/Hold/ElecDoorStop/Rising Debounce" /begin REF_CHARACTERISTIC k_HHM_Ti_TimeHoldDoorStopMovSts /end REF_CHARACTERISTIC /end GROUP
/begin GROUP S87_Timer_Debounce "POD_AntiPinch/POD_AntiPinch/AntiPinch/AntiPinchL/Tip2RunAntiPinch/Time Holding Boolean/Timer Debounce"
 /begin REF_CHARACTERISTIC k_ADP_Ti_AntiPinchHoldingTimer k_ADP_Ti_AntiPinchSequenceTimer /end REF_CHARACTERISTIC
/end GROUP
/begin GROUP S8_cnt "POD_AntiPinch/POD_AntiPinch/AntiPinch/AntiPinchL/AntiPinch_Detection/cnt" /begin REF_CHARACTERISTIC k_ADP_Ti_AntiPinchSequenceTimer /end REF_CHARACTERISTIC /end GROUP
/begin GROUP S8_DetPct "RDM_GetTrunkPos/RDM_GetTrunkPos_Main_sys/DivideTrunkZone/DetPct" /begin REF_CHARACTERISTIC CalC_hIPLGMechHighHall_cnt /end REF_CHARACTERISTIC /end GROUP
/begin GROUP S8_ForR_Para "POD_TipToRun/POD_TipToRun/TipToRun/TipToRunL/TipToRunRqst/ForR_Para"
 /begin REF_CHARACTERISTIC k_TTR_Value_ImuAngAccSpdThdforTTR k_TTR_Value_ImuAngSpdThdforTTR k_TTR_Value_SpdThdforTTR k_TTR_Value_TTRDegThd /end REF_CHARACTERISTIC
/end GROUP
/begin GROUP S96_cnt "POD_AntiPinch/POD_AntiPinch/AntiPinch/AntiPinchR/AntiPinch_Detection/cnt" /begin REF_CHARACTERISTIC k_ADP_Ti_AntiPinchSequenceTimer /end REF_CHARACTERISTIC /end GROUP
/begin GROUP S9_ADPPara "POD_FaultHandle/POD_FaultHandle/FaultHandle/AntiPlay/AntiPlayL/AntiplayStatus/ADPPara" /begin REF_CHARACTERISTIC k_ADP_Ti_AntiPlaySequenceTimer /end REF_CHARACTERISTIC /end GROUP
/begin RECORD_LAYOUT Scalar_FLOAT32_IEEE FNC_VALUES 1 FLOAT32_IEEE COLUMN_DIR DIRECT /end RECORD_LAYOUT
/begin RECORD_LAYOUT Scalar_SWORD FNC_VALUES 1 SWORD COLUMN_DIR DIRECT /end RECORD_LAYOUT
/begin RECORD_LAYOUT Scalar_UBYTE FNC_VALUES 1 UBYTE COLUMN_DIR DIRECT /end RECORD_LAYOUT
/begin RECORD_LAYOUT Scalar_ULONG FNC_VALUES 1 ULONG COLUMN_DIR DIRECT /end RECORD_LAYOUT
/begin RECORD_LAYOUT Scalar_UWORD FNC_VALUES 1 UWORD COLUMN_DIR DIRECT /end RECORD_LAYOUT
/begin RECORD_LAYOUT STANDARD_VALUE_U32 FNC_VALUES 1 ULONG COLUMN_DIR DIRECT /end RECORD_LAYOUT
/begin RECORD_LAYOUT UBYTE_RL FNC_VALUES 1 UBYTE COLUMN_DIR DIRECT /end RECORD_LAYOUT
/begin RECORD_LAYOUT __UBYTE_Z FNC_VALUES 1 UBYTE ROW_DIR DIRECT /end RECORD_LAYOUT
/begin RECORD_LAYOUT __UWORD_Z FNC_VALUES 1 UWORD ROW_DIR DIRECT /end RECORD_LAYOUT
/begin RECORD_LAYOUT __ULONG_Z FNC_VALUES 1 ULONG ROW_DIR DIRECT /end RECORD_LAYOUT
/begin RECORD_LAYOUT __SBYTE_Z FNC_VALUES 1 SBYTE ROW_DIR DIRECT /end RECORD_LAYOUT
/begin RECORD_LAYOUT __SWORD_Z FNC_VALUES 1 SWORD ROW_DIR DIRECT /end RECORD_LAYOUT
/begin RECORD_LAYOUT __SLONG_Z FNC_VALUES 1 SLONG ROW_DIR DIRECT /end RECORD_LAYOUT
/begin RECORD_LAYOUT __FLOAT32_IEEE_Z FNC_VALUES 1 FLOAT32_IEEE ROW_DIR DIRECT /end RECORD_LAYOUT
/begin RECORD_LAYOUT __FLOAT64_IEEE_Z FNC_VALUES 1 FLOAT64_IEEE ROW_DIR DIRECT /end RECORD_LAYOUT
/begin RECORD_LAYOUT __UBYTE_S FNC_VALUES 1 UBYTE COLUMN_DIR DIRECT /end RECORD_LAYOUT
/begin RECORD_LAYOUT __UWORD_S FNC_VALUES 1 UWORD COLUMN_DIR DIRECT /end RECORD_LAYOUT
/end MODULE
/end PROJECT
