ASAP2_VERSION 1 70
/begin PROJECT ProjectName "CARIAD XCP On CAN"
/begin MODULE ZCU "this is a module for XCP A2l"
/begin MOD_COMMON "" BYTE_ORDER MSB_LAST ALIGNMENT_BYTE 1 ALIGNMENT_WORD 2 ALIGNMENT_LONG 4 ALIGNMENT_INT64 8 ALIGNMENT_FLOAT32_IEEE 4 ALIGNMENT_FLOAT64_IEEE 8 /end MOD_COMMON
/begin COMPU_METHOD DIAG_CarConfig_CM_uint8 "Q = V" IDENTICAL "%3.0" "" /end COMPU_METHOD
/begin COMPU_METHOD POD_AntiPinch_CM_boolean "Q = V" IDENTICAL "%1.0" "" /end COMPU_METHOD
/begin COMPU_METHOD POD_AntiPinch_CM_int16 "Q = V" IDENTICAL "%5.0" "" /end COMPU_METHOD
/begin COMPU_METHOD POD_AntiPinch_CM_single "Q = V" IDENTICAL "%8.6" "" /end COMPU_METHOD
/begin COMPU_METHOD POD_FaultHandle_CM_boolean "Q = V" IDENTICAL "%1.0" "" /end COMPU_METHOD
/begin COMPU_METHOD POD_FaultHandle_CM_int16 "Q = V" IDENTICAL "%5.0" "" /end COMPU_METHOD
/begin COMPU_METHOD POD_FaultHandle_CM_single "Q = V" IDENTICAL "%8.6" "" /end COMPU_METHOD
/begin COMPU_METHOD POD_FaultHandle_CM_uint8 "Q = V" IDENTICAL "%3.0" "" /end COMPU_METHOD
/begin COMPU_METHOD POD_FITOut_CM_UINT8 "Q = V" IDENTICAL "%3.0" "" /end COMPU_METHOD
/begin COMPU_METHOD POD_FITOut_CM_uint8 "Q = V" IDENTICAL "%3.0" "" /end COMPU_METHOD
/begin COMPU_METHOD POD_HallHandleModule_TZCU_CM_boolean "Q = V" IDENTICAL "%1.0" "" /end COMPU_METHOD
/begin COMPU_METHOD POD_HallHandleModule_TZCU_CM_int16 "Q = V" IDENTICAL "%5.0" "" /end COMPU_METHOD
/begin COMPU_METHOD POD_HallHandleModule_TZCU_CM_single "Q = V" IDENTICAL "%8.6" "" /end COMPU_METHOD
/begin COMPU_METHOD POD_HallHandleModule_TZCU_CM_single_s "Q = V" IDENTICAL "%8.6" "s" /end COMPU_METHOD
/begin COMPU_METHOD POD_HallHandleModule_TZCU_CM_uint16 "Q = V" IDENTICAL "%5.0" "" /end COMPU_METHOD
/begin COMPU_METHOD POD_HallHandleModule_TZCU_CM_uint8 "Q = V" IDENTICAL "%3.0" "" /end COMPU_METHOD
/begin COMPU_METHOD POD_MBCL_CM_boolean "Q = V" IDENTICAL "%1.0" "" /end COMPU_METHOD
/begin COMPU_METHOD POD_MBCL_CM_uint16 "Q = V" IDENTICAL "%5.0" "" /end COMPU_METHOD
/begin COMPU_METHOD POD_MBCL_CM_uint8 "Q = V" IDENTICAL "%3.0" "" /end COMPU_METHOD
/begin COMPU_METHOD POD_MBCR_CM_boolean "Q = V" IDENTICAL "%1.0" "" /end COMPU_METHOD
/begin COMPU_METHOD POD_MBCR_CM_uint16 "Q = V" IDENTICAL "%5.0" "" /end COMPU_METHOD
/begin COMPU_METHOD POD_MBCR_CM_uint8 "Q = V" IDENTICAL "%3.0" "" /end COMPU_METHOD
/begin COMPU_METHOD POD_MCML_CM_boolean "Q = V" IDENTICAL "%1.0" "" /end COMPU_METHOD
/begin COMPU_METHOD POD_MCML_CM_int16 "Q = V" IDENTICAL "%5.0" "" /end COMPU_METHOD
/begin COMPU_METHOD POD_MCML_CM_single "Q = V" IDENTICAL "%8.6" "" /end COMPU_METHOD
/begin COMPU_METHOD POD_MCML_CM_uint16 "Q = V" IDENTICAL "%5.0" "" /end COMPU_METHOD
/begin COMPU_METHOD POD_MCML_CM_uint8 "Q = V" IDENTICAL "%3.0" "" /end COMPU_METHOD
/begin COMPU_METHOD POD_MCMR_CM_boolean "Q = V" IDENTICAL "%1.0" "" /end COMPU_METHOD
/begin COMPU_METHOD POD_MCMR_CM_int16 "Q = V" IDENTICAL "%5.0" "" /end COMPU_METHOD
/begin COMPU_METHOD POD_MCMR_CM_single "Q = V" IDENTICAL "%8.6" "" /end COMPU_METHOD
/begin COMPU_METHOD POD_MCMR_CM_uint16 "Q = V" IDENTICAL "%5.0" "" /end COMPU_METHOD
/begin COMPU_METHOD POD_MCMR_CM_uint8 "Q = V" IDENTICAL "%3.0" "" /end COMPU_METHOD
/begin COMPU_METHOD POD_SignalHandModule_T_CM_single "Q = V" IDENTICAL "%8.6" "" /end COMPU_METHOD
/begin COMPU_METHOD POD_SignalHandModule_T_CM_uint8 "Q = V" IDENTICAL "%3.0" "" /end COMPU_METHOD
/begin COMPU_METHOD POD_TipToRun_CM_boolean "Q = V" IDENTICAL "%1.0" "" /end COMPU_METHOD
/begin COMPU_METHOD POD_TipToRun_CM_int16 "Q = V" IDENTICAL "%5.0" "" /end COMPU_METHOD
/begin COMPU_METHOD POD_TipToRun_CM_uint8 "Q = V" IDENTICAL "%3.0" "" /end COMPU_METHOD
/begin COMPU_METHOD RDM_AntiPinch_CM_int16 "Q = V" IDENTICAL "%5.0" "" /end COMPU_METHOD
/begin COMPU_METHOD RDM_AntiPinch_CM_single "Q = V" IDENTICAL "%8.6" "" /end COMPU_METHOD
/begin COMPU_METHOD RDM_AntiPinch_CM_uint16 "Q = V" IDENTICAL "%5.0" "" /end COMPU_METHOD
/begin COMPU_METHOD RDM_AntiPinch_CM_uint8 "Q = V" IDENTICAL "%3.0" "" /end COMPU_METHOD
/begin COMPU_METHOD RDM_CtrlLeverMtr_CM_int16 "Q = V" IDENTICAL "%5.0" "" /end COMPU_METHOD
/begin COMPU_METHOD RDM_CtrlLeverMtr_CM_uint16 "Q = V" IDENTICAL "%5.0" "" /end COMPU_METHOD
/begin COMPU_METHOD RDM_DetLeverMtrStallSt_CM_uint16 "Q = V" IDENTICAL "%5.0" "" /end COMPU_METHOD
/begin COMPU_METHOD RDM_DetThermProtSt_CM_uint8 "Q = V" IDENTICAL "%3.0" "" /end COMPU_METHOD
/begin COMPU_METHOD RDM_DetTrunkMoveReq_CM_int16 "Q = V" IDENTICAL "%5.0" "" /end COMPU_METHOD
/begin COMPU_METHOD RDM_DetTrunkMoveReq_CM_single "Q = V" IDENTICAL "%8.6" "" /end COMPU_METHOD
/begin COMPU_METHOD RDM_DetTrunkMoveReq_CM_uint16 "Q = V" IDENTICAL "%5.0" "" /end COMPU_METHOD
/begin COMPU_METHOD RDM_DetTrunkMoveReq_CM_uint8 "Q = V" IDENTICAL "%3.0" "" /end COMPU_METHOD
/begin COMPU_METHOD RDM_FITIn_CM_UINT16 "Q = V" IDENTICAL "%5.0" "" /end COMPU_METHOD
/begin COMPU_METHOD RDM_FITIn_CM_uint16 "Q = V" IDENTICAL "%5.0" "" /end COMPU_METHOD
/begin COMPU_METHOD RDM_FITIn_CM_uint8 "Q = V" IDENTICAL "%3.0" "" /end COMPU_METHOD
/begin COMPU_METHOD RDM_FITOut_CM_UINT8 "Q = V" IDENTICAL "%3.0" "" /end COMPU_METHOD
/begin COMPU_METHOD RDM_FITOut_CM_uint8 "Q = V" IDENTICAL "%3.0" "" /end COMPU_METHOD
/begin COMPU_METHOD RDM_GetTrunkPos_CM_int16 "Q = V" IDENTICAL "%5.0" "" /end COMPU_METHOD
/begin COMPU_METHOD RDM_GetTrunkPos_CM_uint16 "Q = V" IDENTICAL "%5.0" "" /end COMPU_METHOD
/begin COMPU_METHOD RDM_GetTrunkPos_CM_uint8 "Q = V" IDENTICAL "%3.0" "" /end COMPU_METHOD
/begin COMPU_METHOD RDM_HallDeco_CM_uint16 "Q = V" IDENTICAL "%5.0" "" /end COMPU_METHOD
/begin COMPU_METHOD RDM_HallDeco_CM_uint8 "Q = V" IDENTICAL "%3.0" "" /end COMPU_METHOD
/begin COMPU_METHOD RDM_LearnRF_CM_int16 "Q = V" IDENTICAL "%5.0" "" /end COMPU_METHOD
/begin COMPU_METHOD RDM_LearnRF_CM_uint8 "Q = V" IDENTICAL "%3.0" "" /end COMPU_METHOD
/begin COMPU_METHOD RDM_SetSwSt_CM_uint16 "Q = V" IDENTICAL "%5.0" "" /end COMPU_METHOD
/begin COMPU_METHOD RDM_SetSwSt_CM_uint8 "Q = V" IDENTICAL "%3.0" "" /end COMPU_METHOD
/begin COMPU_METHOD RDMLatch_DetMotorStall_CM_uint16 "Q = V" IDENTICAL "%5.0" "" /end COMPU_METHOD
/begin COMPU_METHOD RDMLatch_FITIn_CM_UINT16 "Q = V" IDENTICAL "%5.0" "" /end COMPU_METHOD
/begin COMPU_METHOD RDMLatch_FITIn_CM_uint16 "Q = V" IDENTICAL "%5.0" "" /end COMPU_METHOD
/begin COMPU_METHOD RDMLatch_FITIn_CM_UINT8 "Q = V" IDENTICAL "%3.0" "" /end COMPU_METHOD
/begin COMPU_METHOD RDMLatch_FITIn_CM_uint8 "Q = V" IDENTICAL "%3.0" "" /end COMPU_METHOD
/begin COMPU_METHOD RDMLatch_SetCinchRelsCmd_CM_uint16 "Q = V" IDENTICAL "%5.0" "" /end COMPU_METHOD
/begin COMPU_METHOD TMS_CM_single "Q = V" IDENTICAL "%8.6" "" /end COMPU_METHOD
/begin COMPU_METHOD TMS_CM_UINT16 "Q = V" IDENTICAL "%5.0" "" /end COMPU_METHOD
/begin COMPU_METHOD TMS_CM_uint16 "Q = V" IDENTICAL "%5.0" "" /end COMPU_METHOD
/begin COMPU_METHOD TMS_CM_UINT8 "Q = V" IDENTICAL "%3.0" "" /end COMPU_METHOD
/begin COMPU_METHOD TMS_CM_uint8 "Q = V" IDENTICAL "%3.0" "" /end COMPU_METHOD
/begin COMPU_METHOD TZCUbody_DTC_CM_uint8 "Q = V" IDENTICAL "%3.0" "" /end COMPU_METHOD
/begin MEASUREMENT CIL_3rModFlapMotCtr "" UBYTE TMS_CM_uint8 0 0 0 255 ECU_ADDRESS 0xB0056364
 /begin IF_DATA XCP
  /begin DAQ_EVENT VARIABLE /begin DEFAULT_EVENT_LIST EVENT 0x0 /end DEFAULT_EVENT_LIST /end DAQ_EVENT
 /end IF_DATA
/end MEASUREMENT
/begin CHARACTERISTIC CIL_3rModFlapMotCtr_BypS "" VALUE 0xB00073D4 Record_UBYTE 0 TMS_CM_uint8 0 255 /end CHARACTERISTIC
/begin CHARACTERISTIC CIL_3rModFlapMotCtr_BypV "" VALUE 0xB00073D5 Record_UBYTE 0 TMS_CM_uint8 0 255 /end CHARACTERISTIC
/begin MEASUREMENT CIL_3rTempFlapMotCtr "" UBYTE TMS_CM_uint8 0 0 0 255 ECU_ADDRESS 0xB0056365
 /begin IF_DATA XCP
  /begin DAQ_EVENT VARIABLE /begin DEFAULT_EVENT_LIST EVENT 0x0 /end DEFAULT_EVENT_LIST /end DAQ_EVENT
 /end IF_DATA
/end MEASUREMENT
/begin CHARACTERISTIC CIL_3rTempFlapMotCtr_BypS "" VALUE 0xB00073D6 Record_UBYTE 0 TMS_CM_uint8 0 255 /end CHARACTERISTIC
/begin CHARACTERISTIC CIL_3rTempFlapMotCtr_BypV "" VALUE 0xB00073D7 Record_UBYTE 0 TMS_CM_uint8 0 255 /end CHARACTERISTIC
/begin MEASUREMENT CIL_ICanNmRxInd "" UBYTE TMS_CM_uint8 0 0 0 255 ECU_ADDRESS 0xB0056366
 /begin IF_DATA XCP
  /begin DAQ_EVENT VARIABLE /begin DEFAULT_EVENT_LIST EVENT 0x0 /end DEFAULT_EVENT_LIST /end DAQ_EVENT
 /end IF_DATA
/end MEASUREMENT
/begin CHARACTERISTIC CIL_ICanNmRxInd_BypS "" VALUE 0xB00073D8 Record_UBYTE 0 TMS_CM_uint8 0 255 /end CHARACTERISTIC
/begin CHARACTERISTIC CIL_ICanNmRxInd_BypV "" VALUE 0xB00073D9 Record_UBYTE 0 TMS_CM_uint8 0 255 /end CHARACTERISTIC
/begin MEASUREMENT CIL_RrEvapDuctTempSnsr "" FLOAT32_IEEE TMS_CM_single 0 0 -3.4e+38 3.4e+38 ECU_ADDRESS 0xB0056368
 /begin IF_DATA XCP
  /begin DAQ_EVENT VARIABLE /begin DEFAULT_EVENT_LIST EVENT 0x0 /end DEFAULT_EVENT_LIST /end DAQ_EVENT
 /end IF_DATA
/end MEASUREMENT
/begin MEASUREMENT CIL_RrFaceDuctTempSnsr "" FLOAT32_IEEE TMS_CM_single 0 0 -3.4e+38 3.4e+38 ECU_ADDRESS 0xB005636C
 /begin IF_DATA XCP
  /begin DAQ_EVENT VARIABLE /begin DEFAULT_EVENT_LIST EVENT 0x0 /end DEFAULT_EVENT_LIST /end DAQ_EVENT
 /end IF_DATA
/end MEASUREMENT
/begin MEASUREMENT CIL_RrFootDuctTempSnsr "" FLOAT32_IEEE TMS_CM_single 0 0 -3.4e+38 3.4e+38 ECU_ADDRESS 0xB0056370
 /begin IF_DATA XCP
  /begin DAQ_EVENT VARIABLE /begin DEFAULT_EVENT_LIST EVENT 0x0 /end DEFAULT_EVENT_LIST /end DAQ_EVENT
 /end IF_DATA
/end MEASUREMENT
/begin MEASUREMENT CIL_RrModMotPosnFb "" FLOAT32_IEEE TMS_CM_single 0 0 -3.4e+38 3.4e+38 ECU_ADDRESS 0xB0056374
 /begin IF_DATA XCP
  /begin DAQ_EVENT VARIABLE /begin DEFAULT_EVENT_LIST EVENT 0x0 /end DEFAULT_EVENT_LIST /end DAQ_EVENT
 /end IF_DATA
/end MEASUREMENT
/begin MEASUREMENT CIL_TMCCanComReq "" UBYTE TMS_CM_uint8 0 0 0 255 ECU_ADDRESS 0xB0056378
 /begin IF_DATA XCP
  /begin DAQ_EVENT VARIABLE /begin DEFAULT_EVENT_LIST EVENT 0x0 /end DEFAULT_EVENT_LIST /end DAQ_EVENT
 /end IF_DATA
/end MEASUREMENT
/begin CHARACTERISTIC CIL_TMCCanComReq_BypS "" VALUE 0xB00073DA Record_UBYTE 0 TMS_CM_uint8 0 255 /end CHARACTERISTIC
/begin CHARACTERISTIC CIL_TMCCanComReq_BypV "" VALUE 0xB00073DB Record_UBYTE 0 TMS_CM_uint8 0 255 /end CHARACTERISTIC
/begin MEASUREMENT CIL_TZcuKL30DcV "" FLOAT32_IEEE TMS_CM_single 0 0 -3.4e+38 3.4e+38 ECU_ADDRESS 0xB005637C
 /begin IF_DATA XCP
  /begin DAQ_EVENT VARIABLE /begin DEFAULT_EVENT_LIST EVENT 0x0 /end DEFAULT_EVENT_LIST /end DAQ_EVENT
 /end IF_DATA
/end MEASUREMENT
/begin CHARACTERISTIC COL_3rEvapDuctTempRaw_BypS "" VALUE 0xB00073DC Record_UBYTE 0 TMS_CM_uint8 0 255 /end CHARACTERISTIC
/begin CHARACTERISTIC COL_3rEvapDuctTempRaw_BypV "" VALUE 0xB00073DE Record_UWORD 0 TMS_CM_uint16 0 65535 /end CHARACTERISTIC
/begin CHARACTERISTIC COL_3rFaceDuctTempRaw_BypS "" VALUE 0xB00073E0 Record_UBYTE 0 TMS_CM_uint8 0 255 /end CHARACTERISTIC
/begin CHARACTERISTIC COL_3rFaceDuctTempRaw_BypV "" VALUE 0xB00073E2 Record_UWORD 0 TMS_CM_uint16 0 65535 /end CHARACTERISTIC
/begin CHARACTERISTIC COL_3rFootDuctTempRaw_BypS "" VALUE 0xB00073E4 Record_UBYTE 0 TMS_CM_uint8 0 255 /end CHARACTERISTIC
/begin CHARACTERISTIC COL_3rFootDuctTempRaw_BypV "" VALUE 0xB00073E6 Record_UWORD 0 TMS_CM_uint16 0 65535 /end CHARACTERISTIC
/begin CHARACTERISTIC COL_3rModFlapMotVolFb_BypS "" VALUE 0xB00073E8 Record_UBYTE 0 TMS_CM_uint8 0 255 /end CHARACTERISTIC
/begin CHARACTERISTIC COL_3rModFlapMotVolFb_BypV "" VALUE 0xB00073EA Record_UWORD 0 TMS_CM_uint16 0 65535 /end CHARACTERISTIC
/begin MEASUREMENT COL_3rTempFlapVolFb "" UWORD TMS_CM_uint16 0 0 0 65535 ECU_ADDRESS 0xB0056380
 /begin IF_DATA XCP
  /begin DAQ_EVENT VARIABLE /begin DEFAULT_EVENT_LIST EVENT 0x0 /end DEFAULT_EVENT_LIST /end DAQ_EVENT
 /end IF_DATA
/end MEASUREMENT
/begin CHARACTERISTIC COL_3rTempFlapVolFb_BypS "" VALUE 0xB00073EC Record_UBYTE 0 TMS_CM_uint8 0 255 /end CHARACTERISTIC
/begin CHARACTERISTIC COL_3rTempFlapVolFb_BypV "" VALUE 0xB00073EE Record_UWORD 0 TMS_CM_uint16 0 65535 /end CHARACTERISTIC
/begin CHARACTERISTIC COL_RrModMotCtr_BypS "" VALUE 0xB00073F0 Record_UBYTE 0 TMS_CM_uint8 0 255 /end CHARACTERISTIC
/begin CHARACTERISTIC COL_RrModMotCtr_BypV "" VALUE 0xB00073F1 Record_UBYTE 0 TMS_CM_uint8 0 255 /end CHARACTERISTIC
/begin CHARACTERISTIC CalC_CinchMotDriveTmMax_ms "" VALUE 0xB00072B4 Scalar_UWORD 0 RDMLatch_SetCinchRelsCmd_CM_uint16 0 65535 /end CHARACTERISTIC
/begin CHARACTERISTIC CalC_Debug_TrnkGrOrSpdCond "" VALUE 0xB000727C Scalar_UBYTE 0 RDM_GetTrunkPos_CM_uint8 0 255 /end CHARACTERISTIC
/begin CHARACTERISTIC CalC_Debug_TrnkGrOrSpdCond "" VALUE 0xB000727C Scalar_UBYTE 0 RDM_LearnRF_CM_uint8 0 255 /end CHARACTERISTIC
/begin CHARACTERISTIC CalC_ExitMotTimesPro_s "" VALUE 0xB00072CA Scalar_UWORD 0 RDMLatch_DetMotorStall_CM_uint16 0 65535 /end CHARACTERISTIC
/begin CHARACTERISTIC CalC_TrnkAntiPinchBrakeTm_msec "" VALUE 0xB000709C Scalar_UWORD 0 RDM_CtrlLeverMtr_CM_uint16 0 65535 /end CHARACTERISTIC
/begin CHARACTERISTIC CalC_TrnkClsAPMtrSpdThrTbl_200mm "" VAL_BLK 0xB000709E Scalar_UBYTE 0 RDM_AntiPinch_CM_uint8 0 255 MATRIX_DIM 20 /end CHARACTERISTIC
/begin CHARACTERISTIC CalC_TrnkClsAPMtrSpdThrTbl_20mm "" VAL_BLK 0xB00070B2 Scalar_UBYTE 0 RDM_AntiPinch_CM_uint8 0 255 MATRIX_DIM 20 /end CHARACTERISTIC
/begin CHARACTERISTIC CalC_TrnkClsAPMtrSpdThrTbl_50mm "" VAL_BLK 0xB00070C6 Scalar_UBYTE 0 RDM_AntiPinch_CM_uint8 0 255 MATRIX_DIM 20 /end CHARACTERISTIC
/begin CHARACTERISTIC CalC_TrnkClsAPThrTblPosArr "" VAL_BLK 0xB00070DA Scalar_SWORD 0 RDM_AntiPinch_CM_int16 -32768 32767 MATRIX_DIM 5 /end CHARACTERISTIC
/begin CHARACTERISTIC CalC_TrnkClsAdpCurrNmMvAddPat_HT "" VAL_BLK 0xB00070E4 Scalar_SWORD 0 RDM_AntiPinch_CM_int16 -32768 32767 MATRIX_DIM 3 /end CHARACTERISTIC
/begin CHARACTERISTIC CalC_TrnkClsAdpCurrNmMvAddPat_LT "" VAL_BLK 0xB00070EA Scalar_SWORD 0 RDM_AntiPinch_CM_int16 -32768 32767 MATRIX_DIM 3 /end CHARACTERISTIC
/begin CHARACTERISTIC CalC_TrnkClsAdpCurrNmMvAddPat_NT "" VAL_BLK 0xB00070F0 Scalar_SWORD 0 RDM_AntiPinch_CM_int16 -32768 32767 MATRIX_DIM 3 /end CHARACTERISTIC
/begin CHARACTERISTIC CalC_TrnkClsAdpCurrSlwStpSubPat_HT "" VAL_BLK 0xB00070F6 Scalar_SWORD 0 RDM_AntiPinch_CM_int16 -32768 32767 MATRIX_DIM 3 /end CHARACTERISTIC
/begin CHARACTERISTIC CalC_TrnkClsAdpCurrSlwStpSubPat_LT "" VAL_BLK 0xB00070FC Scalar_SWORD 0 RDM_AntiPinch_CM_int16 -32768 32767 MATRIX_DIM 3 /end CHARACTERISTIC
/begin CHARACTERISTIC CalC_TrnkClsAdpCurrSlwStpSubPat_NT "" VAL_BLK 0xB0007102 Scalar_SWORD 0 RDM_AntiPinch_CM_int16 -32768 32767 MATRIX_DIM 3 /end CHARACTERISTIC
/begin CHARACTERISTIC CalC_TrnkClsAntiPinchCfgEnable "" VALUE 0xB0007108 Scalar_UBYTE 0 RDM_AntiPinch_CM_uint8 0 255 /end CHARACTERISTIC
/begin CHARACTERISTIC CalC_TrnkClsAntiPinchEnableEndPos "" VALUE 0xB000710A Scalar_SWORD 0 RDM_AntiPinch_CM_int16 -32768 32767 /end CHARACTERISTIC
/begin CHARACTERISTIC CalC_TrnkClsAntiPinchEnableStartPos "" VALUE 0xB000710C Scalar_SWORD 0 RDM_AntiPinch_CM_int16 -32768 32767 /end CHARACTERISTIC
/begin CHARACTERISTIC CalC_TrnkClsExitRefSpdAPThrPat1 "" VALUE 0xB000710E Scalar_UWORD 0 RDM_AntiPinch_CM_uint16 0 65535 /end CHARACTERISTIC
/begin CHARACTERISTIC CalC_TrnkClsExitRefSpdAPThrPat2 "" VALUE 0xB0007110 Scalar_UWORD 0 RDM_AntiPinch_CM_uint16 0 65535 /end CHARACTERISTIC
/begin CHARACTERISTIC CalC_TrnkClsExitRefSpdCurrThrPat1 "" VALUE 0xB0007112 Scalar_UWORD 0 RDM_AntiPinch_CM_uint16 0 65535 /end CHARACTERISTIC
/begin CHARACTERISTIC CalC_TrnkClsExitRefSpdCurrThrPat2 "" VALUE 0xB0007114 Scalar_UWORD 0 RDM_AntiPinch_CM_uint16 0 65535 /end CHARACTERISTIC
/begin CHARACTERISTIC CalC_TrnkClsFallBackAPCfgEnable "" VALUE 0xB0007116 Scalar_UBYTE 0 RDM_AntiPinch_CM_uint8 0 255 /end CHARACTERISTIC
/begin CHARACTERISTIC CalC_TrnkClsFallBackAPMtrSpdThr "" VALUE 0xB0007118 Scalar_UWORD 0 RDM_AntiPinch_CM_uint16 0 65535 /end CHARACTERISTIC
/begin CHARACTERISTIC CalC_TrnkClsFallBackAPTmThr "" VALUE 0xB000711A Scalar_UWORD 0 RDM_AntiPinch_CM_uint16 0 65535 /end CHARACTERISTIC
/begin CHARACTERISTIC CalC_TrnkClsMtrNormSpd "" VALUE 0xB000711E Scalar_UWORD 0 RDM_DetTrunkMoveReq_CM_uint16 0 65535 /end CHARACTERISTIC
/begin CHARACTERISTIC CalC_TrnkClsMtrStopDist "" VALUE 0xB0007124 Scalar_UWORD 0 RDM_DetTrunkMoveReq_CM_uint16 0 65535 /end CHARACTERISTIC
/begin CHARACTERISTIC CalC_TrnkClsPauseStopThreshPatch "" VALUE 0xB0007128 Scalar_UWORD 0 RDM_AntiPinch_CM_uint16 0 65535 /end CHARACTERISTIC
/begin CHARACTERISTIC CalC_TrnkClsRFCurStepThr "" VALUE 0xB000712A Scalar_UWORD 0 RDM_AntiPinch_CM_uint16 0 65535 /end CHARACTERISTIC
/begin CHARACTERISTIC CalC_TrnkClsRefAPCfgEnable "" VALUE 0xB000712C Scalar_UBYTE 0 RDM_AntiPinch_CM_uint8 0 255 /end CHARACTERISTIC
/begin CHARACTERISTIC CalC_TrnkClsRefAPSoftRefSpdBias "" VALUE 0xB000712E Scalar_UWORD 0 RDM_AntiPinch_CM_uint16 0 65535 /end CHARACTERISTIC
/begin CHARACTERISTIC CalC_TrnkClsSlowStopThreshPatch "" VALUE 0xB0007130 Scalar_UWORD 0 RDM_AntiPinch_CM_uint16 0 65535 /end CHARACTERISTIC
/begin CHARACTERISTIC CalC_TrnkClsSpdCtrKd "" VALUE 0xB0007134 Scalar_FLOAT32_IEEE 0 RDM_DetTrunkMoveReq_CM_single -3.4e+38 3.4e+38 /end CHARACTERISTIC
/begin CHARACTERISTIC CalC_TrnkClsSpdCtrKi "" VALUE 0xB0007138 Scalar_FLOAT32_IEEE 0 RDM_DetTrunkMoveReq_CM_single -3.4e+38 3.4e+38 /end CHARACTERISTIC
/begin CHARACTERISTIC CalC_TrnkClsSpdCtrKp "" VALUE 0xB000713C Scalar_FLOAT32_IEEE 0 RDM_DetTrunkMoveReq_CM_single -3.4e+38 3.4e+38 /end CHARACTERISTIC
/begin CHARACTERISTIC CalC_TrnkClsStlStpMaxTmTol_ms "" VALUE 0xB0007140 Scalar_UWORD 0 RDM_CtrlLeverMtr_CM_uint16 0 65535 /end CHARACTERISTIC
/begin CHARACTERISTIC CalC_TrnkClsTraceAPCfgEnable "" VALUE 0xB0007150 Scalar_UBYTE 0 RDM_AntiPinch_CM_uint8 0 255 /end CHARACTERISTIC
/begin CHARACTERISTIC CalC_TrnkClsVldMinHallPos "" VALUE 0xB0007152 Scalar_SWORD 0 RDM_DetTrunkMoveReq_CM_int16 -32768 32767 /end CHARACTERISTIC
/begin CHARACTERISTIC CalC_TrnkClsVldMinHallPos "" VALUE 0xB0007152 Scalar_SWORD 0 RDM_GetTrunkPos_CM_int16 -32768 32767 /end CHARACTERISTIC
/begin CHARACTERISTIC CalC_TrnkCurrFilterStartNum "" VALUE 0xB0007154 Scalar_UBYTE 0 RDM_FITIn_CM_uint8 0 255 /end CHARACTERISTIC
/begin CHARACTERISTIC CalC_TrnkCurrFilterWinSize "" VALUE 0xB0007155 Scalar_UBYTE 0 RDM_FITIn_CM_uint8 0 255 /end CHARACTERISTIC
/begin CHARACTERISTIC CalC_TrnkDualLvrMaxPosTol "" VALUE 0xB0007156 Scalar_SWORD 0 RDM_GetTrunkPos_CM_int16 -32768 32767 /end CHARACTERISTIC
/begin CHARACTERISTIC CalC_TrnkFallBackAPCurrThresh "" VALUE 0xB000715C Scalar_UWORD 0 RDM_AntiPinch_CM_uint16 0 65535 /end CHARACTERISTIC
/begin CHARACTERISTIC CalC_TrnkHallOffsetErrExitMinHallTol "" VALUE 0xB0007164 Scalar_UWORD 0 RDM_HallDeco_CM_uint16 0 65535 /end CHARACTERISTIC
/begin CHARACTERISTIC CalC_TrnkHallOffsetErrMaxHallTol "" VALUE 0xB0007166 Scalar_UWORD 0 RDM_HallDeco_CM_uint16 0 65535 /end CHARACTERISTIC
/begin CHARACTERISTIC CalC_TrnkHallSnsrLostDetTm_ms "" VALUE 0xB000716A Scalar_UWORD 0 RDM_HallDeco_CM_uint16 0 65535 /end CHARACTERISTIC
/begin CHARACTERISTIC CalC_TrnkHallZone_HalfClosed_H "" VALUE 0xB000716C Scalar_SWORD 0 RDM_DetTrunkMoveReq_CM_int16 -32768 32767 /end CHARACTERISTIC
/begin CHARACTERISTIC CalC_TrnkLvrMtrStlCurr "" VALUE 0xB000716E Scalar_UWORD 0 RDM_DetLeverMtrStallSt_CM_uint16 0 65535 /end CHARACTERISTIC
/begin CHARACTERISTIC CalC_TrnkLvrMtrStlTm_msec "" VALUE 0xB0007170 Scalar_UWORD 0 RDM_DetLeverMtrStallSt_CM_uint16 0 65535 /end CHARACTERISTIC
/begin CHARACTERISTIC CalC_TrnkLvrMtrStpBrkTm_ms "" VALUE 0xB0007172 Scalar_UWORD 0 RDM_CtrlLeverMtr_CM_uint16 0 65535 /end CHARACTERISTIC
/begin CHARACTERISTIC CalC_TrnkManualAssistThreshPatch "" VALUE 0xB0007174 Scalar_UWORD 0 RDM_AntiPinch_CM_uint16 0 65535 /end CHARACTERISTIC
/begin CHARACTERISTIC CalC_TrnkMinSftStpOpnHallPosOffset "" VALUE 0xB0007176 Scalar_UWORD 0 RDM_GetTrunkPos_CM_uint16 0 65535 /end CHARACTERISTIC
/begin CHARACTERISTIC CalC_TrnkMtrClsStartUpDist "" VALUE 0xB0007178 Scalar_UWORD 0 RDM_GetTrunkPos_CM_uint16 0 65535 /end CHARACTERISTIC
/begin CHARACTERISTIC CalC_TrnkMvAbnMtrSpdRiseTol "" VALUE 0xB0007182 Scalar_UWORD 0 RDM_AntiPinch_CM_uint16 0 65535 /end CHARACTERISTIC
/begin CHARACTERISTIC CalC_TrnkMvAbnPWMThr "" VALUE 0xB0007184 Scalar_UBYTE 0 RDM_AntiPinch_CM_uint8 0 255 /end CHARACTERISTIC
/begin CHARACTERISTIC CalC_TrnkNormMvHallPosTol "" VALUE 0xB000718A Scalar_UWORD 0 RDM_GetTrunkPos_CM_uint16 0 65535 /end CHARACTERISTIC
/begin CHARACTERISTIC CalC_TrnkOpenAntiPinchEnableEndPosOffset "" VALUE 0xB000718C Scalar_SWORD 0 RDM_AntiPinch_CM_int16 -32768 32767 /end CHARACTERISTIC
/begin CHARACTERISTIC CalC_TrnkOpenAntiPinchEnableStartPos "" VALUE 0xB000718E Scalar_SWORD 0 RDM_AntiPinch_CM_int16 -32768 32767 /end CHARACTERISTIC
/begin CHARACTERISTIC CalC_TrnkOpnAPMinCurrThr "" VALUE 0xB0007190 Scalar_UWORD 0 RDM_AntiPinch_CM_uint16 0 65535 /end CHARACTERISTIC
/begin CHARACTERISTIC CalC_TrnkOpnAntiPinchCfgEnable "" VALUE 0xB0007192 Scalar_UBYTE 0 RDM_AntiPinch_CM_uint8 0 255 /end CHARACTERISTIC
/begin CHARACTERISTIC CalC_TrnkOpnFallBackAPCfgEnable "" VALUE 0xB0007193 Scalar_UBYTE 0 RDM_AntiPinch_CM_uint8 0 255 /end CHARACTERISTIC
/begin CHARACTERISTIC CalC_TrnkOpnFallBackAPMtrSpdThr "" VALUE 0xB0007194 Scalar_UWORD 0 RDM_AntiPinch_CM_uint16 0 65535 /end CHARACTERISTIC
/begin CHARACTERISTIC CalC_TrnkOpnFallBackAPTmThr "" VALUE 0xB0007196 Scalar_UWORD 0 RDM_AntiPinch_CM_uint16 0 65535 /end CHARACTERISTIC
/begin CHARACTERISTIC CalC_TrnkOpnMtrNormSpd "" VALUE 0xB000719C Scalar_UWORD 0 RDM_DetTrunkMoveReq_CM_uint16 0 65535 /end CHARACTERISTIC
/begin CHARACTERISTIC CalC_TrnkOpnMtrStartStepPos "" VALUE 0xB00071A6 Scalar_SWORD 0 RDM_DetTrunkMoveReq_CM_int16 -32768 32767 /end CHARACTERISTIC
/begin CHARACTERISTIC CalC_TrnkOpnMtrStartStepTgtSpd "" VALUE 0xB00071A8 Scalar_UWORD 0 RDM_DetTrunkMoveReq_CM_uint16 0 65535 /end CHARACTERISTIC
/begin CHARACTERISTIC CalC_TrnkOpnPauseStopTraceAPEnTol "" VALUE 0xB00071B0 Scalar_UWORD 0 RDM_AntiPinch_CM_uint16 0 65535 /end CHARACTERISTIC
/begin CHARACTERISTIC CalC_TrnkOpnRefAPCfgEnable "" VALUE 0xB00071B4 Scalar_UBYTE 0 RDM_AntiPinch_CM_uint8 0 255 /end CHARACTERISTIC
/begin CHARACTERISTIC CalC_TrnkOpnSlowStopTraceAPEnTol "" VALUE 0xB00071B6 Scalar_UWORD 0 RDM_AntiPinch_CM_uint16 0 65535 /end CHARACTERISTIC
/begin CHARACTERISTIC CalC_TrnkOpnStlStpMaxPosTol "" VALUE 0xB00071C4 Scalar_SWORD 0 RDM_CtrlLeverMtr_CM_int16 -32768 32767 /end CHARACTERISTIC
/begin CHARACTERISTIC CalC_TrnkOpnTraceAPCfgEnable "" VALUE 0xB00071C6 Scalar_UBYTE 0 RDM_AntiPinch_CM_uint8 0 255 /end CHARACTERISTIC
/begin CHARACTERISTIC CalC_TrnkOpnTraceAPMtrSpdThr "" VALUE 0xB00071C8 Scalar_UWORD 0 RDM_AntiPinch_CM_uint16 0 65535 /end CHARACTERISTIC
/begin CHARACTERISTIC CalC_TrnkOpnVldMaxHallPos "" VALUE 0xB00071CA Scalar_SWORD 0 RDM_GetTrunkPos_CM_int16 -32768 32767 /end CHARACTERISTIC
/begin CHARACTERISTIC CalC_TrnkRFAPBlockIntv "" VALUE 0xB00071D0 Scalar_UWORD 0 RDM_GetTrunkPos_CM_uint16 0 65535 /end CHARACTERISTIC
/begin CHARACTERISTIC CalC_TrnkRLvrCfgEnable "" VALUE 0xB00071D2 Scalar_UBYTE 0 RDM_HallDeco_CM_uint8 0 255 /end CHARACTERISTIC
/begin CHARACTERISTIC CalC_TrnkRelsSwLstInitHdTm_sec "" VALUE 0xB00071D3 Scalar_UBYTE 0 RDM_GetTrunkPos_CM_uint8 0 255 /end CHARACTERISTIC
/begin CHARACTERISTIC CalC_TrnkScanKeyPosTm_sec "" VALUE 0xB00071D4 Scalar_UBYTE 0 RDM_DetTrunkMoveReq_CM_uint8 0 255 /end CHARACTERISTIC
/begin CHARACTERISTIC CalC_TrnkSingleMvHallOffsetMaxTol "" VALUE 0xB00071D8 Scalar_UWORD 0 RDM_HallDeco_CM_uint16 0 65535 /end CHARACTERISTIC
/begin CHARACTERISTIC CalC_TrnkSwAdhesTm_sec "" VALUE 0xB00071DE Scalar_UBYTE 0 RDM_SetSwSt_CM_uint8 0 255 /end CHARACTERISTIC
/begin CHARACTERISTIC CalC_TrnkSwLongPrsdTm_msec "" VALUE 0xB00071E0 Scalar_UWORD 0 RDM_SetSwSt_CM_uint16 0 65535 /end CHARACTERISTIC
/begin CHARACTERISTIC CalC_TrnkThermProtCntAccumTmSlot_s "" VALUE 0xB00071E3 Scalar_UBYTE 0 RDM_DetThermProtSt_CM_uint8 0 255 /end CHARACTERISTIC
/begin CHARACTERISTIC CalC_TrnkThermProtCntThresh "" VALUE 0xB00071E4 Scalar_UBYTE 0 RDM_DetThermProtSt_CM_uint8 0 255 /end CHARACTERISTIC
/begin CHARACTERISTIC CalC_TrnkThermProtMdCntDecTmSlot_s "" VALUE 0xB00071E5 Scalar_UBYTE 0 RDM_DetThermProtSt_CM_uint8 0 255 /end CHARACTERISTIC
/begin CHARACTERISTIC CalC_UnlockMotDriveTmMax_ms "" VALUE 0xB00072EA Scalar_UWORD 0 RDMLatch_SetCinchRelsCmd_CM_uint16 0 65535 /end CHARACTERISTIC
/begin CHARACTERISTIC CalC_hIPLGCloseOnlyHallTol_cnt "" VALUE 0xB00071E6 Scalar_UWORD 0 RDM_GetTrunkPos_CM_uint16 0 65535 /end CHARACTERISTIC
/begin CHARACTERISTIC CalC_hIPLGMechHighHall_cnt "" VALUE 0xB00071EC Scalar_UWORD 0 RDM_DetTrunkMoveReq_CM_uint16 0 65535 /end CHARACTERISTIC
/begin CHARACTERISTIC CalC_hIPLGMechHighHall_cnt "" VALUE 0xB00071EC Scalar_UWORD 0 RDM_GetTrunkPos_CM_uint16 0 65535 /end CHARACTERISTIC
/begin CHARACTERISTIC CalC_hIPLGOpenOnlyHall_cnt "" VALUE 0xB00071EE Scalar_SWORD 0 RDM_GetTrunkPos_CM_int16 -32768 32767 /end CHARACTERISTIC
/begin CHARACTERISTIC CalEn_Config_Console "" VALUE 0xB00072F8 Scalar_UBYTE 0 DIAG_CarConfig_CM_uint8 0 255 /end CHARACTERISTIC
/begin CHARACTERISTIC CalEn_Config_PhysicalKeyType "" VALUE 0xB000730C Scalar_UBYTE 0 DIAG_CarConfig_CM_uint8 0 255 /end CHARACTERISTIC
/begin CHARACTERISTIC CalEn_Config_PowerDoor "" VALUE 0xB0007312 Scalar_UBYTE 0 DIAG_CarConfig_CM_uint8 0 255 /end CHARACTERISTIC
/begin CHARACTERISTIC CalEn_Config_SecRowLtSeatCshExt "" VALUE 0xB00072FE Scalar_UBYTE 0 DIAG_CarConfig_CM_uint8 0 255 /end CHARACTERISTIC
/begin CHARACTERISTIC CalEn_Config_SecRowLtSeatHorz "" VALUE 0xB0007302 Scalar_UBYTE 0 DIAG_CarConfig_CM_uint8 0 255 /end CHARACTERISTIC
/begin CHARACTERISTIC CalEn_Config_SecRowLtSeatTilting "" VALUE 0xB00072FA Scalar_UBYTE 0 DIAG_CarConfig_CM_uint8 0 255 /end CHARACTERISTIC
/begin CHARACTERISTIC CalEn_Config_SecRowRtSeatCshExt "" VALUE 0xB0007300 Scalar_UBYTE 0 DIAG_CarConfig_CM_uint8 0 255 /end CHARACTERISTIC
/begin CHARACTERISTIC CalEn_Config_SecRowRtSeatHorz "" VALUE 0xB0007304 Scalar_UBYTE 0 DIAG_CarConfig_CM_uint8 0 255 /end CHARACTERISTIC
/begin CHARACTERISTIC CalEn_Config_SecRowRtSeatTilting "" VALUE 0xB00072FC Scalar_UBYTE 0 DIAG_CarConfig_CM_uint8 0 255 /end CHARACTERISTIC
/begin CHARACTERISTIC CalEn_Config_TailGatetype "" VALUE 0xB000730E Scalar_UBYTE 0 DIAG_CarConfig_CM_uint8 0 255 /end CHARACTERISTIC
/begin CHARACTERISTIC CalEn_Config_TgateLatch "" VALUE 0xB0007310 Scalar_UBYTE 0 DIAG_CarConfig_CM_uint8 0 255 /end CHARACTERISTIC
/begin CHARACTERISTIC CalEn_Config_TrdRowLtSeatTilting "" VALUE 0xB0007306 Scalar_UBYTE 0 DIAG_CarConfig_CM_uint8 0 255 /end CHARACTERISTIC
/begin CHARACTERISTIC CalEn_Config_TrdRowRtSeatTilting "" VALUE 0xB0007308 Scalar_UBYTE 0 DIAG_CarConfig_CM_uint8 0 255 /end CHARACTERISTIC
/begin CHARACTERISTIC CalEn_Config_UWB "" VALUE 0xB000730A Scalar_UBYTE 0 DIAG_CarConfig_CM_uint8 0 255 /end CHARACTERISTIC
/begin CHARACTERISTIC CalEn_DTC_0x97102A "" VALUE 0xB00072F0 Scalar_UBYTE 0 TZCUbody_DTC_CM_uint8 0 255 /end CHARACTERISTIC
/begin CHARACTERISTIC CalEn_DTC_0x971031 "" VALUE 0xB00072F1 Scalar_UBYTE 0 TZCUbody_DTC_CM_uint8 0 255 /end CHARACTERISTIC
/begin CHARACTERISTIC CalEn_DTC_0x971032 "" VALUE 0xB00072F2 Scalar_UBYTE 0 TZCUbody_DTC_CM_uint8 0 255 /end CHARACTERISTIC
/begin CHARACTERISTIC CalEn_DTC_0x971033 "" VALUE 0xB00072F3 Scalar_UBYTE 0 TZCUbody_DTC_CM_uint8 0 255 /end CHARACTERISTIC
/begin CHARACTERISTIC CalEn_DTC_0x971034 "" VALUE 0xB00072F4 Scalar_UBYTE 0 TZCUbody_DTC_CM_uint8 0 255 /end CHARACTERISTIC
/begin CHARACTERISTIC CalEn_DTC_0x97C555 "" VALUE 0xB00072F5 Scalar_UBYTE 0 TZCUbody_DTC_CM_uint8 0 255 /end CHARACTERISTIC
/begin CHARACTERISTIC CalEn_Debug_TgatePosSts "" VALUE 0xB000727D Scalar_UBYTE 0 RDM_GetTrunkPos_CM_uint8 0 255 /end CHARACTERISTIC
/begin CHARACTERISTIC CalEn_Debug_TrnkCurHallPos "" VALUE 0xB000727E Scalar_UBYTE 0 RDM_GetTrunkPos_CM_uint8 0 255 /end CHARACTERISTIC
/begin CHARACTERISTIC CalEn_Debug_TrnkInitSt "" VALUE 0xB000727F Scalar_UBYTE 0 RDM_GetTrunkPos_CM_uint8 0 255 /end CHARACTERISTIC
/begin CHARACTERISTIC CalEn_Debug_TrnkLatchSt "" VALUE 0xB0007280 Scalar_UBYTE 0 RDM_GetTrunkPos_CM_uint8 0 255 /end CHARACTERISTIC
/begin CHARACTERISTIC CalEn_FIN_RDLockCtrFbCur "" VALUE 0xB00072A3 Scalar_UBYTE 0 RDMLatch_FITIn_CM_uint8 0 255 /end CHARACTERISTIC
/begin CHARACTERISTIC CalEn_FIN_RDoorLockPawlSw "" VALUE 0xB00072A4 Scalar_UBYTE 0 RDMLatch_FITIn_CM_uint8 0 255 /end CHARACTERISTIC
/begin CHARACTERISTIC CalEn_FIN_RDoorLockResetSw "" VALUE 0xB00072A5 Scalar_UBYTE 0 RDMLatch_FITIn_CM_uint8 0 255 /end CHARACTERISTIC
/begin CHARACTERISTIC CalEn_FIN_RDoorLockSecondSw "" VALUE 0xB00072A6 Scalar_UBYTE 0 RDMLatch_FITIn_CM_uint8 0 255 /end CHARACTERISTIC
/begin CHARACTERISTIC CalEn_FIN_TrnkLatchCurrFb "" VALUE 0xB00072A7 Scalar_UBYTE 0 RDMLatch_FITIn_CM_uint8 0 255 /end CHARACTERISTIC
/begin CHARACTERISTIC CalEn_FITOut_TgateBuzBepSts "" VALUE 0xB0007291 Scalar_UBYTE 0 RDM_FITOut_CM_uint8 0 255 /end CHARACTERISTIC
/begin CHARACTERISTIC CalEn_FITOut_TrnkLLvrMtrCmd "" VALUE 0xB0007292 Scalar_UBYTE 0 RDM_FITOut_CM_uint8 0 255 /end CHARACTERISTIC
/begin CHARACTERISTIC CalEn_FITOut_TrnkLLvrMtrPWM "" VALUE 0xB0007293 Scalar_UBYTE 0 RDM_FITOut_CM_uint8 0 255 /end CHARACTERISTIC
/begin CHARACTERISTIC CalEn_FITOut_TrnkRLvrMtrCmd "" VALUE 0xB0007294 Scalar_UBYTE 0 RDM_FITOut_CM_uint8 0 255 /end CHARACTERISTIC
/begin CHARACTERISTIC CalEn_FITOut_TrnkRLvrMtrPWM "" VALUE 0xB0007295 Scalar_UBYTE 0 RDM_FITOut_CM_uint8 0 255 /end CHARACTERISTIC
/begin CHARACTERISTIC CalEn_VeSHM_MotorCtrlModeL "" VALUE 0xB000609A Scalar_UBYTE 0 POD_FITOut_CM_uint8 0 255 /end CHARACTERISTIC
/begin CHARACTERISTIC CalEn_VeSHM_MotorCtrlModeR "" VALUE 0xB000609E Scalar_UBYTE 0 POD_FITOut_CM_uint8 0 255 /end CHARACTERISTIC
/begin CHARACTERISTIC CalEn_VuSHM_MotorCtrlDutyL1 "" VALUE 0xB000609C Scalar_UBYTE 0 POD_FITOut_CM_uint8 0 255 /end CHARACTERISTIC
/begin CHARACTERISTIC CalEn_VuSHM_MotorCtrlDutyL2 "" VALUE 0xB00060A2 Scalar_UBYTE 0 POD_FITOut_CM_uint8 0 255 /end CHARACTERISTIC
/begin CHARACTERISTIC CalEn_VuSHM_MotorCtrlDutyR1 "" VALUE 0xB00060A0 Scalar_UBYTE 0 POD_FITOut_CM_uint8 0 255 /end CHARACTERISTIC
/begin CHARACTERISTIC CalEn_VuSHM_MotorCtrlDutyR2 "" VALUE 0xB00060A4 Scalar_UBYTE 0 POD_FITOut_CM_uint8 0 255 /end CHARACTERISTIC
/begin CHARACTERISTIC CalVal_Config_Console "" VALUE 0xB00072F9 Scalar_UBYTE 0 DIAG_CarConfig_CM_uint8 0 255 /end CHARACTERISTIC
/begin CHARACTERISTIC CalVal_Config_PhysicalKeyType "" VALUE 0xB000730D Scalar_UBYTE 0 DIAG_CarConfig_CM_uint8 0 255 /end CHARACTERISTIC
/begin CHARACTERISTIC CalVal_Config_PowerDoor "" VALUE 0xB0007313 Scalar_UBYTE 0 DIAG_CarConfig_CM_uint8 0 255 /end CHARACTERISTIC
/begin CHARACTERISTIC CalVal_Config_SecRowLtSeatCshExt "" VALUE 0xB00072FF Scalar_UBYTE 0 DIAG_CarConfig_CM_uint8 0 255 /end CHARACTERISTIC
/begin CHARACTERISTIC CalVal_Config_SecRowLtSeatHorz "" VALUE 0xB0007303 Scalar_UBYTE 0 DIAG_CarConfig_CM_uint8 0 255 /end CHARACTERISTIC
/begin CHARACTERISTIC CalVal_Config_SecRowLtSeatTilting "" VALUE 0xB00072FB Scalar_UBYTE 0 DIAG_CarConfig_CM_uint8 0 255 /end CHARACTERISTIC
/begin CHARACTERISTIC CalVal_Config_SecRowRtSeatCshExt "" VALUE 0xB0007301 Scalar_UBYTE 0 DIAG_CarConfig_CM_uint8 0 255 /end CHARACTERISTIC
/begin CHARACTERISTIC CalVal_Config_SecRowRtSeatHorz "" VALUE 0xB0007305 Scalar_UBYTE 0 DIAG_CarConfig_CM_uint8 0 255 /end CHARACTERISTIC
/begin CHARACTERISTIC CalVal_Config_SecRowRtSeatTilting "" VALUE 0xB00072FD Scalar_UBYTE 0 DIAG_CarConfig_CM_uint8 0 255 /end CHARACTERISTIC
/begin CHARACTERISTIC CalVal_Config_TailGatetype "" VALUE 0xB000730F Scalar_UBYTE 0 DIAG_CarConfig_CM_uint8 0 255 /end CHARACTERISTIC
/begin CHARACTERISTIC CalVal_Config_TgateLatch "" VALUE 0xB0007311 Scalar_UBYTE 0 DIAG_CarConfig_CM_uint8 0 255 /end CHARACTERISTIC
/begin CHARACTERISTIC CalVal_Config_TrdRowLtSeatTilting "" VALUE 0xB0007307 Scalar_UBYTE 0 DIAG_CarConfig_CM_uint8 0 255 /end CHARACTERISTIC
/begin CHARACTERISTIC CalVal_Config_TrdRowRtSeatTilting "" VALUE 0xB0007309 Scalar_UBYTE 0 DIAG_CarConfig_CM_uint8 0 255 /end CHARACTERISTIC
/begin CHARACTERISTIC CalVal_Config_UWB "" VALUE 0xB000730B Scalar_UBYTE 0 DIAG_CarConfig_CM_uint8 0 255 /end CHARACTERISTIC
/begin CHARACTERISTIC CalVal_Debug_TgatePosSts "" VALUE 0xB0007282 Scalar_UBYTE 0 RDM_GetTrunkPos_CM_uint8 0 255 /end CHARACTERISTIC
/begin CHARACTERISTIC CalVal_Debug_TrnkCurHallPos "" VALUE 0xB0007284 Scalar_SWORD 0 RDM_GetTrunkPos_CM_int16 -32768 32767 /end CHARACTERISTIC
/begin CHARACTERISTIC CalVal_Debug_TrnkInitSt "" VALUE 0xB0007286 Scalar_UBYTE 0 RDM_GetTrunkPos_CM_uint8 0 255 /end CHARACTERISTIC
/begin CHARACTERISTIC CalVal_Debug_TrnkLatchSt "" VALUE 0xB0007287 Scalar_UBYTE 0 RDM_GetTrunkPos_CM_uint8 0 255 /end CHARACTERISTIC
/begin CHARACTERISTIC CalVal_FIN_RDLockCtrFbCur "" VALUE 0xB00072A8 Scalar_UWORD 0 RDMLatch_FITIn_CM_uint16 0 65535 /end CHARACTERISTIC
/begin CHARACTERISTIC CalVal_FIN_RDoorLockPawlSw "" VALUE 0xB00072AA Scalar_UBYTE 0 RDMLatch_FITIn_CM_uint8 0 255 /end CHARACTERISTIC
/begin CHARACTERISTIC CalVal_FIN_RDoorLockResetSw "" VALUE 0xB00072AB Scalar_UBYTE 0 RDMLatch_FITIn_CM_uint8 0 255 /end CHARACTERISTIC
/begin CHARACTERISTIC CalVal_FIN_RDoorLockSecondSw "" VALUE 0xB00072AC Scalar_UBYTE 0 RDMLatch_FITIn_CM_uint8 0 255 /end CHARACTERISTIC
/begin CHARACTERISTIC CalVal_FIN_TrnkLatchCurrFb "" VALUE 0xB00072AE Scalar_UWORD 0 RDMLatch_FITIn_CM_uint16 0 65535 /end CHARACTERISTIC
/begin CHARACTERISTIC CalVal_FITOut_TgateBuzBepSts "" VALUE 0xB0007296 Scalar_UBYTE 0 RDM_FITOut_CM_uint8 0 255 /end CHARACTERISTIC
/begin CHARACTERISTIC CalVal_FITOut_TrnkLLvrMtrCmd "" VALUE 0xB0007297 Scalar_UBYTE 0 RDM_FITOut_CM_uint8 0 255 /end CHARACTERISTIC
/begin CHARACTERISTIC CalVal_FITOut_TrnkLLvrMtrPWM "" VALUE 0xB0007298 Scalar_UBYTE 0 RDM_FITOut_CM_uint8 0 255 /end CHARACTERISTIC
/begin CHARACTERISTIC CalVal_FITOut_TrnkRLvrMtrCmd "" VALUE 0xB0007299 Scalar_UBYTE 0 RDM_FITOut_CM_uint8 0 255 /end CHARACTERISTIC
/begin CHARACTERISTIC CalVal_FITOut_TrnkRLvrMtrPWM "" VALUE 0xB000729A Scalar_UBYTE 0 RDM_FITOut_CM_uint8 0 255 /end CHARACTERISTIC
/begin CHARACTERISTIC CalVal_VeSHM_MotorCtrlModeL "" VALUE 0xB000609B Scalar_UBYTE 0 POD_FITOut_CM_uint8 0 255 /end CHARACTERISTIC
/begin CHARACTERISTIC CalVal_VeSHM_MotorCtrlModeR "" VALUE 0xB000609F Scalar_UBYTE 0 POD_FITOut_CM_uint8 0 255 /end CHARACTERISTIC
/begin CHARACTERISTIC CalVal_VuSHM_MotorCtrlDutyL1 "" VALUE 0xB000609D Scalar_UBYTE 0 POD_FITOut_CM_uint8 0 255 /end CHARACTERISTIC
/begin CHARACTERISTIC CalVal_VuSHM_MotorCtrlDutyL2 "" VALUE 0xB00060A3 Scalar_UBYTE 0 POD_FITOut_CM_uint8 0 255 /end CHARACTERISTIC
/begin CHARACTERISTIC CalVal_VuSHM_MotorCtrlDutyR1 "" VALUE 0xB00060A1 Scalar_UBYTE 0 POD_FITOut_CM_uint8 0 255 /end CHARACTERISTIC
/begin CHARACTERISTIC CalVal_VuSHM_MotorCtrlDutyR2 "" VALUE 0xB00060A5 Scalar_UBYTE 0 POD_FITOut_CM_uint8 0 255 /end CHARACTERISTIC
/begin CHARACTERISTIC Cal_CurAvgMax_mA "" VALUE 0xB00071FA Scalar_SWORD 0 RDM_LearnRF_CM_int16 -32768 32767 /end CHARACTERISTIC
/begin CHARACTERISTIC Cal_CurAvgMin_mA "" VALUE 0xB00071FC Scalar_SWORD 0 RDM_LearnRF_CM_int16 -32768 32767 /end CHARACTERISTIC
/begin CHARACTERISTIC Cal_SlopeCurPatch "" VAL_BLK 0xB000720C Scalar_UWORD 0 RDM_AntiPinch_CM_uint16 0 65535 MATRIX_DIM 7 /end CHARACTERISTIC
/begin AXIS_PTS Cal_SlopePatch "" 0x8077421C NO_INPUT_QUANTITY Lookup1D_X_FLOAT32_IEEE 0 RDM_DetTrunkMoveReq_CM_single 7 -3.4e+38 3.4e+38 DEPOSIT ABSOLUTE /end AXIS_PTS
/begin CHARACTERISTIC Cal_SlopePatch "" VAL_BLK 0xB000721C Scalar_FLOAT32_IEEE 0 RDM_AntiPinch_CM_single -3.4e+38 3.4e+38 MATRIX_DIM 7 /end CHARACTERISTIC
/begin CHARACTERISTIC Cal_SlopePatchEnable "" VALUE 0xB0007238 Scalar_UBYTE 0 RDM_AntiPinch_CM_uint8 0 255 /end CHARACTERISTIC
/begin CHARACTERISTIC Cal_SlopeSpdPatch "" VAL_BLK 0xB0007239 Scalar_UBYTE 0 RDM_AntiPinch_CM_uint8 0 255 MATRIX_DIM 35 /end CHARACTERISTIC
/begin CHARACTERISTIC K_ADP_Value_CurDiffAntiPinchforMinPntClose "" VALUE 0xB0006CF0 Scalar_FLOAT32_IEEE 0 POD_AntiPinch_CM_single -3.4e+38 3.4e+38 /end CHARACTERISTIC
/begin CHARACTERISTIC K_ADP_Value_ErrPositionDiff "" CURVE 0xB0006CF4 Lookup1D_FLOAT32_IEEE 0 POD_AntiPinch_CM_single -3.4e+38 3.4e+38
 /begin AXIS_DESCR COM_AXIS monr_VfMCM_ldlToAntipinchLAP_MA POD_AntiPinch_CM_single 8 -3.4e+38 3.4e+38 DEPOSIT ABSOLUTE AXIS_PTS_REF k_ADP_Value_ElecComBreakPoints /end AXIS_DESCR
/end CHARACTERISTIC
/begin CHARACTERISTIC K_ADP_Value_MainMotoCurrentMaxDiff "" VALUE 0xB0006D18 Scalar_FLOAT32_IEEE 0 POD_AntiPinch_CM_single -3.4e+38 3.4e+38 /end CHARACTERISTIC
/begin CHARACTERISTIC KfINP_HallDirBckwrdCdn_s "霍尔方向Backward确认时间" VALUE 0xB00060B6 Scalar_FLOAT32_IEEE 0 POD_HallHandleModule_TZCU_CM_single_s -3.4e+38 3.4e+38 /end CHARACTERISTIC
/begin CHARACTERISTIC KfINP_HallDirFrwrdCdn_s "霍尔方向Forward确认时间" VALUE 0xB0007088 Scalar_FLOAT32_IEEE 0 POD_HallHandleModule_TZCU_CM_single_s -3.4e+38 3.4e+38 /end CHARACTERISTIC
/begin CHARACTERISTIC KfINP_HallDirStopCdn_s "霍尔方向stop确认时间" VALUE 0xB000708C Scalar_FLOAT32_IEEE 0 POD_HallHandleModule_TZCU_CM_single_s -3.4e+38 3.4e+38 /end CHARACTERISTIC
/begin MEASUREMENT Monr_Config_Console "" UBYTE DIAG_CarConfig_CM_uint8 0 0 0 255 ECU_ADDRESS 0xB005638E /end MEASUREMENT
/begin MEASUREMENT Monr_Config_PhysicalKeyType "" UBYTE DIAG_CarConfig_CM_uint8 0 0 0 255 ECU_ADDRESS 0xB0056398 /end MEASUREMENT
/begin MEASUREMENT Monr_Config_PowerDoor "" UBYTE DIAG_CarConfig_CM_uint8 0 0 0 255 ECU_ADDRESS 0xB005639B /end MEASUREMENT
/begin MEASUREMENT Monr_Config_SecRowLtSeatCshExt "" UBYTE DIAG_CarConfig_CM_uint8 0 0 0 255 ECU_ADDRESS 0xB0056391 /end MEASUREMENT
/begin MEASUREMENT Monr_Config_SecRowLtSeatHorz "" UBYTE DIAG_CarConfig_CM_uint8 0 0 0 255 ECU_ADDRESS 0xB0056393 /end MEASUREMENT
/begin MEASUREMENT Monr_Config_SecRowLtSeatTilting "" UBYTE DIAG_CarConfig_CM_uint8 0 0 0 255 ECU_ADDRESS 0xB005638F /end MEASUREMENT
/begin MEASUREMENT Monr_Config_SecRowRtSeatCshExt "" UBYTE DIAG_CarConfig_CM_uint8 0 0 0 255 ECU_ADDRESS 0xB0056392 /end MEASUREMENT
/begin MEASUREMENT Monr_Config_SecRowRtSeatHorz "" UBYTE DIAG_CarConfig_CM_uint8 0 0 0 255 ECU_ADDRESS 0xB0056394 /end MEASUREMENT
/begin MEASUREMENT Monr_Config_SecRowRtSeatTilting "" UBYTE DIAG_CarConfig_CM_uint8 0 0 0 255 ECU_ADDRESS 0xB0056390 /end MEASUREMENT
/begin MEASUREMENT Monr_Config_TailGatetype "" UBYTE DIAG_CarConfig_CM_uint8 0 0 0 255 ECU_ADDRESS 0xB0056399 /end MEASUREMENT
/begin MEASUREMENT Monr_Config_TgateLatch "" UBYTE DIAG_CarConfig_CM_uint8 0 0 0 255 ECU_ADDRESS 0xB005639A /end MEASUREMENT
/begin MEASUREMENT Monr_Config_TrdRowLtSeatTilting "" UBYTE DIAG_CarConfig_CM_uint8 0 0 0 255 ECU_ADDRESS 0xB0056395 /end MEASUREMENT
/begin MEASUREMENT Monr_Config_TrdRowRtSeatTilting "" UBYTE DIAG_CarConfig_CM_uint8 0 0 0 255 ECU_ADDRESS 0xB0056396 /end MEASUREMENT
/begin MEASUREMENT Monr_Config_UWB "" UBYTE DIAG_CarConfig_CM_uint8 0 0 0 255 ECU_ADDRESS 0xB0056397 /end MEASUREMENT
/begin MEASUREMENT Monr_FIN_RDLockCtrFbCur "" UWORD RDMLatch_FITIn_CM_UINT16 0 0 0 65535 ECU_ADDRESS 0xB0056382 /end MEASUREMENT
/begin MEASUREMENT Monr_FIN_RDoorLockPawlSw "" UBYTE RDMLatch_FITIn_CM_UINT8 0 0 0 255 ECU_ADDRESS 0xB0056384 /end MEASUREMENT
/begin MEASUREMENT Monr_FIN_RDoorLockResetSw "" UBYTE RDMLatch_FITIn_CM_UINT8 0 0 0 255 ECU_ADDRESS 0xB0056385 /end MEASUREMENT
/begin MEASUREMENT Monr_FIN_RDoorLockSecondSw "" UBYTE RDMLatch_FITIn_CM_UINT8 0 0 0 255 ECU_ADDRESS 0xB0056386 /end MEASUREMENT
/begin MEASUREMENT Monr_FIN_TrnkLLvrCurrFB "" UWORD RDM_FITIn_CM_uint16 0 0 0 65535 ECU_ADDRESS 0xB005635A /end MEASUREMENT
/begin MEASUREMENT Monr_FIN_TrnkLatchCurrFb "" UWORD RDMLatch_FITIn_CM_UINT16 0 0 0 65535 ECU_ADDRESS 0xB0056388 /end MEASUREMENT
/begin MEASUREMENT Monr_FIN_TrnkRLvrCurrFB "" UWORD RDM_FITIn_CM_uint16 0 0 0 65535 ECU_ADDRESS 0xB0056358 /end MEASUREMENT
/begin MEASUREMENT Monr_FITOut_TrnkLLvrMtrCmd "" UBYTE RDM_FITOut_CM_UINT8 0 0 0 255 ECU_ADDRESS 0xB0056360 /end MEASUREMENT
/begin MEASUREMENT Monr_FITOut_TrnkLLvrMtrPWM "" UBYTE RDM_FITOut_CM_UINT8 0 0 0 255 ECU_ADDRESS 0xB0056361 /end MEASUREMENT
/begin MEASUREMENT Monr_FITOut_TrnkRLvrMtrCmd "" UBYTE RDM_FITOut_CM_UINT8 0 0 0 255 ECU_ADDRESS 0xB0056362 /end MEASUREMENT
/begin MEASUREMENT Monr_FITOut_TrnkRLvrMtrPWM "" UBYTE RDM_FITOut_CM_UINT8 0 0 0 255 ECU_ADDRESS 0xB0056363 /end MEASUREMENT
/begin MEASUREMENT Monr_FITOut_VeSHM_MotorCtrlModeL "" UBYTE POD_FITOut_CM_UINT8 0 0 0 255 ECU_ADDRESS 0xB00561BD /end MEASUREMENT
/begin MEASUREMENT Monr_FITOut_VeSHM_MotorCtrlModeR "" UBYTE POD_FITOut_CM_UINT8 0 0 0 255 ECU_ADDRESS 0xB00561BB /end MEASUREMENT
/begin MEASUREMENT Monr_FITOut_VuSHM_MotorCtrlDutyL1 "" UBYTE POD_FITOut_CM_UINT8 0 0 0 255 ECU_ADDRESS 0xB00561BC /end MEASUREMENT
/begin MEASUREMENT Monr_FITOut_VuSHM_MotorCtrlDutyL2 "" UBYTE POD_FITOut_CM_UINT8 0 0 0 255 ECU_ADDRESS 0xB00561B9 /end MEASUREMENT
/begin MEASUREMENT Monr_FITOut_VuSHM_MotorCtrlDutyR1 "" UBYTE POD_FITOut_CM_UINT8 0 0 0 255 ECU_ADDRESS 0xB00561BA /end MEASUREMENT
/begin MEASUREMENT Monr_FITOut_VuSHM_MotorCtrlDutyR2 "" UBYTE POD_FITOut_CM_UINT8 0 0 0 255 ECU_ADDRESS 0xB00561B8 /end MEASUREMENT
/begin MEASUREMENT Monr_TrnkLLvrMtrSpd "" UWORD RDM_HallDeco_CM_uint16 0 0 0 65535 ECU_ADDRESS 0xB0056232 /end MEASUREMENT
/begin MEASUREMENT Monr_TrnkLLvrSortedCurrFBArr "" UWORD RDM_FITIn_CM_UINT16 0 0 0 65535 ECU_ADDRESS 0xB0056284 MATRIX_DIM 100 LAYOUT ROW_DIR /end MEASUREMENT
/begin MEASUREMENT Monr_TrnkRLvrMtrSpd "" UWORD RDM_HallDeco_CM_uint16 0 0 0 65535 ECU_ADDRESS 0xB0056234 /end MEASUREMENT
/begin MEASUREMENT gdu16 "" UWORD TMS_CM_UINT16 0 0 0 65535 ECU_ADDRESS 0x0
 /begin IF_DATA XCP
  /begin DAQ_EVENT VARIABLE /begin DEFAULT_EVENT_LIST EVENT 0x0 /end DEFAULT_EVENT_LIST /end DAQ_EVENT
 /end IF_DATA
/end MEASUREMENT
/begin MEASUREMENT gdu8 "" UBYTE TMS_CM_UINT8 0 0 0 255 ECU_ADDRESS 0x0
 /begin IF_DATA XCP
  /begin DAQ_EVENT VARIABLE /begin DEFAULT_EVENT_LIST EVENT 0x0 /end DEFAULT_EVENT_LIST /end DAQ_EVENT
 /end IF_DATA
/end MEASUREMENT
/begin CHARACTERISTIC k_ADCH_Fac_FilterForAmbTemp "" VALUE 0xB000648C Scalar_FLOAT32_IEEE 0 POD_SignalHandModule_T_CM_single -3.4e+38 3.4e+38 /end CHARACTERISTIC
/begin CHARACTERISTIC k_ADCH_Fac_FilterForUBRVolt "" VALUE 0xB0006498 Scalar_FLOAT32_IEEE 0 POD_SignalHandModule_T_CM_single -3.4e+38 3.4e+38 /end CHARACTERISTIC
/begin CHARACTERISTIC k_ADP_Boolean_APHDEnable "" VALUE 0xB00060FC Scalar_BOOLEAN 0 POD_AntiPinch_CM_boolean 0 1 /end CHARACTERISTIC
/begin CHARACTERISTIC k_ADP_Boolean_Value "防夹标志强标值" VALUE 0xB0006099 Scalar_BOOLEAN 0 POD_AntiPinch_CM_boolean 0 1 /end CHARACTERISTIC
/begin CHARACTERISTIC k_ADP_Boolean_flg "防夹标志强标使能" VALUE 0xB0006098 Scalar_BOOLEAN 0 POD_AntiPinch_CM_boolean 0 1 /end CHARACTERISTIC
/begin CHARACTERISTIC k_ADP_Ti_AllowforAntiPinchTimer "" VALUE 0xB0006100 Scalar_FLOAT32_IEEE 0 POD_AntiPinch_CM_single -3.4e+38 3.4e+38 /end CHARACTERISTIC
/begin CHARACTERISTIC k_ADP_Ti_TimeSpanActiveThreshold "" VALUE 0xB00063A8 Scalar_FLOAT32_IEEE 0 POD_FaultHandle_CM_single -3.4e+38 3.4e+38 /end CHARACTERISTIC
/begin CHARACTERISTIC k_ADP_Value_AllowRelPositionforAntiPinch "" VALUE 0xB000613C Scalar_SWORD 0 POD_AntiPinch_CM_int16 -32768 32767 /end CHARACTERISTIC
/begin CHARACTERISTIC k_ADP_Value_CalCurrentLimitBasicAntiPinch "" VALUE 0xB0006140 Scalar_FLOAT32_IEEE 0 POD_AntiPinch_CM_single -3.4e+38 3.4e+38 /end CHARACTERISTIC
/begin CHARACTERISTIC k_ADP_Value_CurrentMinRefDiffforAntiPinch "" VALUE 0xB0006150 Scalar_FLOAT32_IEEE 0 POD_AntiPinch_CM_single -3.4e+38 3.4e+38 /end CHARACTERISTIC
/begin CHARACTERISTIC k_ADP_Value_CurrentMinRefHallSpeedforAntiPinch "" VALUE 0xB0006154 Scalar_SWORD 0 POD_AntiPinch_CM_int16 -32768 32767 /end CHARACTERISTIC
/begin CHARACTERISTIC k_ADP_Value_CurrentMinRefPntDiffforAntiPinch "" VALUE 0xB0006156 Scalar_SWORD 0 POD_AntiPinch_CM_int16 -32768 32767 /end CHARACTERISTIC
/begin CHARACTERISTIC k_ADP_Value_CurrentMinRefPntforAntiPinch "" VALUE 0xB0006158 Scalar_SWORD 0 POD_AntiPinch_CM_int16 -32768 32767 /end CHARACTERISTIC
/begin CHARACTERISTIC k_ADP_Value_CurrentRefPositionDiffforAntiPinch "" VALUE 0xB000615A Scalar_SWORD 0 POD_AntiPinch_CM_int16 -32768 32767 /end CHARACTERISTIC
/begin CHARACTERISTIC k_ADP_Value_DieMinimumSpeedforAntiPinch "" VALUE 0xB000615E Scalar_SWORD 0 POD_AntiPinch_CM_int16 -32768 32767 /end CHARACTERISTIC
/begin AXIS_PTS k_ADP_Value_ElecComBreakPoints "" 0x80773314 monr_VfMCM_ldlToAntipinchLAP_MA Lookup1D_X_FLOAT32_IEEE 0 POD_AntiPinch_CM_single 8 -3.4e+38 3.4e+38 DEPOSIT ABSOLUTE /end AXIS_PTS
/begin CHARACTERISTIC k_ADP_Value_PIDPosRateforAntiPinch "" VALUE 0xB0006164 Scalar_FLOAT32_IEEE 0 POD_AntiPinch_CM_single -3.4e+38 3.4e+38 /end CHARACTERISTIC
/begin CHARACTERISTIC k_ADP_Value_RefCurrentLimitMax "" VALUE 0xB0006168 Scalar_FLOAT32_IEEE 0 POD_AntiPinch_CM_single -3.4e+38 3.4e+38 /end CHARACTERISTIC
/begin CHARACTERISTIC k_ADP_Value_ThresholdAdjast "" CURVE 0xB000637C Lookup1D_FLOAT32_IEEE 0 POD_AntiPinch_CM_single -3.4e+38 3.4e+38
 /begin AXIS_DESCR COM_AXIS monr_VfMCM_ldlToAntipinchLAP_MA POD_AntiPinch_CM_single 8 -3.4e+38 3.4e+38 DEPOSIT ABSOLUTE AXIS_PTS_REF k_ADP_Value_ElecComBreakPoints /end AXIS_DESCR
/end CHARACTERISTIC
/begin CHARACTERISTIC k_ADP_Value_ThresholdValueOfPosition "" VALUE 0xB000616C Scalar_FLOAT32_IEEE 0 POD_AntiPinch_CM_single -3.4e+38 3.4e+38 /end CHARACTERISTIC
/begin CHARACTERISTIC k_APD_Boolean_AntiPlayEnable "" VALUE 0xB00063AC Scalar_BOOLEAN 0 POD_FaultHandle_CM_boolean 0 1 /end CHARACTERISTIC
/begin CHARACTERISTIC k_APD_Num_AntiPlayNumThreshold "" VALUE 0xB00063AD Scalar_UBYTE 0 POD_FaultHandle_CM_uint8 0 255 /end CHARACTERISTIC
/begin CHARACTERISTIC k_MCM_MotorCtrlDuty1L_flg "" VALUE 0xB00060A6 Scalar_BOOLEAN 0 POD_MCML_CM_boolean 0 1 /end CHARACTERISTIC
/begin CHARACTERISTIC k_MCM_MotorCtrlDuty1L_value "" VALUE 0xB00060A8 Scalar_UWORD 0 POD_MCML_CM_uint16 0 65535 /end CHARACTERISTIC
/begin CHARACTERISTIC k_MCM_MotorCtrlDuty2L_flg "" VALUE 0xB00060AA Scalar_BOOLEAN 0 POD_MCML_CM_boolean 0 1 /end CHARACTERISTIC
/begin CHARACTERISTIC k_MCM_MotorCtrlDuty2L_value "" VALUE 0xB00060AC Scalar_UWORD 0 POD_MCML_CM_uint16 0 65535 /end CHARACTERISTIC
/begin CHARACTERISTIC k_MCM_MotorCtrlDutyL_flg "" VALUE 0xB00060AE Scalar_BOOLEAN 0 POD_MCML_CM_boolean 0 1 /end CHARACTERISTIC
/begin CHARACTERISTIC k_MCM_MotorCtrlDutyL_value "" VALUE 0xB00060B0 Scalar_FLOAT32_IEEE 0 POD_MCML_CM_single -3.4e+38 3.4e+38 /end CHARACTERISTIC
/begin CHARACTERISTIC k_MCM_MotorCtrlModeL_flg "" VALUE 0xB00060B4 Scalar_BOOLEAN 0 POD_MCML_CM_boolean 0 1 /end CHARACTERISTIC
/begin CHARACTERISTIC k_MCM_MotorCtrlModeL_value "" VALUE 0xB00060B5 Scalar_UBYTE 0 POD_MCML_CM_uint8 0 255 /end CHARACTERISTIC
/begin MEASUREMENT mA_u16 "" UWORD TMS_CM_UINT16 0 0 0 65535 ECU_ADDRESS 0x0
 /begin IF_DATA XCP
  /begin DAQ_EVENT VARIABLE /begin DEFAULT_EVENT_LIST EVENT 0x0 /end DEFAULT_EVENT_LIST /end DAQ_EVENT
 /end IF_DATA
/end MEASUREMENT
/begin MEASUREMENT monr_ADP_ErrPosition_FlagLAP "" UBYTE POD_AntiPinch_CM_boolean 0 0 0 1 ECU_ADDRESS 0xB0055981 /end MEASUREMENT
/begin MEASUREMENT monr_ADP_ErrPosition_FlagRAP "" UBYTE POD_AntiPinch_CM_boolean 0 0 0 1 ECU_ADDRESS 0xB0055878 /end MEASUREMENT
/begin MEASUREMENT monr_ADP_PIDErrPosLAP "" FLOAT32_IEEE POD_AntiPinch_CM_single 0 0 -3.4e+38 3.4e+38 ECU_ADDRESS 0xB005587C /end MEASUREMENT
/begin MEASUREMENT monr_ADP_PIDErrPosRAP "" FLOAT32_IEEE POD_AntiPinch_CM_single 0 0 -3.4e+38 3.4e+38 ECU_ADDRESS 0xB0055880 /end MEASUREMENT
/begin MEASUREMENT monr_ADP_Value_AntiPlayActiveCounterR "" SWORD POD_FaultHandle_CM_int16 0 0 -32768 32767 ECU_ADDRESS 0xB0055B86 /end MEASUREMENT
/begin MEASUREMENT monr_ADP_Value_BatVoltaget_DiffLAP "" FLOAT32_IEEE POD_AntiPinch_CM_single 0 0 -3.4e+38 3.4e+38 ECU_ADDRESS 0xB0055884 /end MEASUREMENT
/begin MEASUREMENT monr_ADP_Value_BatVoltaget_DiffRAP "" FLOAT32_IEEE POD_AntiPinch_CM_single 0 0 -3.4e+38 3.4e+38 ECU_ADDRESS 0xB0055888 /end MEASUREMENT
/begin MEASUREMENT monr_ADP_Value_ErrPositionLAP "" FLOAT32_IEEE POD_AntiPinch_CM_single 0 0 -3.4e+38 3.4e+38 ECU_ADDRESS 0xB0055894 /end MEASUREMENT
/begin MEASUREMENT monr_ADP_Value_ErrPositionRAP "" FLOAT32_IEEE POD_AntiPinch_CM_single 0 0 -3.4e+38 3.4e+38 ECU_ADDRESS 0xB0055898 /end MEASUREMENT
/begin MEASUREMENT monr_ADP_Value_ErrPosition_DiffLAP "" FLOAT32_IEEE POD_AntiPinch_CM_single 0 0 -3.4e+38 3.4e+38 ECU_ADDRESS 0xB005588C /end MEASUREMENT
/begin MEASUREMENT monr_ADP_Value_ErrPosition_DiffRAP "" FLOAT32_IEEE POD_AntiPinch_CM_single 0 0 -3.4e+38 3.4e+38 ECU_ADDRESS 0xB0055890 /end MEASUREMENT
/begin MEASUREMENT monr_ADP_Value_FastPointerL "" FLOAT32_IEEE POD_FaultHandle_CM_single 0 0 -3.4e+38 3.4e+38 ECU_ADDRESS 0xB0055B8C /end MEASUREMENT
/begin MEASUREMENT monr_ADP_Value_FastPointerR "" FLOAT32_IEEE POD_FaultHandle_CM_single 0 0 -3.4e+38 3.4e+38 ECU_ADDRESS 0xB0055B90 /end MEASUREMENT
/begin MEASUREMENT monr_ADP_Value_HistoricalTimerL "" FLOAT32_IEEE POD_FaultHandle_CM_single 0 0 -3.4e+38 3.4e+38 ECU_ADDRESS 0xB0055B88 /end MEASUREMENT
/begin MEASUREMENT monr_ADP_Value_HistoricalTimerR "" FLOAT32_IEEE POD_FaultHandle_CM_single 0 0 -3.4e+38 3.4e+38 ECU_ADDRESS 0xB0055A7C /end MEASUREMENT
/begin MEASUREMENT monr_ADP_Value_MainMotoCurrent_DiffLAP "" FLOAT32_IEEE POD_AntiPinch_CM_single 0 0 -3.4e+38 3.4e+38 ECU_ADDRESS 0xB005589C /end MEASUREMENT
/begin MEASUREMENT monr_ADP_Value_MainMotoCurrent_DiffRAP "" FLOAT32_IEEE POD_AntiPinch_CM_single 0 0 -3.4e+38 3.4e+38 ECU_ADDRESS 0xB00558A0 /end MEASUREMENT
/begin MEASUREMENT monr_ADP_Value_SlowPointerL "" FLOAT32_IEEE POD_FaultHandle_CM_single 0 0 -3.4e+38 3.4e+38 ECU_ADDRESS 0xB0055A80 /end MEASUREMENT
/begin MEASUREMENT monr_ADP_Value_SlowPointerR "" FLOAT32_IEEE POD_FaultHandle_CM_single 0 0 -3.4e+38 3.4e+38 ECU_ADDRESS 0xB0055A84 /end MEASUREMENT
/begin MEASUREMENT monr_ADP_Value_TimeStampL "" FLOAT32_IEEE POD_FaultHandle_CM_single 0 0 -3.4e+38 3.4e+38 ECU_ADDRESS 0xB0055A88 /end MEASUREMENT
/begin MEASUREMENT monr_ADP_Value_TimeStampR "" FLOAT32_IEEE POD_FaultHandle_CM_single 0 0 -3.4e+38 3.4e+38 ECU_ADDRESS 0xB0055A8C /end MEASUREMENT
/begin MEASUREMENT monr_ADP_Value_TimerL "" FLOAT32_IEEE POD_FaultHandle_CM_single 0 0 -3.4e+38 3.4e+38 ECU_ADDRESS 0xB0055A90 /end MEASUREMENT
/begin MEASUREMENT monr_ADP_Value_TimerR "" FLOAT32_IEEE POD_FaultHandle_CM_single 0 0 -3.4e+38 3.4e+38 ECU_ADDRESS 0xB0055A94 /end MEASUREMENT
/begin MEASUREMENT monr_EncoderGetCounter_XL "" UWORD POD_HallHandleModule_TZCU_CM_uint16 0 0 0 65535 ECU_ADDRESS 0xB00561CC /end MEASUREMENT
/begin MEASUREMENT monr_EncoderGetCounter_XR "" UWORD POD_HallHandleModule_TZCU_CM_uint16 0 0 0 65535 ECU_ADDRESS 0xB00561CE /end MEASUREMENT
/begin MEASUREMENT monr_EncoderGetDirection_XL "" UBYTE POD_HallHandleModule_TZCU_CM_uint8 0 0 0 255 ECU_ADDRESS 0xB00561D0 /end MEASUREMENT
/begin MEASUREMENT monr_EncoderGetDirection_XR "" UBYTE POD_HallHandleModule_TZCU_CM_uint8 0 0 0 255 ECU_ADDRESS 0xB00561D1 /end MEASUREMENT
/begin MEASUREMENT monr_VbAP_AntiPinchStsDspL_flg "" UBYTE POD_AntiPinch_CM_boolean 0 0 0 1 ECU_ADDRESS 0xB00558FC /end MEASUREMENT
/begin MEASUREMENT monr_VbAP_AntiPinchforMinPntCloseLAP_flg "" UBYTE POD_AntiPinch_CM_boolean 0 0 0 1 ECU_ADDRESS 0xB00558A4 /end MEASUREMENT
/begin MEASUREMENT monr_VbAP_AntiPinchforMinPntCloseRAP_flg "" UBYTE POD_AntiPinch_CM_boolean 0 0 0 1 ECU_ADDRESS 0xB00558A5 /end MEASUREMENT
/begin MEASUREMENT monr_VbAP_CurrJudgeDurNormrunLAP_flg "" UBYTE POD_AntiPinch_CM_boolean 0 0 0 1 ECU_ADDRESS 0xB00558A6 /end MEASUREMENT
/begin MEASUREMENT monr_VbAP_CurrJudgeDurNormrunRAP_flg "" UBYTE POD_AntiPinch_CM_boolean 0 0 0 1 ECU_ADDRESS 0xB00558A7 /end MEASUREMENT
/begin MEASUREMENT monr_VbAP_DiffJudgeDurNormrunLAP_flg "" UBYTE POD_AntiPinch_CM_boolean 0 0 0 1 ECU_ADDRESS 0xB00558A8 /end MEASUREMENT
/begin MEASUREMENT monr_VbAP_DiffJudgeDurNormrunRAP_flg "" UBYTE POD_AntiPinch_CM_boolean 0 0 0 1 ECU_ADDRESS 0xB00558A9 /end MEASUREMENT
/begin MEASUREMENT monr_VbAP_JudgeCurAntiPinchLAP_flg "" UBYTE POD_AntiPinch_CM_boolean 0 0 0 1 ECU_ADDRESS 0xB00558AB /end MEASUREMENT
/begin MEASUREMENT monr_VbAP_JudgeCurAntiPinchRAP_flg "" UBYTE POD_AntiPinch_CM_boolean 0 0 0 1 ECU_ADDRESS 0xB00558AC /end MEASUREMENT
/begin MEASUREMENT monr_VbAP_JudgeCurAntiPinchforMinPntCloseLAP_flg "" UBYTE POD_AntiPinch_CM_boolean 0 0 0 1 ECU_ADDRESS 0xB0055980 /end MEASUREMENT
/begin MEASUREMENT monr_VbAP_JudgeCurAntiPinchforMinPntCloseRAP_flg "" UBYTE POD_AntiPinch_CM_boolean 0 0 0 1 ECU_ADDRESS 0xB00558AA /end MEASUREMENT
/begin MEASUREMENT monr_VbAP_Tip2RunAntiPinchL_flg "" UBYTE POD_AntiPinch_CM_boolean 0 0 0 1 ECU_ADDRESS 0xB00558FE /end MEASUREMENT
/begin MEASUREMENT monr_VbFH_AnptiplayR_flg "" UBYTE POD_FaultHandle_CM_boolean 0 0 0 1 ECU_ADDRESS 0xB0055A9B /end MEASUREMENT
/begin MEASUREMENT monr_VbFH_FrbdMaiMotWrkL_flg "" UBYTE POD_FaultHandle_CM_boolean 0 0 0 1 ECU_ADDRESS 0xB0055AA0 /end MEASUREMENT
/begin MEASUREMENT monr_VbFH_FrbdMaiMotWrkR_flg "" UBYTE POD_FaultHandle_CM_boolean 0 0 0 1 ECU_ADDRESS 0xB0055AA1 /end MEASUREMENT
/begin MEASUREMENT monr_VbFH_FrntIncinAgFltL_flg "" UBYTE POD_FaultHandle_CM_boolean 0 0 0 1 ECU_ADDRESS 0xB0055AA2 /end MEASUREMENT
/begin MEASUREMENT monr_VbFH_GyroSigFltL_flg "" UBYTE POD_FaultHandle_CM_boolean 0 0 0 1 ECU_ADDRESS 0xB0055AA4 /end MEASUREMENT
/begin MEASUREMENT monr_VbFH_HallSigErrL_flg "" UBYTE POD_FaultHandle_CM_boolean 0 0 0 1 ECU_ADDRESS 0xB0055AA6 /end MEASUREMENT
/begin MEASUREMENT monr_VbFH_HallSigErrR_flg "" UBYTE POD_FaultHandle_CM_boolean 0 0 0 1 ECU_ADDRESS 0xB0055AA7 /end MEASUREMENT
/begin MEASUREMENT monr_VbFH_MotOvrheatProtL_flg "" UBYTE POD_FaultHandle_CM_boolean 0 0 0 1 ECU_ADDRESS 0xB0055AA8 /end MEASUREMENT
/begin MEASUREMENT monr_VbFH_MotOvrheatProtR_flg "" UBYTE POD_FaultHandle_CM_boolean 0 0 0 1 ECU_ADDRESS 0xB0055AA9 /end MEASUREMENT
/begin MEASUREMENT monr_VbFH_RdrTioutL_flg "" UBYTE POD_FaultHandle_CM_boolean 0 0 0 1 ECU_ADDRESS 0xB0055AAA /end MEASUREMENT
/begin MEASUREMENT monr_VbFH_SideIncinAgFltL_flg "" UBYTE POD_FaultHandle_CM_boolean 0 0 0 1 ECU_ADDRESS 0xB0055AAC /end MEASUREMENT
/begin MEASUREMENT monr_VbFH_VBattNrml_flg "" UBYTE POD_FaultHandle_CM_boolean 0 0 0 1 ECU_ADDRESS 0xB0055AB1 /end MEASUREMENT
/begin MEASUREMENT monr_VbFMS_CAN0BusOffErrL_FMS_flg "" UBYTE POD_FaultHandle_CM_boolean 0 0 0 1 ECU_ADDRESS 0xB0055AB2 /end MEASUREMENT
/begin MEASUREMENT monr_VbFMS_CAN0BusOffErrR_FMS_flg "" UBYTE POD_FaultHandle_CM_boolean 0 0 0 1 ECU_ADDRESS 0xB0055AB3 /end MEASUREMENT
/begin MEASUREMENT monr_VbFMS_CAN1BusOffErrL_FMS_flg "" UBYTE POD_FaultHandle_CM_boolean 0 0 0 1 ECU_ADDRESS 0xB0055AB4 /end MEASUREMENT
/begin MEASUREMENT monr_VbFMS_CAN1BusOffErrR_FMS_flg "" UBYTE POD_FaultHandle_CM_boolean 0 0 0 1 ECU_ADDRESS 0xB0055AB5 /end MEASUREMENT
/begin MEASUREMENT monr_VbFMS_CemFr05TiOutL_FMS_flg "" UBYTE POD_FaultHandle_CM_boolean 0 0 0 1 ECU_ADDRESS 0xB0055AB8 /end MEASUREMENT
/begin MEASUREMENT monr_VbFMS_CemFr05TiOutR_FMS_flg "" UBYTE POD_FaultHandle_CM_boolean 0 0 0 1 ECU_ADDRESS 0xB0055AB9 /end MEASUREMENT
/begin MEASUREMENT monr_VbFMS_CemFr09TiOutL_FMS_flg "" UBYTE POD_FaultHandle_CM_boolean 0 0 0 1 ECU_ADDRESS 0xB0055ABA /end MEASUREMENT
/begin MEASUREMENT monr_VbFMS_CemFr09TiOutR_FMS_flg "" UBYTE POD_FaultHandle_CM_boolean 0 0 0 1 ECU_ADDRESS 0xB0055ABB /end MEASUREMENT
/begin MEASUREMENT monr_VbFMS_HallBSCGErrL_flg "" UBYTE POD_FaultHandle_CM_boolean 0 0 0 1 ECU_ADDRESS 0xB0055AC0 /end MEASUREMENT
/begin MEASUREMENT monr_VbFMS_MCUOHLvl2ErrL_FMS_flg "" UBYTE POD_FaultHandle_CM_boolean 0 0 0 1 ECU_ADDRESS 0xB0055AC2 /end MEASUREMENT
/begin MEASUREMENT monr_VbFMS_MCUOHLvl2ErrR_FMS_flg "" UBYTE POD_FaultHandle_CM_boolean 0 0 0 1 ECU_ADDRESS 0xB0055AC3 /end MEASUREMENT
/begin MEASUREMENT monr_VbFMS_MaiMotOCErrL_flg "" UBYTE POD_FaultHandle_CM_boolean 0 0 0 1 ECU_ADDRESS 0xB0055AC4 /end MEASUREMENT
/begin MEASUREMENT monr_VbFMS_MaiMotSCBErrL_flg "" UBYTE POD_FaultHandle_CM_boolean 0 0 0 1 ECU_ADDRESS 0xB0055AC8 /end MEASUREMENT
/begin MEASUREMENT monr_VbFMS_MaiMotSCGErrL_flg "" UBYTE POD_FaultHandle_CM_boolean 0 0 0 1 ECU_ADDRESS 0xB0055ACC /end MEASUREMENT
/begin MEASUREMENT monr_VbFMS_MaiMotVDSULErrL_flg "" UBYTE POD_FaultHandle_CM_boolean 0 0 0 1 ECU_ADDRESS 0xB0055AD2 /end MEASUREMENT
/begin MEASUREMENT monr_VbFMS_RAMErrL_flg "" UBYTE POD_FaultHandle_CM_boolean 0 0 0 1 ECU_ADDRESS 0xB0055ADA /end MEASUREMENT
/begin MEASUREMENT monr_VbFMS_RdrTimeOutRawL_flg "" UBYTE POD_FaultHandle_CM_boolean 0 0 0 1 ECU_ADDRESS 0xB0055ADE /end MEASUREMENT
/begin MEASUREMENT monr_VbFMS_SPIComErrL_FMS_flg "" UBYTE POD_FaultHandle_CM_boolean 0 0 0 1 ECU_ADDRESS 0xB0055AE2 /end MEASUREMENT
/begin MEASUREMENT monr_VbFMS_SPIComErrR_FMS_flg "" UBYTE POD_FaultHandle_CM_boolean 0 0 0 1 ECU_ADDRESS 0xB0055AE3 /end MEASUREMENT
/begin MEASUREMENT monr_VbHHM_ASWBSWHallInitR_flg "" UBYTE POD_HallHandleModule_TZCU_CM_boolean 0 0 0 1 ECU_ADDRESS 0xB0055B9D /end MEASUREMENT
/begin MEASUREMENT monr_VbHHM_BooleanDownLHHM_flg "" UBYTE POD_HallHandleModule_TZCU_CM_boolean 0 0 0 1 ECU_ADDRESS 0xB0055B9E /end MEASUREMENT
/begin MEASUREMENT monr_VbHHM_BooleanHoldLHHM_flg "" UBYTE POD_HallHandleModule_TZCU_CM_boolean 0 0 0 1 ECU_ADDRESS 0xB0055BA0 /end MEASUREMENT
/begin MEASUREMENT monr_VbHHM_BooleanManualDownLHHM_flg "" UBYTE POD_HallHandleModule_TZCU_CM_boolean 0 0 0 1 ECU_ADDRESS 0xB0055BA2 /end MEASUREMENT
/begin MEASUREMENT monr_VbHHM_BooleanManualUpLHHM_flg "" UBYTE POD_HallHandleModule_TZCU_CM_boolean 0 0 0 1 ECU_ADDRESS 0xB0055BA4 /end MEASUREMENT
/begin MEASUREMENT monr_VbHHM_BooleanUpLHHM_flg "" UBYTE POD_HallHandleModule_TZCU_CM_boolean 0 0 0 1 ECU_ADDRESS 0xB0055BA6 /end MEASUREMENT
/begin MEASUREMENT monr_VbHHM_CloseTheDoorHallErrLHHM_flg "" UBYTE POD_HallHandleModule_TZCU_CM_boolean 0 0 0 1 ECU_ADDRESS 0xB0055BA8 /end MEASUREMENT
/begin MEASUREMENT monr_VbHHM_DoorAbsPstnInitRHHM_flg "" UBYTE POD_HallHandleModule_TZCU_CM_boolean 0 0 0 1 ECU_ADDRESS 0xB0055BAB /end MEASUREMENT
/begin MEASUREMENT monr_VbHHM_DoorOpenL_flg "" UBYTE POD_HallHandleModule_TZCU_CM_boolean 0 0 0 1 ECU_ADDRESS 0xB0055BAC /end MEASUREMENT
/begin MEASUREMENT monr_VbHHM_DoorOpenRHHM_flg "" UBYTE POD_HallHandleModule_TZCU_CM_boolean 0 0 0 1 ECU_ADDRESS 0xB0055BAF /end MEASUREMENT
/begin MEASUREMENT monr_VbHHM_DoorPstnInitRHHM_flg "" UBYTE POD_HallHandleModule_TZCU_CM_boolean 0 0 0 1 ECU_ADDRESS 0xB0055BB1 /end MEASUREMENT
/begin MEASUREMENT monr_VbHHM_DoorRelPstnInitRHHM_flg "" UBYTE POD_HallHandleModule_TZCU_CM_boolean 0 0 0 1 ECU_ADDRESS 0xB0055BB3 /end MEASUREMENT
/begin MEASUREMENT monr_VbHHM_HALLAErrEnableLHHM_flg "" UBYTE POD_HallHandleModule_TZCU_CM_boolean 0 0 0 1 ECU_ADDRESS 0xB0055BB4 /end MEASUREMENT
/begin MEASUREMENT monr_VbHHM_HALLAFaultLHHM_flg "" UBYTE POD_HallHandleModule_TZCU_CM_boolean 0 0 0 1 ECU_ADDRESS 0xB0055BB6 /end MEASUREMENT
/begin MEASUREMENT monr_VbHHM_HallErrEnableLHHM_flg "" UBYTE POD_HallHandleModule_TZCU_CM_boolean 0 0 0 1 ECU_ADDRESS 0xB0055BB8 /end MEASUREMENT
/begin MEASUREMENT monr_VbHHM_HallErrRHHM_flg "" UBYTE POD_HallHandleModule_TZCU_CM_boolean 0 0 0 1 ECU_ADDRESS 0xB0055BBB /end MEASUREMENT
/begin MEASUREMENT monr_VbHHM_HallErrSpeedRHHM_flg "" UBYTE POD_HallHandleModule_TZCU_CM_boolean 0 0 0 1 ECU_ADDRESS 0xB0055BBD /end MEASUREMENT
/begin MEASUREMENT monr_VbHHM_HallSigFltR_flg "" UBYTE POD_HallHandleModule_TZCU_CM_boolean 0 0 0 1 ECU_ADDRESS 0xB0055BC3 /end MEASUREMENT
/begin MEASUREMENT monr_VbHHM_InitErrorRHHM_flg "" UBYTE POD_HallHandleModule_TZCU_CM_boolean 0 0 0 1 ECU_ADDRESS 0xB0055BC5 /end MEASUREMENT
/begin MEASUREMENT monr_VbHHM_Lck2DrStsErrRHHM_flg "" UBYTE POD_HallHandleModule_TZCU_CM_boolean 0 0 0 1 ECU_ADDRESS 0xB0055BC7 /end MEASUREMENT
/begin MEASUREMENT monr_VbHHM_NVMHallEnableRHHM_flg "" UBYTE POD_HallHandleModule_TZCU_CM_boolean 0 0 0 1 ECU_ADDRESS 0xB0055BC9 /end MEASUREMENT
/begin MEASUREMENT monr_VbHHM_OnlyHallPWMErrLHHM_flg "" UBYTE POD_HallHandleModule_TZCU_CM_boolean 0 0 0 1 ECU_ADDRESS 0xB0055BCA /end MEASUREMENT
/begin MEASUREMENT monr_VbHHM_OpenTheDoorHallErrLHHM_flg "" UBYTE POD_HallHandleModule_TZCU_CM_boolean 0 0 0 1 ECU_ADDRESS 0xB0055BCC /end MEASUREMENT
/begin MEASUREMENT monr_VbHHM_PreClsdLHHM_flg "" UBYTE POD_HallHandleModule_TZCU_CM_boolean 0 0 0 1 ECU_ADDRESS 0xB0055BCE /end MEASUREMENT
/begin MEASUREMENT monr_VbHHM_PreOpenLHHM_flg "" UBYTE POD_HallHandleModule_TZCU_CM_boolean 0 0 0 1 ECU_ADDRESS 0xB0055BD0 /end MEASUREMENT
/begin MEASUREMENT monr_VbMBC_HoldIsCtrlL_flg "" UBYTE POD_MBCL_CM_boolean 0 0 0 1 ECU_ADDRESS 0xB00561BE /end MEASUREMENT
/begin MEASUREMENT monr_VbMBC_HoldIsCtrlR_flg "" UBYTE POD_MBCR_CM_boolean 0 0 0 1 ECU_ADDRESS 0xB00561C4 /end MEASUREMENT
/begin MEASUREMENT monr_VbMCM_ManualAssistL_flag "" UBYTE POD_MCML_CM_boolean 0 0 0 1 ECU_ADDRESS 0xB0055D29 /end MEASUREMENT
/begin MEASUREMENT monr_VbMCM_ManualAssistR_flag "" UBYTE POD_MCMR_CM_boolean 0 0 0 1 ECU_ADDRESS 0xB0055DAC /end MEASUREMENT
/begin MEASUREMENT monr_VbMCM_MotorBrkgL_flg "" UBYTE POD_MCML_CM_boolean 0 0 0 1 ECU_ADDRESS 0xB0055D28 /end MEASUREMENT
/begin MEASUREMENT monr_VbMCM_MotorBrkgR_flg "" UBYTE POD_MCMR_CM_boolean 0 0 0 1 ECU_ADDRESS 0xB0055DBC /end MEASUREMENT
/begin MEASUREMENT monr_VbMCM_TipToRunL_flag "" UBYTE POD_MCML_CM_boolean 0 0 0 1 ECU_ADDRESS 0xB0055D2A /end MEASUREMENT
/begin MEASUREMENT monr_VbMCM_TipToRunR_flag "" UBYTE POD_MCMR_CM_boolean 0 0 0 1 ECU_ADDRESS 0xB0055DB4 /end MEASUREMENT
/begin MEASUREMENT monr_VbTTR_HoldModeManAssistLTTR_flg "" UBYTE POD_TipToRun_CM_boolean 0 0 0 1 ECU_ADDRESS 0xB00560D0 /end MEASUREMENT
/begin MEASUREMENT monr_VbTTR_HoldPosExitLTTR_flg "" UBYTE POD_TipToRun_CM_boolean 0 0 0 1 ECU_ADDRESS 0xB00560D2 /end MEASUREMENT
/begin MEASUREMENT monr_VbTTR_StopToAssistCloseLTTR_flg "" UBYTE POD_TipToRun_CM_boolean 0 0 0 1 ECU_ADDRESS 0xB00560F2 /end MEASUREMENT
/begin MEASUREMENT monr_VbTTR_StopToAssistOpenLTTR_flg "" UBYTE POD_TipToRun_CM_boolean 0 0 0 1 ECU_ADDRESS 0xB00560F3 /end MEASUREMENT
/begin MEASUREMENT monr_VbTTR_TipToRunRqstL_flg "" UBYTE POD_TipToRun_CM_boolean 0 0 0 1 ECU_ADDRESS 0xB0056174 /end MEASUREMENT
/begin MEASUREMENT monr_VbTTR_TipToRunRqstR_flg "" UBYTE POD_TipToRun_CM_boolean 0 0 0 1 ECU_ADDRESS 0xB0056175 /end MEASUREMENT
/begin MEASUREMENT monr_VeFH_DoorLckPstnL_enum "" UBYTE POD_FaultHandle_CM_uint8 0 0 0 255 ECU_ADDRESS 0xB0055B04 /end MEASUREMENT
/begin MEASUREMENT monr_VeFMS_MaiMotErrL_NULL "" UBYTE POD_FaultHandle_CM_uint8 0 0 0 255 ECU_ADDRESS 0xB0055B0B /end MEASUREMENT
/begin MEASUREMENT monr_VeHHM_DoorMovStsL_NULL "" UBYTE POD_HallHandleModule_TZCU_CM_uint8 0 0 0 255 ECU_ADDRESS 0xB0055BD4 /end MEASUREMENT
/begin MEASUREMENT monr_VeHHM_SectorIndexL_enum "" UBYTE POD_HallHandleModule_TZCU_CM_uint8 0 0 0 255 ECU_ADDRESS 0xB0055BD6 /end MEASUREMENT
/begin MEASUREMENT monr_VeHHM_SectorIndexR_enum "" UBYTE POD_HallHandleModule_TZCU_CM_uint8 0 0 0 255 ECU_ADDRESS 0xB0055BD7 /end MEASUREMENT
/begin MEASUREMENT monr_VeHHM_UsrSetMaxPstnL_pct "" UBYTE POD_HallHandleModule_TZCU_CM_uint8 0 0 0 255 ECU_ADDRESS 0xB0055BD8 /end MEASUREMENT
/begin MEASUREMENT monr_VeMBC_HoldMotorCtrlModeL_enum "" UBYTE POD_MBCL_CM_uint8 0 0 0 255 ECU_ADDRESS 0xB00561BF /end MEASUREMENT
/begin MEASUREMENT monr_VeMBC_HoldMotorCtrlModeR_enum "" UBYTE POD_MBCR_CM_uint8 0 0 0 255 ECU_ADDRESS 0xB00561C5 /end MEASUREMENT
/begin MEASUREMENT monr_VeMCM_CmdStateL_NULL "" UBYTE POD_MCML_CM_uint8 0 0 0 255 ECU_ADDRESS 0xB0055D98 /end MEASUREMENT
/begin MEASUREMENT monr_VeMCM_CmdStateR_NULL "" UBYTE POD_MCMR_CM_uint8 0 0 0 255 ECU_ADDRESS 0xB0055E23 /end MEASUREMENT
/begin MEASUREMENT monr_VeMCM_MotorCtrlModeL_enum "" UBYTE POD_MCML_CM_uint8 0 0 0 255 ECU_ADDRESS 0xB0055D14 /end MEASUREMENT
/begin MEASUREMENT monr_VeMCM_MotorCtrlModeR_enum "" UBYTE POD_MCMR_CM_uint8 0 0 0 255 ECU_ADDRESS 0xB0055E12 /end MEASUREMENT
/begin MEASUREMENT monr_VeSHM_DoorOpenArlmL_enum "" UBYTE POD_SignalHandModule_T_CM_uint8 0 0 0 255 ECU_ADDRESS 0xB0055EDB /end MEASUREMENT
/begin MEASUREMENT monr_VeSHM_DoorOpenArlmR_enum "" UBYTE POD_SignalHandModule_T_CM_uint8 0 0 0 255 ECU_ADDRESS 0xB0055EDC /end MEASUREMENT
/begin MEASUREMENT monr_VeSHM_FrntIncinAgQlyL_enum "" UBYTE POD_SignalHandModule_T_CM_uint8 0 0 0 255 ECU_ADDRESS 0xB0055EF3 /end MEASUREMENT
/begin MEASUREMENT monr_VeSHM_FrntIncinAgQlyR_enum "" UBYTE POD_SignalHandModule_T_CM_uint8 0 0 0 255 ECU_ADDRESS 0xB0055EF4 /end MEASUREMENT
/begin MEASUREMENT monr_VeSHM_MotorCtrlModeL_enum "" UBYTE POD_SignalHandModule_T_CM_uint8 0 0 0 255 ECU_ADDRESS 0xB0055EF6 /end MEASUREMENT
/begin MEASUREMENT monr_VeSHM_MotorCtrlModeR_enum "" UBYTE POD_SignalHandModule_T_CM_uint8 0 0 0 255 ECU_ADDRESS 0xB0055EF7 /end MEASUREMENT
/begin MEASUREMENT monr_VeSHM_SideIncinAgQlyL_enum "" UBYTE POD_SignalHandModule_T_CM_uint8 0 0 0 255 ECU_ADDRESS 0xB0055F04 /end MEASUREMENT
/begin MEASUREMENT monr_VeSHM_SideIncinAgQlyR_enum "" UBYTE POD_SignalHandModule_T_CM_uint8 0 0 0 255 ECU_ADDRESS 0xB0055F05 /end MEASUREMENT
/begin MEASUREMENT monr_VeSHM_TopPercXLHmiFeedBack_pct "" UBYTE POD_SignalHandModule_T_CM_uint8 0 0 0 255 ECU_ADDRESS 0xB0055F06 /end MEASUREMENT
/begin MEASUREMENT monr_VeSHM_TopPercXRHmiFeedBack_pct "" UBYTE POD_SignalHandModule_T_CM_uint8 0 0 0 255 ECU_ADDRESS 0xB0055F07 /end MEASUREMENT
/begin MEASUREMENT monr_VeSHM_VehSpdLgtQly_enum "" UBYTE POD_SignalHandModule_T_CM_uint8 0 0 0 255 ECU_ADDRESS 0xB0055F0B /end MEASUREMENT
/begin MEASUREMENT monr_VeSHM_XLReq_enum "" UBYTE POD_SignalHandModule_T_CM_uint8 0 0 0 255 ECU_ADDRESS 0xB0055F14 /end MEASUREMENT
/begin MEASUREMENT monr_VeSHM_XRReq_enum "" UBYTE POD_SignalHandModule_T_CM_uint8 0 0 0 255 ECU_ADDRESS 0xB0055F19 /end MEASUREMENT
/begin MEASUREMENT monr_VeTTR_ManAsstRqstL_enum "" UBYTE POD_TipToRun_CM_uint8 0 0 0 255 ECU_ADDRESS 0xB0056183 /end MEASUREMENT
/begin MEASUREMENT monr_VeTTR_ManAsstRqstR_enum "" UBYTE POD_TipToRun_CM_uint8 0 0 0 255 ECU_ADDRESS 0xB0056184 /end MEASUREMENT
/begin MEASUREMENT monr_VfAP_ValueBatVoltagetBaseLAP_MV "" FLOAT32_IEEE POD_AntiPinch_CM_single 0 0 -3.4e+38 3.4e+38 ECU_ADDRESS 0xB00558B4 /end MEASUREMENT
/begin MEASUREMENT monr_VfAP_ValueBatVoltagetBaseRAP_MV "" FLOAT32_IEEE POD_AntiPinch_CM_single 0 0 -3.4e+38 3.4e+38 ECU_ADDRESS 0xB00558B8 /end MEASUREMENT
/begin MEASUREMENT monr_VfAP_ValueCurrentCmpLAP_MA "" FLOAT32_IEEE POD_AntiPinch_CM_single 0 0 -3.4e+38 3.4e+38 ECU_ADDRESS 0xB00558C4 /end MEASUREMENT
/begin MEASUREMENT monr_VfAP_ValueCurrentCmpRAP_MA "" FLOAT32_IEEE POD_AntiPinch_CM_single 0 0 -3.4e+38 3.4e+38 ECU_ADDRESS 0xB00558C8 /end MEASUREMENT
/begin MEASUREMENT monr_VfAP_ValueMainMotoCurrentBaseLAP_MA "" FLOAT32_IEEE POD_AntiPinch_CM_single 0 0 -3.4e+38 3.4e+38 ECU_ADDRESS 0xB00558CC /end MEASUREMENT
/begin MEASUREMENT monr_VfAP_ValueMainMotoCurrentBaseRAP_MA "" FLOAT32_IEEE POD_AntiPinch_CM_single 0 0 -3.4e+38 3.4e+38 ECU_ADDRESS 0xB00558D0 /end MEASUREMENT
/begin MEASUREMENT monr_VfAP_ValueReferenceCurrentSumLAP_MA "" FLOAT32_IEEE POD_AntiPinch_CM_single 0 0 -3.4e+38 3.4e+38 ECU_ADDRESS 0xB00558E4 /end MEASUREMENT
/begin MEASUREMENT monr_VfAP_ValueReferenceCurrentSumRAP_MA "" FLOAT32_IEEE POD_AntiPinch_CM_single 0 0 -3.4e+38 3.4e+38 ECU_ADDRESS 0xB00558E8 /end MEASUREMENT
/begin MEASUREMENT monr_VfAP_ValueTriggMotCurAddLAP_MA "" FLOAT32_IEEE POD_AntiPinch_CM_single 0 0 -3.4e+38 3.4e+38 ECU_ADDRESS 0xB00558F4 /end MEASUREMENT
/begin MEASUREMENT monr_VfAP_ValueTriggMotCurAddRAP_MA "" FLOAT32_IEEE POD_AntiPinch_CM_single 0 0 -3.4e+38 3.4e+38 ECU_ADDRESS 0xB00558F8 /end MEASUREMENT
/begin MEASUREMENT monr_VfHHM_AswHallPositionL_deg "" FLOAT32_IEEE POD_HallHandleModule_TZCU_CM_single 0 0 -3.4e+38 3.4e+38 ECU_ADDRESS 0xB0055BF0 /end MEASUREMENT
/begin MEASUREMENT monr_VfHHM_DoorPstnL_pct "" FLOAT32_IEEE POD_HallHandleModule_TZCU_CM_single 0 0 -3.4e+38 3.4e+38 ECU_ADDRESS 0xB0055BF8 /end MEASUREMENT
/begin MEASUREMENT monr_VfHHM_HallFixedTiOffsetRHHM_NULL "" FLOAT32_IEEE POD_HallHandleModule_TZCU_CM_single 0 0 -3.4e+38 3.4e+38 ECU_ADDRESS 0xB0055C04 /end MEASUREMENT
/begin MEASUREMENT monr_VfHHM_HallSpeedDirectionRHHM_NULL "" FLOAT32_IEEE POD_HallHandleModule_TZCU_CM_single 0 0 -3.4e+38 3.4e+38 ECU_ADDRESS 0xB0055C0C /end MEASUREMENT
/begin MEASUREMENT monr_VfHHM_MaxOpenPositionL_deg "" FLOAT32_IEEE POD_HallHandleModule_TZCU_CM_single 0 0 -3.4e+38 3.4e+38 ECU_ADDRESS 0xB0055C10 /end MEASUREMENT
/begin MEASUREMENT monr_VfMCM_BrakingTorqueL_NULL "" FLOAT32_IEEE POD_MCML_CM_single 0 0 -3.4e+38 3.4e+38 ECU_ADDRESS 0xB0055D94 /end MEASUREMENT
/begin MEASUREMENT monr_VfMCM_BrakingTorqueR_NULL "" FLOAT32_IEEE POD_MCMR_CM_single 0 0 -3.4e+38 3.4e+38 ECU_ADDRESS 0xB0055E1C /end MEASUREMENT
/begin MEASUREMENT monr_VfMCM_GravityTorqueL_Nm "" FLOAT32_IEEE POD_MCML_CM_single 0 0 -3.4e+38 3.4e+38 ECU_ADDRESS 0xB0055D24 /end MEASUREMENT
/begin MEASUREMENT monr_VfMCM_GravityTorqueR_Nm "" FLOAT32_IEEE POD_MCMR_CM_single 0 0 -3.4e+38 3.4e+38 ECU_ADDRESS 0xB0055DA8 /end MEASUREMENT
/begin MEASUREMENT monr_VfMCM_MotorCtrlDutyL_NULL "" FLOAT32_IEEE POD_MCML_CM_single 0 0 -3.4e+38 3.4e+38 ECU_ADDRESS 0xB0055D18 /end MEASUREMENT
/begin MEASUREMENT monr_VfMCM_MotorCtrlDutyR_NULL "" FLOAT32_IEEE POD_MCMR_CM_single 0 0 -3.4e+38 3.4e+38 ECU_ADDRESS 0xB0055DA4 /end MEASUREMENT
/begin MEASUREMENT monr_VfMCM_RoadInclnL_deg "" FLOAT32_IEEE POD_MCML_CM_single 0 0 -3.4e+38 3.4e+38 ECU_ADDRESS 0xB0055D20 /end MEASUREMENT
/begin MEASUREMENT monr_VfMCM_RoadInclnR_deg "" FLOAT32_IEEE POD_MCMR_CM_single 0 0 -3.4e+38 3.4e+38 ECU_ADDRESS 0xB0055DC0 /end MEASUREMENT
/begin MEASUREMENT monr_VfMCM_SideIncinAgL_deg "" FLOAT32_IEEE POD_MCML_CM_single 0 0 -3.4e+38 3.4e+38 ECU_ADDRESS 0xB0055D2C /end MEASUREMENT
/begin MEASUREMENT monr_VfMCM_SideIncinAgR_deg "" FLOAT32_IEEE POD_MCMR_CM_single 0 0 -3.4e+38 3.4e+38 ECU_ADDRESS 0xB0055DB8 /end MEASUREMENT
/begin MEASUREMENT monr_VfMCM_TarPosL_NULL "" FLOAT32_IEEE POD_MCML_CM_single 0 0 -3.4e+38 3.4e+38 ECU_ADDRESS 0xB0055DA0 /end MEASUREMENT
/begin MEASUREMENT monr_VfMCM_TarPosR_NULL "" FLOAT32_IEEE POD_MCMR_CM_single 0 0 -3.4e+38 3.4e+38 ECU_ADDRESS 0xB0055E28 /end MEASUREMENT
/begin MEASUREMENT monr_VfMCM_TarSpdL_NULL "" FLOAT32_IEEE POD_MCML_CM_single 0 0 -3.4e+38 3.4e+38 ECU_ADDRESS 0xB0055D9C /end MEASUREMENT
/begin MEASUREMENT monr_VfMCM_TarSpdR_NULL "" FLOAT32_IEEE POD_MCMR_CM_single 0 0 -3.4e+38 3.4e+38 ECU_ADDRESS 0xB0055DB0 /end MEASUREMENT
/begin MEASUREMENT monr_VfMCM_ldlToAntipinchL_MA "" FLOAT32_IEEE POD_MCML_CM_single 0 0 -3.4e+38 3.4e+38 ECU_ADDRESS 0xB0055D8C /end MEASUREMENT
/begin MEASUREMENT monr_VfMCM_ldlToAntipinchR_MA "" FLOAT32_IEEE POD_MCMR_CM_single 0 0 -3.4e+38 3.4e+38 ECU_ADDRESS 0xB0055E00 /end MEASUREMENT
/begin MEASUREMENT monr_VfSHM_AmbTemp_C "" FLOAT32_IEEE POD_SignalHandModule_T_CM_single 0 0 -3.4e+38 3.4e+38 ECU_ADDRESS 0xB0055F6C /end MEASUREMENT
/begin MEASUREMENT monr_VfSHM_BatVoltageValue_MV "" FLOAT32_IEEE POD_SignalHandModule_T_CM_single 0 0 -3.4e+38 3.4e+38 ECU_ADDRESS 0xB0055F70 /end MEASUREMENT
/begin MEASUREMENT monr_VfSHM_FLGYROAgSpd_degps "" FLOAT32_IEEE POD_SignalHandModule_T_CM_single 0 0 -3.4e+38 3.4e+38 ECU_ADDRESS 0xB0055F84 /end MEASUREMENT
/begin MEASUREMENT monr_VfSHM_FRGYROAgSpd_degps "" FLOAT32_IEEE POD_SignalHandModule_T_CM_single 0 0 -3.4e+38 3.4e+38 ECU_ADDRESS 0xB0055F88 /end MEASUREMENT
/begin MEASUREMENT monr_VfSHM_FrntIncinAgR_deg "" FLOAT32_IEEE POD_SignalHandModule_T_CM_single 0 0 -3.4e+38 3.4e+38 ECU_ADDRESS 0xB0055F90 /end MEASUREMENT
/begin MEASUREMENT monr_VfSHM_MainMotoCurrentL_MA "" FLOAT32_IEEE POD_SignalHandModule_T_CM_single 0 0 -3.4e+38 3.4e+38 ECU_ADDRESS 0xB0055F94 /end MEASUREMENT
/begin MEASUREMENT monr_VfSHM_MainMotoCurrentR_MA "" FLOAT32_IEEE POD_SignalHandModule_T_CM_single 0 0 -3.4e+38 3.4e+38 ECU_ADDRESS 0xB0055F98 /end MEASUREMENT
/begin MEASUREMENT monr_VfSHM_SideIncinAgR_deg "" FLOAT32_IEEE POD_SignalHandModule_T_CM_single 0 0 -3.4e+38 3.4e+38 ECU_ADDRESS 0xB0055FB0 /end MEASUREMENT
/begin MEASUREMENT monr_VfSHM_VehLVBatt_V "" FLOAT32_IEEE POD_SignalHandModule_T_CM_single 0 0 -3.4e+38 3.4e+38 ECU_ADDRESS 0xB0055FB4 /end MEASUREMENT
/begin MEASUREMENT monr_VsHHM_AntiPinchHallPositionR_NULL "" SWORD POD_HallHandleModule_TZCU_CM_int16 0 0 -32768 32767 ECU_ADDRESS 0xB0055C3A /end MEASUREMENT
/begin MEASUREMENT monr_VsHHM_AswHallAccR_g "" SWORD POD_HallHandleModule_TZCU_CM_int16 0 0 -32768 32767 ECU_ADDRESS 0xB0055C3E /end MEASUREMENT
/begin MEASUREMENT monr_VsHHM_AswHallPosSpeedRHHM_rpm "" SWORD POD_HallHandleModule_TZCU_CM_int16 0 0 -32768 32767 ECU_ADDRESS 0xB0055C46 /end MEASUREMENT
/begin MEASUREMENT monr_VsHHM_AswHallPositionL_NULL "" SWORD POD_HallHandleModule_TZCU_CM_int16 0 0 -32768 32767 ECU_ADDRESS 0xB0055C40 /end MEASUREMENT
/begin MEASUREMENT monr_VsHHM_AswHallSpeedR_rpm "" SWORD POD_HallHandleModule_TZCU_CM_int16 0 0 -32768 32767 ECU_ADDRESS 0xB0055C4A /end MEASUREMENT
/begin MEASUREMENT monr_VsHHM_HallCntrL_NULL "" SWORD POD_HallHandleModule_TZCU_CM_int16 0 0 -32768 32767 ECU_ADDRESS 0xB0055C4C /end MEASUREMENT
/begin MEASUREMENT monr_VsHHM_HallPWMSpeedErrLHHM_rpm "" SWORD POD_HallHandleModule_TZCU_CM_int16 0 0 -32768 32767 ECU_ADDRESS 0xB0055C50 /end MEASUREMENT
/begin MEASUREMENT monr_VsHHM_OrigValueAntiPinchHallPositionRHHM_NULL "" SWORD POD_HallHandleModule_TZCU_CM_int16 0 0 -32768 32767 ECU_ADDRESS 0xB0055C56 /end MEASUREMENT
/begin MEASUREMENT monr_VsHHM_OrigValueHallPositionRHHM_NULL "" SWORD POD_HallHandleModule_TZCU_CM_int16 0 0 -32768 32767 ECU_ADDRESS 0xB0055C5A /end MEASUREMENT
/begin MEASUREMENT monr_VsMCM_TarCurrentL_NULL "" SWORD POD_MCML_CM_int16 0 0 -32768 32767 ECU_ADDRESS 0xB0055D1C /end MEASUREMENT
/begin MEASUREMENT monr_VsMCM_TarCurrentR_NULL "" SWORD POD_MCMR_CM_int16 0 0 -32768 32767 ECU_ADDRESS 0xB0055E2C /end MEASUREMENT
/begin MEASUREMENT monr_VsTTR_IMUAgSpdAccLTTR_g "" SWORD POD_TipToRun_CM_int16 0 0 -32768 32767 ECU_ADDRESS 0xB0056144 /end MEASUREMENT
/begin MEASUREMENT monr_VsTTR_IMUAgSpdAccRTTR_g "" SWORD POD_TipToRun_CM_int16 0 0 -32768 32767 ECU_ADDRESS 0xB0056146 /end MEASUREMENT
/begin MEASUREMENT monr_VsTTR_IMUAgSpdLTTR_degps "" SWORD POD_TipToRun_CM_int16 0 0 -32768 32767 ECU_ADDRESS 0xB0056148 /end MEASUREMENT
/begin MEASUREMENT monr_VsTTR_IMUAgSpdRTTR_degps "" SWORD POD_TipToRun_CM_int16 0 0 -32768 32767 ECU_ADDRESS 0xB005614A /end MEASUREMENT
/begin MEASUREMENT monr_VsTTR_PluseHoldPosLTTR_deg "" SWORD POD_TipToRun_CM_int16 0 0 -32768 32767 ECU_ADDRESS 0xB005614C /end MEASUREMENT
/begin MEASUREMENT monr_VuHallPWMHz_XL "" UWORD POD_HallHandleModule_TZCU_CM_uint16 0 0 0 65535 ECU_ADDRESS 0xB00561D6 /end MEASUREMENT
/begin MEASUREMENT monr_VuHallPWMHz_XR "" UWORD POD_HallHandleModule_TZCU_CM_uint16 0 0 0 65535 ECU_ADDRESS 0xB00561D8 /end MEASUREMENT
/begin MEASUREMENT monr_VuMBC_HoldDutyL_NULL "" UWORD POD_MBCL_CM_uint16 0 0 0 65535 ECU_ADDRESS 0xB00561C0 /end MEASUREMENT
/begin MEASUREMENT monr_VuMBC_HoldDutyR_NULL "" UWORD POD_MBCR_CM_uint16 0 0 0 65535 ECU_ADDRESS 0xB00561C8 /end MEASUREMENT
/begin MEASUREMENT monr_VuMBC_MotorCtrlBreakDutyL_NULL "" UWORD POD_MBCL_CM_uint16 0 0 0 65535 ECU_ADDRESS 0xB00561C2 /end MEASUREMENT
/begin MEASUREMENT monr_VuMBC_MotorCtrlBreakDutyR_NULL "" UWORD POD_MBCR_CM_uint16 0 0 0 65535 ECU_ADDRESS 0xB00561CA /end MEASUREMENT
/begin MEASUREMENT monr_VuMCM_MotorCtrlDuty1L_NULL "" UWORD POD_MCML_CM_uint16 0 0 0 65535 ECU_ADDRESS 0xB0055D3C /end MEASUREMENT
/begin MEASUREMENT monr_VuMCM_MotorCtrlDuty1R_NULL "" UWORD POD_MCMR_CM_uint16 0 0 0 65535 ECU_ADDRESS 0xB0055DCE /end MEASUREMENT
/begin MEASUREMENT monr_VuMCM_MotorCtrlDuty2L_NULL "" UWORD POD_MCML_CM_uint16 0 0 0 65535 ECU_ADDRESS 0xB0055D4E /end MEASUREMENT
/begin MEASUREMENT monr_VuMCM_MotorCtrlDuty2R_NULL "" UWORD POD_MCMR_CM_uint16 0 0 0 65535 ECU_ADDRESS 0xB0055DE0 /end MEASUREMENT
/begin GROUP S2_Cal_RDMLatch_FITIn "RDMLatch_FITIn/RDMLatch_FITIn_Main_sys/Cal_RDMLatch_FITIn"
 /begin REF_CHARACTERISTIC CalEn_FIN_RDLockCtrFbCur CalEn_FIN_RDoorLockPawlSw CalEn_FIN_RDoorLockResetSw CalEn_FIN_RDoorLockSecondSw CalEn_FIN_TrnkLatchCurrFb CalVal_FIN_RDLockCtrFbCur CalVal_FIN_RDoorLockPawlSw CalVal_FIN_RDoorLockResetSw CalVal_FIN_RDoorLockSecondSw CalVal_FIN_TrnkLatchCurrFb /end REF_CHARACTERISTIC
 /begin REF_MEASUREMENT Monr_FIN_RDLockCtrFbCur Monr_FIN_RDoorLockPawlSw Monr_FIN_RDoorLockResetSw Monr_FIN_RDoorLockSecondSw Monr_FIN_TrnkLatchCurrFb /end REF_MEASUREMENT
/end GROUP
/begin GROUP S2_FaultHandle "POD_FaultHandle/POD_FaultHandle/FaultHandle" /begin SUB_GROUP S3_AntiPlay S3_FMS S3_LVM /end SUB_GROUP /begin REF_MEASUREMENT monr_VbFH_VBattNrml_flg /end REF_MEASUREMENT /end GROUP
/begin GROUP S2_FITOutCS "RDM_FITOut/RDM_FITOut_Main_sys/FITOutCS"
 /begin REF_CHARACTERISTIC CalEn_FITOut_TgateBuzBepSts CalEn_FITOut_TrnkLLvrMtrCmd CalEn_FITOut_TrnkLLvrMtrPWM CalEn_FITOut_TrnkRLvrMtrCmd CalEn_FITOut_TrnkRLvrMtrPWM CalVal_FITOut_TgateBuzBepSts CalVal_FITOut_TrnkLLvrMtrCmd CalVal_FITOut_TrnkLLvrMtrPWM CalVal_FITOut_TrnkRLvrMtrCmd CalVal_FITOut_TrnkRLvrMtrPWM /end REF_CHARACTERISTIC
 /begin REF_MEASUREMENT Monr_FITOut_TrnkLLvrMtrCmd Monr_FITOut_TrnkLLvrMtrPWM Monr_FITOut_TrnkRLvrMtrCmd Monr_FITOut_TrnkRLvrMtrPWM /end REF_MEASUREMENT
/end GROUP
/begin GROUP S2_HallHandleModule "POD_HallHandleModule_TZCU/POD_HallHandleModule/HallHandleModule"
 /begin SUB_GROUP S3_HallDirection1 S3_HallDirection2 S3_HallHandleModuleL S3_HallHandleModuleR /end SUB_GROUP
 /begin REF_MEASUREMENT monr_EncoderGetCounter_XL monr_EncoderGetCounter_XR monr_EncoderGetDirection_XL monr_EncoderGetDirection_XR monr_VeHHM_SectorIndexL_enum monr_VeHHM_SectorIndexR_enum monr_VuHallPWMHz_XL monr_VuHallPWMHz_XR /end REF_MEASUREMENT
/end GROUP
/begin GROUP S2_POD_MotorBrakeCtrlL "POD_MBCL/POD_MotorBrakeCtrlL_Step_sys/POD_MotorBrakeCtrlL"
 /begin REF_MEASUREMENT monr_VbMBC_HoldIsCtrlL_flg monr_VeMBC_HoldMotorCtrlModeL_enum monr_VuMBC_HoldDutyL_NULL monr_VuMBC_MotorCtrlBreakDutyL_NULL /end REF_MEASUREMENT
/end GROUP
/begin GROUP S2_POD_MotorBrakeCtrlR "POD_MBCR/POD_MotorBrakeCtrlR_Step_sys/POD_MotorBrakeCtrlR"
 /begin REF_MEASUREMENT monr_VbMBC_HoldIsCtrlR_flg monr_VeMBC_HoldMotorCtrlModeR_enum monr_VuMBC_HoldDutyR_NULL monr_VuMBC_MotorCtrlBreakDutyR_NULL /end REF_MEASUREMENT
/end GROUP
/begin GROUP S2_POD_MotorCtrlModuleL "POD_MCML/POD_MotorCtrlModuleL_Step_sys/POD_MotorCtrlModuleL"
 /begin SUB_GROUP S3_Signal_Override S3_Signal_Override1 S3_Signal_Override2 S3_Signal_Override3 /end SUB_GROUP
 /begin REF_MEASUREMENT monr_VbMCM_ManualAssistL_flag monr_VbMCM_MotorBrkgL_flg monr_VbMCM_TipToRunL_flag monr_VeMCM_CmdStateL_NULL monr_VfMCM_BrakingTorqueL_NULL monr_VfMCM_GravityTorqueL_Nm monr_VfMCM_RoadInclnL_deg monr_VfMCM_SideIncinAgL_deg monr_VfMCM_TarPosL_NULL monr_VfMCM_TarSpdL_NULL monr_VfMCM_ldlToAntipinchL_MA monr_VsMCM_TarCurrentL_NULL /end REF_MEASUREMENT
/end GROUP
/begin GROUP S2_POD_MotorCtrlModuleR "POD_MCMR/POD_MotorCtrlModuleR_Step_sys/POD_MotorCtrlModuleR"
 /begin REF_MEASUREMENT monr_VbMCM_ManualAssistR_flag monr_VbMCM_MotorBrkgR_flg monr_VbMCM_TipToRunR_flag monr_VeMCM_CmdStateR_NULL monr_VeMCM_MotorCtrlModeR_enum monr_VfMCM_BrakingTorqueR_NULL monr_VfMCM_GravityTorqueR_Nm monr_VfMCM_MotorCtrlDutyR_NULL monr_VfMCM_RoadInclnR_deg monr_VfMCM_SideIncinAgR_deg monr_VfMCM_TarPosR_NULL monr_VfMCM_TarSpdR_NULL monr_VfMCM_ldlToAntipinchR_MA monr_VsMCM_TarCurrentR_NULL monr_VuMCM_MotorCtrlDuty1R_NULL monr_VuMCM_MotorCtrlDuty2R_NULL /end REF_MEASUREMENT
/end GROUP
/begin GROUP S2_SignalHandModule "POD_SignalHandModule_T/POD_SignalHandModule/SignalHandModule"
 /begin SUB_GROUP S3_ADCHandleModule S3_IMUSpeed S3_INP S3_LowVoltaBattery S3_MotorCtrl S3_VehSpd /end SUB_GROUP
 /begin REF_MEASUREMENT monr_VeSHM_TopPercXLHmiFeedBack_pct monr_VeSHM_TopPercXRHmiFeedBack_pct monr_VeSHM_XLReq_enum monr_VeSHM_XRReq_enum /end REF_MEASUREMENT
/end GROUP
/begin GROUP S2_Subsystem "POD_FITOut/RDM_FITOut_Main_sys/Subsystem"
 /begin REF_CHARACTERISTIC CalEn_VeSHM_MotorCtrlModeL CalEn_VeSHM_MotorCtrlModeR CalEn_VuSHM_MotorCtrlDutyL1 CalEn_VuSHM_MotorCtrlDutyL2 CalEn_VuSHM_MotorCtrlDutyR1 CalEn_VuSHM_MotorCtrlDutyR2 CalVal_VeSHM_MotorCtrlModeL CalVal_VeSHM_MotorCtrlModeR CalVal_VuSHM_MotorCtrlDutyL1 CalVal_VuSHM_MotorCtrlDutyL2 CalVal_VuSHM_MotorCtrlDutyR1 CalVal_VuSHM_MotorCtrlDutyR2 /end REF_CHARACTERISTIC
 /begin REF_MEASUREMENT Monr_FITOut_VeSHM_MotorCtrlModeL Monr_FITOut_VeSHM_MotorCtrlModeR Monr_FITOut_VuSHM_MotorCtrlDutyL1 Monr_FITOut_VuSHM_MotorCtrlDutyL2 Monr_FITOut_VuSHM_MotorCtrlDutyR1 Monr_FITOut_VuSHM_MotorCtrlDutyR2 /end REF_MEASUREMENT
/end GROUP
/begin GROUP S2_TipToRun "POD_TipToRun/POD_TipToRun/TipToRun" /begin SUB_GROUP S3_TipToRunL S3_TipToRunR /end SUB_GROUP /begin REF_MEASUREMENT monr_VeTTR_ManAsstRqstL_enum monr_VeTTR_ManAsstRqstR_enum /end REF_MEASUREMENT /end GROUP
/begin GROUP S2_TZCUBody_DTC_Main_sys "TZCUbody_DTC/TZCUbody_DTC_Main_sys/TZCUBody_DTC_Main_sys"
 /begin REF_CHARACTERISTIC CalEn_DTC_0x97102A CalEn_DTC_0x971031 CalEn_DTC_0x971032 CalEn_DTC_0x971033 CalEn_DTC_0x971034 CalEn_DTC_0x97C555 /end REF_CHARACTERISTIC
/end GROUP
/begin GROUP S30_Subsystem "RDM_AntiPinch/RDM_AntiPinch_Main_sys/Subsystem3/Subsystem"
 /begin REF_CHARACTERISTIC CalC_TrnkClsAdpCurrNmMvAddPat_HT CalC_TrnkClsAdpCurrNmMvAddPat_LT CalC_TrnkClsAdpCurrNmMvAddPat_NT CalC_TrnkClsAdpCurrSlwStpSubPat_HT CalC_TrnkClsAdpCurrSlwStpSubPat_LT CalC_TrnkClsAdpCurrSlwStpSubPat_NT Cal_SlopeCurPatch Cal_SlopePatch /end REF_CHARACTERISTIC
/end GROUP
/begin GROUP S331_ASWHallInit "POD_HallHandleModule_TZCU/POD_HallHandleModule/HallHandleModule/HallHandleModuleR/HallCntrHandle/HallPosition/ASWHallInit" /begin SUB_GROUP S333_Rising_Debounce S333_Timer_Debounce /end SUB_GROUP /begin REF_MEASUREMENT monr_VbHHM_ASWBSWHallInitR_flg /end REF_MEASUREMENT /end GROUP
/begin GROUP S331_DrvHallNum "POD_HallHandleModule_TZCU/POD_HallHandleModule/HallHandleModule/HallHandleModuleR/HallCntrHandle/HallPosition/DrvHallNum"
 /begin REF_MEASUREMENT monr_VsHHM_AntiPinchHallPositionR_NULL monr_VsHHM_OrigValueAntiPinchHallPositionRHHM_NULL monr_VsHHM_OrigValueHallPositionRHHM_NULL /end REF_MEASUREMENT
/end GROUP
/begin GROUP S331_HallInitialization "POD_HallHandleModule_TZCU/POD_HallHandleModule/HallHandleModule/HallHandleModuleR/HallCntrHandle/HallPosition/HallInitialization" /begin SUB_GROUP S335_ErrInitVerify S335_LckState /end SUB_GROUP
 /begin REF_MEASUREMENT monr_VbHHM_DoorAbsPstnInitRHHM_flg monr_VbHHM_DoorOpenRHHM_flg monr_VbHHM_DoorPstnInitRHHM_flg monr_VbHHM_DoorRelPstnInitRHHM_flg monr_VbHHM_NVMHallEnableRHHM_flg /end REF_MEASUREMENT
/end GROUP
/begin GROUP S332_DirectionJudge "POD_HallHandleModule_TZCU/POD_HallHandleModule/HallHandleModule/HallHandleModuleR/HallCntrHandle/HallSpeed/DirectionJudge" /begin REF_MEASUREMENT monr_VfHHM_HallSpeedDirectionRHHM_NULL /end REF_MEASUREMENT /end GROUP
/begin GROUP S332_HallFixedTiOffset "POD_HallHandleModule_TZCU/POD_HallHandleModule/HallHandleModule/HallHandleModuleR/HallCntrHandle/HallSpeed/HallFixedTiOffset" /begin SUB_GROUP S366_Rising_Debounce1 /end SUB_GROUP /begin REF_MEASUREMENT monr_VfHHM_HallFixedTiOffsetRHHM_NULL /end REF_MEASUREMENT /end GROUP
/begin GROUP S332_HallSpeedJudge "POD_HallHandleModule_TZCU/POD_HallHandleModule/HallHandleModule/HallHandleModuleR/HallCntrHandle/HallSpeed/HallSpeedJudge"
 /begin REF_MEASUREMENT monr_VsHHM_AswHallAccR_g monr_VsHHM_AswHallPosSpeedRHHM_rpm monr_VsHHM_AswHallSpeedR_rpm /end REF_MEASUREMENT
/end GROUP
/begin GROUP S335_ErrInitVerify "POD_HallHandleModule_TZCU/POD_HallHandleModule/HallHandleModule/HallHandleModuleR/HallCntrHandle/HallPosition/HallInitialization/ErrInitVerify" /begin REF_MEASUREMENT monr_VbHHM_HallErrRHHM_flg monr_VbHHM_InitErrorRHHM_flg /end REF_MEASUREMENT /end GROUP
/begin GROUP S335_LckState "POD_HallHandleModule_TZCU/POD_HallHandleModule/HallHandleModule/HallHandleModuleR/HallCntrHandle/HallPosition/HallInitialization/LckState" /begin SUB_GROUP S351_Rising_Debounce1 S351_RS /end SUB_GROUP /end GROUP
/begin GROUP S351_RS "POD_HallHandleModule_TZCU/POD_HallHandleModule/HallHandleModule/HallHandleModuleR/HallCntrHandle/HallPosition/HallInitialization/LckState/RS" /begin SUB_GROUP S354_Switch1 /end SUB_GROUP /end GROUP
/begin GROUP S354_Switch1 "POD_HallHandleModule_TZCU/POD_HallHandleModule/HallHandleModule/HallHandleModuleR/HallCntrHandle/HallPosition/HallInitialization/LckState/RS/Switch1" /begin REF_MEASUREMENT monr_VbHHM_Lck2DrStsErrRHHM_flg /end REF_MEASUREMENT /end GROUP
/begin GROUP S377_Rising_Debounce1 "POD_HallHandleModule_TZCU/POD_HallHandleModule/HallHandleModule/HallHandleModuleR/HallErrorProcess/HallJudgeCondition/Rising Debounce1" /begin REF_MEASUREMENT monr_VbHHM_HallErrSpeedRHHM_flg /end REF_MEASUREMENT /end GROUP
/begin GROUP S378_RS "POD_HallHandleModule_TZCU/POD_HallHandleModule/HallHandleModule/HallHandleModuleR/HallErrorProcess/SenorErr/RS" /begin SUB_GROUP S434_Switch1 /end SUB_GROUP /end GROUP
/begin GROUP S379_MovReset "POD_HallHandleModule_TZCU/POD_HallHandleModule/HallHandleModule/HallHandleModuleR/HallErrorProcess/SenorErr_Reset/MovReset" /begin SUB_GROUP S441_Rising_Debounce1 /end SUB_GROUP /end GROUP
/begin GROUP S38_DetLvrHallErr "RDM_HallDeco/RDM_HallDeco_Main_sys/DetLvrHallErr/DetLvrHallErr"
 /begin REF_CHARACTERISTIC CalC_TrnkHallOffsetErrExitMinHallTol CalC_TrnkHallOffsetErrMaxHallTol CalC_TrnkHallSnsrLostDetTm_ms CalC_TrnkSingleMvHallOffsetMaxTol /end REF_CHARACTERISTIC
/end GROUP
/begin GROUP S39_1stOrderFilter4 "POD_SignalHandModule_T/POD_SignalHandModule/SignalHandModule/INP/INPR/ADCHandleModule/1stOrderFilter4" /begin REF_MEASUREMENT monr_VfSHM_MainMotoCurrentR_MA /end REF_MEASUREMENT /end GROUP
/begin GROUP S39_RFAP "RDM_AntiPinch/RDM_AntiPinch_Main_sys/AntiPinchMainAlgo1/MainAlgorithm/RFAP" /begin REF_CHARACTERISTIC CalC_TrnkClsRFCurStepThr /end REF_CHARACTERISTIC /end GROUP
/begin GROUP S3_ADCHandleModule "POD_SignalHandModule_T/POD_SignalHandModule/SignalHandModule/ADCHandleModule" /begin SUB_GROUP S4_1stOrderFilter1 S4_1stOrderFilter2 S4_1stOrderFilter4 /end SUB_GROUP /begin REF_CHARACTERISTIC k_ADCH_Fac_FilterForAmbTemp k_ADCH_Fac_FilterForUBRVolt /end REF_CHARACTERISTIC /end GROUP
/begin GROUP S3_AntiPinchHallBlockDivide "RDM_GetTrunkPos/RDM_GetTrunkPos_Main_sys/AntiPinchHallBlockDivide" /begin SUB_GROUP S4_DetStartUp S4_DivideBlock /end SUB_GROUP /end GROUP
/begin GROUP S3_AntiPinchL "POD_AntiPinch/POD_AntiPinch/AntiPinch/AntiPinchL"
 /begin SUB_GROUP S4_AntiPinch_Detection S4_AntiPinchCurOffset S4_AntiPinchTrig S4_BaseBatVoltage S4_BaseMainMotoCurrent S4_ErrPosition S4_MotoCurrentOrBatVoltageDiff S4_Tip2RunAntiPinch /end SUB_GROUP
/end GROUP
/begin GROUP S3_AntiPinchMainAlgo1 "RDM_AntiPinch/RDM_AntiPinch_Main_sys/AntiPinchMainAlgo1" /begin SUB_GROUP S4_EnableAntiPinch S4_MainAlgorithm /end SUB_GROUP
 /begin REF_CHARACTERISTIC CalC_TrnkClsAntiPinchEnableEndPos CalC_TrnkClsAntiPinchEnableStartPos CalC_TrnkClsFallBackAPCfgEnable CalC_TrnkClsFallBackAPMtrSpdThr CalC_TrnkClsFallBackAPTmThr CalC_TrnkFallBackAPCurrThresh /end REF_CHARACTERISTIC
/end GROUP
/begin GROUP S3_AntiPinchMainAlgo4 "RDM_AntiPinch/RDM_AntiPinch_Main_sys/AntiPinchMainAlgo4" /begin SUB_GROUP S5_EnableAntiPinch S5_MainAlgorithm /end SUB_GROUP
 /begin REF_CHARACTERISTIC CalC_TrnkFallBackAPCurrThresh CalC_TrnkOpenAntiPinchEnableStartPos CalC_TrnkOpnAPMinCurrThr CalC_TrnkOpnFallBackAPCfgEnable CalC_TrnkOpnFallBackAPMtrSpdThr CalC_TrnkOpnFallBackAPTmThr /end REF_CHARACTERISTIC
/end GROUP
/begin GROUP S3_AntiPinchR "POD_AntiPinch/POD_AntiPinch/AntiPinch/AntiPinchR"
 /begin SUB_GROUP S5_AntiPinch_Detection S5_AntiPinchCurOffset S5_AntiPinchTrig S5_BaseBatVoltage S5_BaseMainMotoCurrent S5_ErrPosition S5_MotoCurrentOrBatVoltageDiff S5_Tip2RunAntiPinch /end SUB_GROUP
/end GROUP
/begin GROUP S3_AntiPinchThresh "RDM_AntiPinch/RDM_AntiPinch_Main_sys/AntiPinchThresh" /begin SUB_GROUP S6_ThreshPatch /end SUB_GROUP /end GROUP
/begin GROUP S3_AntiPlay "POD_FaultHandle/POD_FaultHandle/FaultHandle/AntiPlay" /begin SUB_GROUP S4_AntiPlayL S4_AntiPlayR /end SUB_GROUP /end GROUP
/begin GROUP S3_DetAutoInitExctCond "RDM_DetTrunkMoveReq/RDM_DetTrunkMoveReq_Main_sys/DetAutoInitExctCond" /begin REF_CHARACTERISTIC CalC_TrnkClsVldMinHallPos /end REF_CHARACTERISTIC /end GROUP
/begin GROUP S3_DetClsTraceAPTol "RDM_AntiPinch/RDM_AntiPinch_Main_sys/DetClsTraceAPTol"
 /begin REF_CHARACTERISTIC CalC_TrnkOpnPauseStopTraceAPEnTol CalC_TrnkOpnSlowStopTraceAPEnTol /end REF_CHARACTERISTIC
/end GROUP
/begin GROUP S3_DetInitMode "RDM_GetTrunkPos/RDM_GetTrunkPos_Main_sys/DetInitMode" /begin SUB_GROUP S7_DetQuitInitSrc /end SUB_GROUP /end GROUP
/begin GROUP S3_DetOpnAPThresh "RDM_AntiPinch/RDM_AntiPinch_Main_sys/DetOpnAPThresh"
 /begin REF_CHARACTERISTIC CalC_TrnkManualAssistThreshPatch CalC_TrnkOpnTraceAPMtrSpdThr /end REF_CHARACTERISTIC
/end GROUP
/begin GROUP S3_DetOpnStartStepTgtSpd "RDM_DetTrunkMoveReq/RDM_DetTrunkMoveReq_Main_sys/DetOpnStartStepTgtSpd" /begin REF_CHARACTERISTIC CalC_TrnkOpnMtrStartStepPos CalC_TrnkOpnMtrStartStepTgtSpd /end REF_CHARACTERISTIC /end GROUP
/begin GROUP S3_DetPWMRqst "RDM_DetTrunkMoveReq/RDM_DetTrunkMoveReq_Main_sys/DetPWMRqst" /begin SUB_GROUP S19_DetClsPWMLim S19_DetOpnStartStepTgtSpd /end SUB_GROUP
 /begin REF_CHARACTERISTIC CalC_TrnkClsSpdCtrKd CalC_TrnkClsSpdCtrKi CalC_TrnkClsSpdCtrKp /end REF_CHARACTERISTIC
/end GROUP
/begin GROUP S3_DetStallStopCond "RDM_CtrlLeverMtr/RDM_CtrlLeverMtr_Main_sys/DetStallStopCond" /begin SUB_GROUP S7_DualLeverStallStop /end SUB_GROUP /end GROUP
/begin GROUP S3_DetTraceAPTol "RDM_AntiPinch/RDM_AntiPinch_Main_sys/DetTraceAPTol"
 /begin REF_CHARACTERISTIC CalC_TrnkOpnPauseStopTraceAPEnTol CalC_TrnkOpnSlowStopTraceAPEnTol /end REF_CHARACTERISTIC
/end GROUP
/begin GROUP S3_DivideTrunkZone "RDM_GetTrunkPos/RDM_GetTrunkPos_Main_sys/DivideTrunkZone" /begin SUB_GROUP S8_DetPct S8_DetPosZone /end SUB_GROUP /end GROUP
/begin GROUP S3_Enabled_Subsystem2 "RDM_LearnRF/RDM_LearnRF_Main_sys/Enabled Subsystem2" /begin REF_CHARACTERISTIC Cal_CurAvgMax_mA Cal_CurAvgMin_mA /end REF_CHARACTERISTIC /end GROUP
/begin GROUP S3_FMS "POD_FaultHandle/POD_FaultHandle/FaultHandle/FMS" /begin SUB_GROUP S5_FMSL S5_FMSR /end SUB_GROUP /end GROUP
/begin GROUP S3_For_Each_Subsystem "RDM_AntiPinch/RDM_AntiPinch_Main_sys/For Each Subsystem" ROOT /begin REF_CHARACTERISTIC CalC_TrnkMvAbnMtrSpdRiseTol CalC_TrnkMvAbnPWMThr /end REF_CHARACTERISTIC /end GROUP
/begin GROUP S3_For_Each_Subsystem "RDM_CtrlLeverMtr/RDM_CtrlLeverMtr_Main_sys/For Each Subsystem" ROOT /begin SUB_GROUP S8_Subsystem /end SUB_GROUP /end GROUP
/begin GROUP S3_For_Each_Subsystem "RDM_DetLeverMtrStallSt/RDM_DetLeverMtrStallSt_Main_sys/For Each Subsystem" ROOT /begin SUB_GROUP S9_Subsystem /end SUB_GROUP /end GROUP
/begin GROUP S3_For_Each_Subsystem "RDM_SetSwSt/RDM_SetSwSt_Main_sys/For Each Subsystem" ROOT /begin REF_CHARACTERISTIC CalC_TrnkSwAdhesTm_sec CalC_TrnkSwLongPrsdTm_msec /end REF_CHARACTERISTIC /end GROUP
/begin GROUP S3_HallDirection1 "POD_HallHandleModule_TZCU/POD_HallHandleModule/HallHandleModule/HallDirection1"
 /begin REF_CHARACTERISTIC KfINP_HallDirBckwrdCdn_s KfINP_HallDirFrwrdCdn_s KfINP_HallDirStopCdn_s /end REF_CHARACTERISTIC
/end GROUP
/begin GROUP S3_HallDirection2 "POD_HallHandleModule_TZCU/POD_HallHandleModule/HallHandleModule/HallDirection2"
 /begin REF_CHARACTERISTIC KfINP_HallDirBckwrdCdn_s KfINP_HallDirFrwrdCdn_s KfINP_HallDirStopCdn_s /end REF_CHARACTERISTIC
/end GROUP
/begin GROUP S3_HallHandleModuleL "POD_HallHandleModule_TZCU/POD_HallHandleModule/HallHandleModule/HallHandleModuleL"
 /begin SUB_GROUP S7_AngleConversion S7_DoorMovSts S7_HallCntrHandle S7_HallErrorProcess /end SUB_GROUP
/end GROUP
/begin GROUP S3_HallHandleModuleR "POD_HallHandleModule_TZCU/POD_HallHandleModule/HallHandleModule/HallHandleModuleR"
 /begin SUB_GROUP S8_AngleConversion S8_DoorMovSts S8_HallCntrHandle S8_HallErrorProcess /end SUB_GROUP
/end GROUP
/begin GROUP S3_IMUSpeed "POD_SignalHandModule_T/POD_SignalHandModule/SignalHandModule/IMUSpeed" /begin REF_MEASUREMENT monr_VfSHM_FLGYROAgSpd_degps monr_VfSHM_FRGYROAgSpd_degps /end REF_MEASUREMENT /end GROUP
/begin GROUP S3_INP "POD_SignalHandModule_T/POD_SignalHandModule/SignalHandModule/INP" /begin SUB_GROUP S10_INPL S10_INPR /end SUB_GROUP
 /begin REF_MEASUREMENT monr_VeSHM_DoorOpenArlmL_enum monr_VeSHM_DoorOpenArlmR_enum monr_VeSHM_FrntIncinAgQlyL_enum monr_VeSHM_FrntIncinAgQlyR_enum monr_VeSHM_SideIncinAgQlyL_enum monr_VeSHM_SideIncinAgQlyR_enum /end REF_MEASUREMENT
/end GROUP
/begin GROUP S3_LearnPos "RDM_GetTrunkPos/RDM_GetTrunkPos_Main_sys/LearnPos" /begin SUB_GROUP S9_DetLvrPos S9_DetSftStpOpnHallPos /end SUB_GROUP
 /begin REF_CHARACTERISTIC CalEn_Debug_TrnkCurHallPos CalEn_Debug_TrnkInitSt CalVal_Debug_TrnkCurHallPos CalVal_Debug_TrnkInitSt /end REF_CHARACTERISTIC
/end GROUP
/begin GROUP S3_LowVoltaBattery "POD_SignalHandModule_T/POD_SignalHandModule/SignalHandModule/LowVoltaBattery" /begin REF_MEASUREMENT monr_VfSHM_VehLVBatt_V /end REF_MEASUREMENT /end GROUP
/begin GROUP S3_LVM "POD_FaultHandle/POD_FaultHandle/FaultHandle/LVM" /begin SUB_GROUP S6_LVML S6_LVMR /end SUB_GROUP /begin REF_MEASUREMENT monr_VeFH_DoorLckPstnL_enum /end REF_MEASUREMENT /end GROUP
/begin GROUP S3_MotorCtrl "POD_SignalHandModule_T/POD_SignalHandModule/SignalHandModule/MotorCtrl"
 /begin REF_MEASUREMENT monr_VeSHM_MotorCtrlModeL_enum monr_VeSHM_MotorCtrlModeR_enum /end REF_MEASUREMENT
/end GROUP
/begin GROUP S3_MotTimesProtect1 "RDMLatch_DetMotorStall/RDMLatch_DetMotorStall_Main_sys/MotTimesProtect1" /begin REF_CHARACTERISTIC CalC_ExitMotTimesPro_s /end REF_CHARACTERISTIC /end GROUP
/begin GROUP S3_RqstPreProcess "RDM_DetTrunkMoveReq/RDM_DetTrunkMoveReq_Main_sys/RqstPreProcess" /begin SUB_GROUP S28_DetManualPushTrig /end SUB_GROUP /begin REF_CHARACTERISTIC CalC_TrnkScanKeyPosTm_sec /end REF_CHARACTERISTIC /end GROUP
/begin GROUP S3_Signal_Override "POD_MCML/POD_MotorCtrlModuleL_Step_sys/POD_MotorCtrlModuleL/Signal_Override" /begin SUB_GROUP S4_Switch /end SUB_GROUP /begin REF_CHARACTERISTIC k_MCM_MotorCtrlModeL_flg k_MCM_MotorCtrlModeL_value /end REF_CHARACTERISTIC /end GROUP
/begin GROUP S3_Signal_Override1 "POD_MCML/POD_MotorCtrlModuleL_Step_sys/POD_MotorCtrlModuleL/Signal_Override1" /begin SUB_GROUP S5_Switch /end SUB_GROUP /begin REF_CHARACTERISTIC k_MCM_MotorCtrlDutyL_flg k_MCM_MotorCtrlDutyL_value /end REF_CHARACTERISTIC /end GROUP
/begin GROUP S3_Signal_Override2 "POD_MCML/POD_MotorCtrlModuleL_Step_sys/POD_MotorCtrlModuleL/Signal_Override2" /begin SUB_GROUP S6_Switch /end SUB_GROUP /begin REF_CHARACTERISTIC k_MCM_MotorCtrlDuty1L_flg k_MCM_MotorCtrlDuty1L_value /end REF_CHARACTERISTIC /end GROUP
/begin GROUP S3_Signal_Override3 "POD_MCML/POD_MotorCtrlModuleL_Step_sys/POD_MotorCtrlModuleL/Signal_Override3" /begin SUB_GROUP S7_Switch /end SUB_GROUP /begin REF_CHARACTERISTIC k_MCM_MotorCtrlDuty2L_flg k_MCM_MotorCtrlDuty2L_value /end REF_CHARACTERISTIC /end GROUP
/begin GROUP S3_Subsystem "RDM_DetThermProtSt/RDM_DetThermProtSt_Main_sys/Subsystem" ROOT
 /begin REF_CHARACTERISTIC CalC_TrnkThermProtCntAccumTmSlot_s CalC_TrnkThermProtCntThresh CalC_TrnkThermProtMdCntDecTmSlot_s /end REF_CHARACTERISTIC
/end GROUP
/begin GROUP S3_Subsystem "RDM_FITIn/RDM_FITIn_Main_sys/Cal_RDM_FITIn/Subsystem" ROOT /begin REF_MEASUREMENT Monr_FIN_TrnkRLvrCurrFB /end REF_MEASUREMENT /end GROUP
/begin GROUP S3_Subsystem1 "RDM_AntiPinch/RDM_AntiPinch_Main_sys/Subsystem1" ROOT
 /begin REF_CHARACTERISTIC CalC_TrnkClsExitRefSpdAPThrPat1 CalC_TrnkClsExitRefSpdAPThrPat2 CalC_TrnkClsPauseStopThreshPatch CalC_TrnkClsSlowStopThreshPatch /end REF_CHARACTERISTIC
/end GROUP
/begin GROUP S3_Subsystem1 "RDM_FITIn/RDM_FITIn_Main_sys/Cal_RDM_FITIn/Subsystem1" ROOT /begin REF_CHARACTERISTIC CalC_TrnkCurrFilterStartNum CalC_TrnkCurrFilterWinSize /end REF_CHARACTERISTIC /begin REF_MEASUREMENT Monr_FIN_TrnkLLvrCurrFB Monr_TrnkLLvrSortedCurrFBArr /end REF_MEASUREMENT /end GROUP
/begin GROUP S3_Subsystem2 "RDM_AntiPinch/RDM_AntiPinch_Main_sys/Subsystem2" /begin REF_CHARACTERISTIC CalC_TrnkOpenAntiPinchEnableEndPosOffset /end REF_CHARACTERISTIC /end GROUP
/begin GROUP S3_Subsystem3 "RDM_AntiPinch/RDM_AntiPinch_Main_sys/Subsystem3" /begin SUB_GROUP S30_Subsystem S30_Subsystem1 /end SUB_GROUP
 /begin REF_CHARACTERISTIC CalC_TrnkClsExitRefSpdCurrThrPat1 CalC_TrnkClsExitRefSpdCurrThrPat2 CalC_TrnkClsRefAPSoftRefSpdBias /end REF_CHARACTERISTIC
/end GROUP
/begin GROUP S3_TipToRunL "POD_TipToRun/POD_TipToRun/TipToRun/TipToRunL" /begin SUB_GROUP S4_IMU S4_ManAsstRqst S4_TipToRunRqst /end SUB_GROUP /end GROUP
/begin GROUP S3_TipToRunR "POD_TipToRun/POD_TipToRun/TipToRun/TipToRunR" /begin SUB_GROUP S5_IMU S5_ManAsstRqst S5_TipToRunRqst /end SUB_GROUP /end GROUP
/begin GROUP S3_VehSpd "POD_SignalHandModule_T/POD_SignalHandModule/SignalHandModule/VehSpd" /begin SUB_GROUP S15_Switch1 /end SUB_GROUP /begin REF_MEASUREMENT monr_VeSHM_VehSpdLgtQly_enum /end REF_MEASUREMENT /end GROUP
/begin GROUP S40_FrontInclineAngle "POD_SignalHandModule_T/POD_SignalHandModule/SignalHandModule/INP/INPR/CEM/FrontInclineAngle" /begin REF_MEASUREMENT monr_VfSHM_FrntIncinAgR_deg /end REF_MEASUREMENT /end GROUP
/begin GROUP S40_SideInclineAngle "POD_SignalHandModule_T/POD_SignalHandModule/SignalHandModule/INP/INPR/CEM/SideInclineAngle" /begin REF_MEASUREMENT monr_VfSHM_SideIncinAgR_deg /end REF_MEASUREMENT /end GROUP
/begin GROUP S434_Switch1 "POD_HallHandleModule_TZCU/POD_HallHandleModule/HallHandleModule/HallHandleModuleR/HallErrorProcess/SenorErr/RS/Switch1" /begin REF_MEASUREMENT monr_VbHHM_HallSigFltR_flg /end REF_MEASUREMENT /end GROUP
/begin GROUP S47_ADPPara "POD_FaultHandle/POD_FaultHandle/FaultHandle/AntiPlay/AntiPlayR/AntiplayStatus/ADPPara"
 /begin REF_CHARACTERISTIC k_ADP_Ti_TimeSpanActiveThreshold k_APD_Num_AntiPlayNumThreshold /end REF_CHARACTERISTIC
/end GROUP
/begin GROUP S47_AntiPlayState "POD_FaultHandle/POD_FaultHandle/FaultHandle/AntiPlay/AntiPlayR/AntiplayStatus/AntiPlayState" /begin SUB_GROUP S51_AntiPlayActiveCounter S51_Time_Holding_Boolean /end SUB_GROUP /begin REF_CHARACTERISTIC k_APD_Boolean_AntiPlayEnable /end REF_CHARACTERISTIC /end GROUP
/begin GROUP S47_Hall_Based_Motor_Speed_Calculator "RDM_HallDeco/RDM_HallDeco_Main_sys/Subsystem/Hall-Based Motor Speed Calculator" /begin REF_MEASUREMENT Monr_TrnkRLvrMtrSpd /end REF_MEASUREMENT /end GROUP
/begin GROUP S4_1stOrderFilter1 "POD_SignalHandModule_T/POD_SignalHandModule/SignalHandModule/ADCHandleModule/1stOrderFilter1" /begin REF_MEASUREMENT monr_VfSHM_BatVoltageValue_MV /end REF_MEASUREMENT /end GROUP
/begin GROUP S4_1stOrderFilter2 "POD_SignalHandModule_T/POD_SignalHandModule/SignalHandModule/ADCHandleModule/1stOrderFilter2" /begin REF_MEASUREMENT monr_VfSHM_AmbTemp_C /end REF_MEASUREMENT /end GROUP
/begin GROUP S4_1stOrderFilter4 "POD_SignalHandModule_T/POD_SignalHandModule/SignalHandModule/ADCHandleModule/1stOrderFilter4" /begin REF_MEASUREMENT monr_VfSHM_MainMotoCurrentL_MA /end REF_MEASUREMENT /end GROUP
/begin GROUP S4_AntiPinch_Detection "POD_AntiPinch/POD_AntiPinch/AntiPinch/AntiPinchL/AntiPinch_Detection"
 /begin SUB_GROUP S8_AntiPinchEvent S8_cnt S8_Signal_Override S8_Time_Holding_Boolean /end SUB_GROUP
 /begin REF_CHARACTERISTIC k_ADP_Boolean_APHDEnable k_ADP_Value_AllowRelPositionforAntiPinch /end REF_CHARACTERISTIC
/end GROUP
/begin GROUP S4_AntiPinchCurOffset "POD_AntiPinch/POD_AntiPinch/AntiPinch/AntiPinchL/AntiPinchCurOffset" /begin SUB_GROUP S6_CurrentCmp S6_ReferenceCurrent S6_SectorCompensation /end SUB_GROUP /begin REF_CHARACTERISTIC k_ADP_Value_CalCurrentLimitBasicAntiPinch /end REF_CHARACTERISTIC /begin REF_MEASUREMENT monr_VfAP_ValueTriggMotCurAddLAP_MA /end REF_MEASUREMENT /end GROUP
/begin GROUP S4_AntiPinchTrig "POD_AntiPinch/POD_AntiPinch/AntiPinch/AntiPinchL/AntiPinchTrig"
 /begin SUB_GROUP S7_AntiPinchConditions_Current S7_AntiPinchConditions_Speed /end SUB_GROUP
/end GROUP
/begin GROUP S4_AntiPlayL "POD_FaultHandle/POD_FaultHandle/FaultHandle/AntiPlay/AntiPlayL" /begin SUB_GROUP S7_AntiplayStatus /end SUB_GROUP /end GROUP
/begin GROUP S4_AntiPlayR "POD_FaultHandle/POD_FaultHandle/FaultHandle/AntiPlay/AntiPlayR" /begin SUB_GROUP S8_AntiplayStatus /end SUB_GROUP /end GROUP
/begin GROUP S4_BaseBatVoltage "POD_AntiPinch/POD_AntiPinch/AntiPinch/AntiPinchL/BaseBatVoltage" /begin REF_MEASUREMENT monr_VfAP_ValueBatVoltagetBaseLAP_MV /end REF_MEASUREMENT /end GROUP
/begin GROUP S4_BaseMainMotoCurrent "POD_AntiPinch/POD_AntiPinch/AntiPinch/AntiPinchL/BaseMainMotoCurrent" /begin REF_MEASUREMENT monr_VfAP_ValueMainMotoCurrentBaseLAP_MA /end REF_MEASUREMENT /end GROUP
/begin GROUP S4_DetStartUp "RDM_GetTrunkPos/RDM_GetTrunkPos_Main_sys/AntiPinchHallBlockDivide/DetStartUp" /begin REF_CHARACTERISTIC CalC_TrnkMtrClsStartUpDist /end REF_CHARACTERISTIC /end GROUP
/begin GROUP S4_DivideBlock "RDM_GetTrunkPos/RDM_GetTrunkPos_Main_sys/AntiPinchHallBlockDivide/DivideBlock" /begin REF_CHARACTERISTIC CalC_TrnkRFAPBlockIntv /end REF_CHARACTERISTIC /end GROUP
/begin GROUP S4_EnableAntiPinch "RDM_AntiPinch/RDM_AntiPinch_Main_sys/AntiPinchMainAlgo1/EnableAntiPinch" /begin REF_CHARACTERISTIC CalC_TrnkClsAntiPinchCfgEnable /end REF_CHARACTERISTIC /end GROUP
/begin GROUP S4_ErrPosition "POD_AntiPinch/POD_AntiPinch/AntiPinch/AntiPinchL/ErrPosition"
 /begin REF_CHARACTERISTIC k_ADP_Value_PIDPosRateforAntiPinch k_ADP_Value_ThresholdAdjast k_ADP_Value_ThresholdValueOfPosition /end REF_CHARACTERISTIC
 /begin REF_MEASUREMENT monr_ADP_ErrPosition_FlagLAP monr_ADP_PIDErrPosLAP monr_ADP_Value_ErrPositionLAP monr_ADP_Value_ErrPosition_DiffLAP /end REF_MEASUREMENT
/end GROUP
/begin GROUP S4_IMU "POD_TipToRun/POD_TipToRun/TipToRun/TipToRunL/IMU" /begin SUB_GROUP S6_Rising_Debounce S6_Rising_Debounce1 /end SUB_GROUP /begin REF_MEASUREMENT monr_VsTTR_IMUAgSpdAccLTTR_g monr_VsTTR_IMUAgSpdLTTR_degps /end REF_MEASUREMENT /end GROUP
/begin GROUP S4_MainAlgorithm "RDM_AntiPinch/RDM_AntiPinch_Main_sys/AntiPinchMainAlgo1/MainAlgorithm" /begin SUB_GROUP S39_RFAP /end SUB_GROUP /begin REF_CHARACTERISTIC CalC_TrnkClsRefAPCfgEnable CalC_TrnkClsTraceAPCfgEnable /end REF_CHARACTERISTIC /end GROUP
/begin GROUP S4_ManAsstRqst "POD_TipToRun/POD_TipToRun/TipToRun/TipToRunL/ManAsstRqst" /begin SUB_GROUP S7_ElecToAssist S7_ManualSpdBack S7_StopToAssist /end SUB_GROUP /end GROUP
/begin GROUP S4_MotoCurrentOrBatVoltageDiff "POD_AntiPinch/POD_AntiPinch/AntiPinch/AntiPinchL/MotoCurrentOrBatVoltageDiff"
 /begin REF_MEASUREMENT monr_ADP_Value_BatVoltaget_DiffLAP monr_ADP_Value_MainMotoCurrent_DiffLAP /end REF_MEASUREMENT
/end GROUP
/begin GROUP S4_Switch "POD_MCML/POD_MotorCtrlModuleL_Step_sys/POD_MotorCtrlModuleL/Signal_Override/Switch" /begin REF_MEASUREMENT monr_VeMCM_MotorCtrlModeL_enum /end REF_MEASUREMENT /end GROUP
/begin GROUP S4_Tip2RunAntiPinch "POD_AntiPinch/POD_AntiPinch/AntiPinch/AntiPinchL/Tip2RunAntiPinch" /begin SUB_GROUP S13_Time_Holding_Boolean /end SUB_GROUP /begin REF_CHARACTERISTIC k_ADP_Boolean_APHDEnable /end REF_CHARACTERISTIC /end GROUP
/begin GROUP S4_TipToRunRqst "POD_TipToRun/POD_TipToRun/TipToRun/TipToRunL/TipToRunRqst" /begin SUB_GROUP S8_ForR_Para /end SUB_GROUP /begin REF_MEASUREMENT monr_VbTTR_TipToRunRqstL_flg /end REF_MEASUREMENT /end GROUP
/begin GROUP S51_AntiPlayActiveCounter "POD_FaultHandle/POD_FaultHandle/FaultHandle/AntiPlay/AntiPlayR/AntiplayStatus/AntiPlayState/AntiPlayActiveCounter" /begin REF_MEASUREMENT monr_ADP_Value_AntiPlayActiveCounterR /end REF_MEASUREMENT /end GROUP
/begin GROUP S51_DoorHallPosition "POD_HallHandleModule_TZCU/POD_HallHandleModule/HallHandleModule/HallHandleModuleL/AngleConversion/DoorHallPosition"
 /begin REF_MEASUREMENT monr_VbHHM_DoorOpenL_flg monr_VsHHM_AswHallPositionL_NULL monr_VsHHM_HallCntrL_NULL /end REF_MEASUREMENT
/end GROUP
/begin GROUP S51_DoorOpenTargetPosition "POD_HallHandleModule_TZCU/POD_HallHandleModule/HallHandleModule/HallHandleModuleL/AngleConversion/DoorOpenTargetPosition" /begin SUB_GROUP S58_Rising_Debounce /end SUB_GROUP /begin REF_MEASUREMENT monr_VeHHM_UsrSetMaxPstnL_pct /end REF_MEASUREMENT /end GROUP
/begin GROUP S51_PercPosn2AndPosn2 "POD_HallHandleModule_TZCU/POD_HallHandleModule/HallHandleModule/HallHandleModuleL/AngleConversion/PercPosn2AndPosn2" /begin REF_MEASUREMENT monr_VfHHM_AswHallPositionL_deg monr_VfHHM_DoorPstnL_pct /end REF_MEASUREMENT /end GROUP
/begin GROUP S51_Time_Holding_Boolean "POD_FaultHandle/POD_FaultHandle/FaultHandle/AntiPlay/AntiPlayR/AntiplayStatus/AntiPlayState/Time Holding Boolean" /begin SUB_GROUP S65_Signal_Holding_Boolean S65_Timer_Debounce /end SUB_GROUP /end GROUP
/begin GROUP S51_TopDegforDoorOpen "POD_HallHandleModule_TZCU/POD_HallHandleModule/HallHandleModule/HallHandleModuleL/AngleConversion/TopDegforDoorOpen" /begin REF_MEASUREMENT monr_VfHHM_MaxOpenPositionL_deg /end REF_MEASUREMENT /end GROUP
/begin GROUP S53_DoorMovSts_Chart "POD_HallHandleModule_TZCU/POD_HallHandleModule/HallHandleModule/HallHandleModuleL/DoorMovSts/DoorMovSts_Chart" /begin REF_MEASUREMENT monr_VeHHM_DoorMovStsL_NULL /end REF_MEASUREMENT /end GROUP
/begin GROUP S53_ElecMov "POD_HallHandleModule_TZCU/POD_HallHandleModule/HallHandleModule/HallHandleModuleL/DoorMovSts/ElecMov"
 /begin REF_MEASUREMENT monr_VbHHM_BooleanDownLHHM_flg monr_VbHHM_BooleanUpLHHM_flg /end REF_MEASUREMENT
/end GROUP
/begin GROUP S53_Hold "POD_HallHandleModule_TZCU/POD_HallHandleModule/HallHandleModule/HallHandleModuleL/DoorMovSts/Hold"
 /begin SUB_GROUP S74_ClosingInLock S74_DoorStateErrorJudge S74_DooStop S74_ElecDoorStop S74_ManualDoorStop /end SUB_GROUP
 /begin REF_MEASUREMENT monr_VbHHM_BooleanHoldLHHM_flg /end REF_MEASUREMENT
/end GROUP
/begin GROUP S53_ManualMov "POD_HallHandleModule_TZCU/POD_HallHandleModule/HallHandleModule/HallHandleModuleL/DoorMovSts/ManualMov" /begin SUB_GROUP S76_ManualJudge S76_PerManualMovDoor /end SUB_GROUP /end GROUP
/begin GROUP S53_POD_GetSector "POD_HallHandleModule_TZCU/POD_HallHandleModule/HallHandleModule/HallHandleModuleL/DoorMovSts/POD_GetSector" /begin SUB_GROUP S77_SectorTopClose S77_SectorTopOpen /end SUB_GROUP /end GROUP
/begin GROUP S53_PreOpenOrClsd "POD_HallHandleModule_TZCU/POD_HallHandleModule/HallHandleModule/HallHandleModuleL/DoorMovSts/PreOpenOrClsd" /begin REF_MEASUREMENT monr_VbHHM_PreClsdLHHM_flg monr_VbHHM_PreOpenLHHM_flg /end REF_MEASUREMENT /end GROUP
/begin GROUP S54_HallPosition "POD_HallHandleModule_TZCU/POD_HallHandleModule/HallHandleModule/HallHandleModuleL/HallCntrHandle/HallPosition" /begin SUB_GROUP S132_ASWHallInit S132_DrvHallNum S132_HallInitialization /end SUB_GROUP /end GROUP
/begin GROUP S54_HallSpeed "POD_HallHandleModule_TZCU/POD_HallHandleModule/HallHandleModule/HallHandleModuleL/HallCntrHandle/HallSpeed"
 /begin SUB_GROUP S133_DirectionJudge S133_HallFixedTiOffset S133_HallSpeedJudge /end SUB_GROUP
/end GROUP
/begin GROUP S55_HALL_AFault "POD_HallHandleModule_TZCU/POD_HallHandleModule/HallHandleModule/HallHandleModuleL/HallErrorProcess/HALL_AFault"
 /begin SUB_GROUP S176_Rising_Debounce S176_Rising_Debounce1 S176_Rising_Debounce2 S176_Rising_Debounce3 /end SUB_GROUP
 /begin REF_MEASUREMENT monr_VbHHM_HALLAErrEnableLHHM_flg monr_VbHHM_HALLAFaultLHHM_flg /end REF_MEASUREMENT
/end GROUP
/begin GROUP S55_HALL_BFault "POD_HallHandleModule_TZCU/POD_HallHandleModule/HallHandleModule/HallHandleModuleL/HallErrorProcess/HALL_BFault"
 /begin SUB_GROUP S177_Falling_Debounce S177_Falling_Debounce1 S177_Rising_Debounce S177_Rising_Debounce1 S177_Rising_Debounce2 S177_Rising_Debounce3 S177_Rising_Debounce4 S177_Rising_Debounce5 S177_Rising_Debounce6 S177_Rising_Debounce7 /end SUB_GROUP
 /begin REF_MEASUREMENT monr_VbHHM_CloseTheDoorHallErrLHHM_flg monr_VbHHM_OnlyHallPWMErrLHHM_flg monr_VbHHM_OpenTheDoorHallErrLHHM_flg /end REF_MEASUREMENT
/end GROUP
/begin GROUP S55_HallJudgeCondition "POD_HallHandleModule_TZCU/POD_HallHandleModule/HallHandleModule/HallHandleModuleL/HallErrorProcess/HallJudgeCondition" /begin SUB_GROUP S178_Rising_Debounce S178_Rising_Debounce1 /end SUB_GROUP
 /begin REF_MEASUREMENT monr_VbHHM_HallErrEnableLHHM_flg monr_VsHHM_HallPWMSpeedErrLHHM_rpm /end REF_MEASUREMENT
/end GROUP
/begin GROUP S55_SenorErr "POD_HallHandleModule_TZCU/POD_HallHandleModule/HallHandleModule/HallHandleModuleL/HallErrorProcess/SenorErr" /begin SUB_GROUP S179_RS /end SUB_GROUP /end GROUP
/begin GROUP S55_SenorErr_Reset "POD_HallHandleModule_TZCU/POD_HallHandleModule/HallHandleModule/HallHandleModuleL/HallErrorProcess/SenorErr_Reset" /begin SUB_GROUP S180_cnt S180_MovReset S180_Rising_Debounce2 /end SUB_GROUP /end GROUP
/begin GROUP S5_AntiPinch_Detection "POD_AntiPinch/POD_AntiPinch/AntiPinch/AntiPinchR/AntiPinch_Detection"
 /begin SUB_GROUP S96_AntiPinchEvent S96_cnt S96_Signal_Override S96_Time_Holding_Boolean /end SUB_GROUP
 /begin REF_CHARACTERISTIC k_ADP_Boolean_APHDEnable k_ADP_Value_AllowRelPositionforAntiPinch /end REF_CHARACTERISTIC
/end GROUP
/begin GROUP S5_AntiPinchCurOffset "POD_AntiPinch/POD_AntiPinch/AntiPinch/AntiPinchR/AntiPinchCurOffset" /begin SUB_GROUP S94_CurrentCmp S94_ReferenceCurrent S94_SectorCompensation /end SUB_GROUP /begin REF_CHARACTERISTIC k_ADP_Value_CalCurrentLimitBasicAntiPinch /end REF_CHARACTERISTIC /begin REF_MEASUREMENT monr_VfAP_ValueTriggMotCurAddRAP_MA /end REF_MEASUREMENT /end GROUP
/begin GROUP S5_AntiPinchTrig "POD_AntiPinch/POD_AntiPinch/AntiPinch/AntiPinchR/AntiPinchTrig"
 /begin SUB_GROUP S95_AntiPinchConditions_Current S95_AntiPinchConditions_Speed /end SUB_GROUP
/end GROUP
/begin GROUP S5_BaseBatVoltage "POD_AntiPinch/POD_AntiPinch/AntiPinch/AntiPinchR/BaseBatVoltage" /begin REF_MEASUREMENT monr_VfAP_ValueBatVoltagetBaseRAP_MV /end REF_MEASUREMENT /end GROUP
/begin GROUP S5_BaseMainMotoCurrent "POD_AntiPinch/POD_AntiPinch/AntiPinch/AntiPinchR/BaseMainMotoCurrent" /begin REF_MEASUREMENT monr_VfAP_ValueMainMotoCurrentBaseRAP_MA /end REF_MEASUREMENT /end GROUP
/begin GROUP S5_DetLvrHallErr "RDM_HallDeco/RDM_HallDeco_Main_sys/DetLvrHallErr" /begin SUB_GROUP S38_DetLvrHallErr /end SUB_GROUP /end GROUP
/begin GROUP S5_EnableAntiPinch "RDM_AntiPinch/RDM_AntiPinch_Main_sys/AntiPinchMainAlgo4/EnableAntiPinch" /begin REF_CHARACTERISTIC CalC_TrnkOpnAntiPinchCfgEnable /end REF_CHARACTERISTIC /end GROUP
/begin GROUP S5_ErrPosition "POD_AntiPinch/POD_AntiPinch/AntiPinch/AntiPinchR/ErrPosition"
 /begin REF_CHARACTERISTIC k_ADP_Value_PIDPosRateforAntiPinch k_ADP_Value_ThresholdAdjast k_ADP_Value_ThresholdValueOfPosition /end REF_CHARACTERISTIC
 /begin REF_MEASUREMENT monr_ADP_ErrPosition_FlagRAP monr_ADP_PIDErrPosRAP monr_ADP_Value_ErrPositionRAP monr_ADP_Value_ErrPosition_DiffRAP /end REF_MEASUREMENT
/end GROUP
/begin GROUP S5_FMSL "POD_FaultHandle/POD_FaultHandle/FaultHandle/FMS/FMSL" /begin SUB_GROUP S83_ArrayProces1 S83_Event S83_Event1 S83_FIM /end SUB_GROUP
 /begin REF_MEASUREMENT monr_VbFH_HallSigErrL_flg monr_VbFMS_CAN0BusOffErrL_FMS_flg monr_VbFMS_CAN1BusOffErrL_FMS_flg monr_VbFMS_CemFr05TiOutL_FMS_flg monr_VbFMS_CemFr09TiOutL_FMS_flg monr_VbFMS_MCUOHLvl2ErrL_FMS_flg monr_VbFMS_SPIComErrL_FMS_flg /end REF_MEASUREMENT
/end GROUP
/begin GROUP S5_FMSR "POD_FaultHandle/POD_FaultHandle/FaultHandle/FMS/FMSR" /begin SUB_GROUP S84_ArrayProces1 S84_Event S84_Event1 S84_FIM /end SUB_GROUP
 /begin REF_MEASUREMENT monr_VbFH_HallSigErrR_flg monr_VbFMS_CAN0BusOffErrR_FMS_flg monr_VbFMS_CAN1BusOffErrR_FMS_flg monr_VbFMS_CemFr05TiOutR_FMS_flg monr_VbFMS_CemFr09TiOutR_FMS_flg monr_VbFMS_MCUOHLvl2ErrR_FMS_flg monr_VbFMS_SPIComErrR_FMS_flg /end REF_MEASUREMENT
/end GROUP
/begin GROUP S5_Hall_Based_Motor_Speed_Calculator "RDM_HallDeco/RDM_HallDeco_Main_sys/Hall-Based Motor Speed Calculator" /begin REF_MEASUREMENT Monr_TrnkLLvrMtrSpd /end REF_MEASUREMENT /end GROUP
/begin GROUP S5_IMU "POD_TipToRun/POD_TipToRun/TipToRun/TipToRunR/IMU" /begin SUB_GROUP S174_Rising_Debounce S174_Rising_Debounce1 /end SUB_GROUP /begin REF_MEASUREMENT monr_VsTTR_IMUAgSpdAccRTTR_g monr_VsTTR_IMUAgSpdRTTR_degps /end REF_MEASUREMENT /end GROUP
/begin GROUP S5_MainAlgorithm "RDM_AntiPinch/RDM_AntiPinch_Main_sys/AntiPinchMainAlgo4/MainAlgorithm" /begin REF_CHARACTERISTIC CalC_TrnkOpnRefAPCfgEnable CalC_TrnkOpnTraceAPCfgEnable /end REF_CHARACTERISTIC /end GROUP
/begin GROUP S5_ManAsstRqst "POD_TipToRun/POD_TipToRun/TipToRun/TipToRunR/ManAsstRqst" /begin SUB_GROUP S175_ElecToAssist S175_ManualSpdBack S175_StopToAssist /end SUB_GROUP /end GROUP
/begin GROUP S5_MotoCurrentOrBatVoltageDiff "POD_AntiPinch/POD_AntiPinch/AntiPinch/AntiPinchR/MotoCurrentOrBatVoltageDiff"
 /begin REF_MEASUREMENT monr_ADP_Value_BatVoltaget_DiffRAP monr_ADP_Value_MainMotoCurrent_DiffRAP /end REF_MEASUREMENT
/end GROUP
/begin GROUP S5_Subsystem "RDM_HallDeco/RDM_HallDeco_Main_sys/Subsystem" /begin SUB_GROUP S47_Hall_Based_Motor_Speed_Calculator /end SUB_GROUP /end GROUP
/begin GROUP S5_Switch "POD_MCML/POD_MotorCtrlModuleL_Step_sys/POD_MotorCtrlModuleL/Signal_Override1/Switch" /begin REF_MEASUREMENT monr_VfMCM_MotorCtrlDutyL_NULL /end REF_MEASUREMENT /end GROUP
/begin GROUP S5_Tip2RunAntiPinch "POD_AntiPinch/POD_AntiPinch/AntiPinch/AntiPinchR/Tip2RunAntiPinch" /begin SUB_GROUP S101_Time_Holding_Boolean /end SUB_GROUP /begin REF_CHARACTERISTIC k_ADP_Boolean_APHDEnable /end REF_CHARACTERISTIC /end GROUP
/begin GROUP S5_TipToRunRqst "POD_TipToRun/POD_TipToRun/TipToRun/TipToRunR/TipToRunRqst" /begin SUB_GROUP S176_ForR_Para /end SUB_GROUP /begin REF_MEASUREMENT monr_VbTTR_TipToRunRqstR_flg /end REF_MEASUREMENT /end GROUP
/begin GROUP S65_Signal_Holding_Boolean "POD_FaultHandle/POD_FaultHandle/FaultHandle/AntiPlay/AntiPlayR/AntiplayStatus/AntiPlayState/Time Holding Boolean/Signal Holding Boolean" /begin REF_MEASUREMENT monr_VbFH_AnptiplayR_flg /end REF_MEASUREMENT /end GROUP
/begin GROUP S69_Signal_Holding_Boolean "POD_AntiPinch/POD_AntiPinch/AntiPinch/AntiPinchL/AntiPinch_Detection/Time Holding Boolean/Signal Holding Boolean" /begin REF_MEASUREMENT monr_VbAP_AntiPinchStsDspL_flg /end REF_MEASUREMENT /end GROUP
/begin GROUP S6_CurrentCmp "POD_AntiPinch/POD_AntiPinch/AntiPinch/AntiPinchL/AntiPinchCurOffset/CurrentCmp" /begin SUB_GROUP S15_CloseDoor S15_OpenDoor /end SUB_GROUP /begin REF_MEASUREMENT monr_VfAP_ValueCurrentCmpLAP_MA /end REF_MEASUREMENT /end GROUP
/begin GROUP S6_LVML "POD_FaultHandle/POD_FaultHandle/FaultHandle/LVM/LVML" /begin SUB_GROUP S165_State /end SUB_GROUP /end GROUP
/begin GROUP S6_LVMR "POD_FaultHandle/POD_FaultHandle/FaultHandle/LVM/LVMR" /begin SUB_GROUP S166_LockState S166_State /end SUB_GROUP /end GROUP
/begin GROUP S6_ReferenceCurrent "POD_AntiPinch/POD_AntiPinch/AntiPinch/AntiPinchL/AntiPinchCurOffset/ReferenceCurrent"
 /begin SUB_GROUP S16_KeepReferenceCurrentFlag S16_ReferenceCurrent S16_ReferenceCurrentCompensation /end SUB_GROUP
 /begin REF_CHARACTERISTIC k_ADP_Value_RefCurrentLimitMax /end REF_CHARACTERISTIC
 /begin REF_MEASUREMENT monr_VfAP_ValueReferenceCurrentSumLAP_MA /end REF_MEASUREMENT
/end GROUP
/begin GROUP S6_SectorCompensation "POD_AntiPinch/POD_AntiPinch/AntiPinch/AntiPinchL/AntiPinchCurOffset/SectorCompensation" /begin SUB_GROUP S17_CloseDoor S17_OpenDoor /end SUB_GROUP /end GROUP
/begin GROUP S6_Switch "POD_MCML/POD_MotorCtrlModuleL_Step_sys/POD_MotorCtrlModuleL/Signal_Override2/Switch" /begin REF_MEASUREMENT monr_VuMCM_MotorCtrlDuty1L_NULL /end REF_MEASUREMENT /end GROUP
/begin GROUP S6_ThreshPatch "RDM_AntiPinch/RDM_AntiPinch_Main_sys/AntiPinchThresh/ThreshPatch" /begin SUB_GROUP S87_BaseThreshold S87_SlopePatch /end SUB_GROUP /begin REF_CHARACTERISTIC Cal_SlopePatchEnable /end REF_CHARACTERISTIC /end GROUP
/begin GROUP S74_ClosingInLock "POD_HallHandleModule_TZCU/POD_HallHandleModule/HallHandleModule/HallHandleModuleL/DoorMovSts/Hold/ClosingInLock" /begin SUB_GROUP S80_Rising_Debounce /end SUB_GROUP /end GROUP
/begin GROUP S74_DoorStateErrorJudge "POD_HallHandleModule_TZCU/POD_HallHandleModule/HallHandleModule/HallHandleModuleL/DoorMovSts/Hold/DoorStateErrorJudge" /begin SUB_GROUP S82_Rising_Debounce4 /end SUB_GROUP /end GROUP
/begin GROUP S74_DooStop "POD_HallHandleModule_TZCU/POD_HallHandleModule/HallHandleModule/HallHandleModuleL/DoorMovSts/Hold/DooStop" /begin SUB_GROUP S81_Rising_Debounce S81_Rising_Debounce1 /end SUB_GROUP /end GROUP
/begin GROUP S74_ElecDoorStop "POD_HallHandleModule_TZCU/POD_HallHandleModule/HallHandleModule/HallHandleModuleL/DoorMovSts/Hold/ElecDoorStop" /begin SUB_GROUP S83_Rising_Debounce /end SUB_GROUP /end GROUP
/begin GROUP S76_ManualJudge "POD_HallHandleModule_TZCU/POD_HallHandleModule/HallHandleModule/HallHandleModuleL/DoorMovSts/ManualMov/ManualJudge"
 /begin REF_MEASUREMENT monr_VbHHM_BooleanManualDownLHHM_flg monr_VbHHM_BooleanManualUpLHHM_flg /end REF_MEASUREMENT
/end GROUP
/begin GROUP S76_PerManualMovDoor "POD_HallHandleModule_TZCU/POD_HallHandleModule/HallHandleModule/HallHandleModuleL/DoorMovSts/ManualMov/PerManualMovDoor"
 /begin SUB_GROUP S108_Rising_Debounce S108_Rising_Debounce1 S108_Rising_Debounce2 S108_Rising_Debounce3 /end SUB_GROUP
/end GROUP
/begin GROUP S7_AngleConversion "POD_HallHandleModule_TZCU/POD_HallHandleModule/HallHandleModule/HallHandleModuleL/AngleConversion"
 /begin SUB_GROUP S51_DoorHallPosition S51_DoorOpenTargetPosition S51_PercPosn2AndPosn2 S51_TopDegforDoorOpen /end SUB_GROUP
/end GROUP
/begin GROUP S7_AntiPinchConditions_Current "POD_AntiPinch/POD_AntiPinch/AntiPinch/AntiPinchL/AntiPinchTrig/AntiPinchConditions_Current"
 /begin SUB_GROUP S47_Rising_Debounce S47_Rising_Debounce1 S47_Rising_Debounce2 S47_Rising_Debounce3 /end SUB_GROUP
 /begin REF_CHARACTERISTIC k_ADP_Value_CurrentMinRefDiffforAntiPinch k_ADP_Value_CurrentMinRefHallSpeedforAntiPinch k_ADP_Value_CurrentMinRefPntDiffforAntiPinch k_ADP_Value_CurrentMinRefPntforAntiPinch /end REF_CHARACTERISTIC
 /begin REF_MEASUREMENT monr_VbAP_JudgeCurAntiPinchLAP_flg monr_VbAP_JudgeCurAntiPinchforMinPntCloseLAP_flg /end REF_MEASUREMENT
/end GROUP
/begin GROUP S7_AntiPinchConditions_Speed "POD_AntiPinch/POD_AntiPinch/AntiPinch/AntiPinchL/AntiPinchTrig/AntiPinchConditions_Speed" /begin SUB_GROUP S48_Rising_Debounce4 /end SUB_GROUP /begin REF_CHARACTERISTIC k_ADP_Value_DieMinimumSpeedforAntiPinch /end REF_CHARACTERISTIC /end GROUP
/begin GROUP S7_AntiplayStatus "POD_FaultHandle/POD_FaultHandle/FaultHandle/AntiPlay/AntiPlayL/AntiplayStatus" /begin SUB_GROUP S9_ADPPara S9_AntiPlayState /end SUB_GROUP
 /begin REF_MEASUREMENT monr_ADP_Value_FastPointerL monr_ADP_Value_HistoricalTimerL monr_ADP_Value_SlowPointerL monr_ADP_Value_TimeStampL monr_ADP_Value_TimerL /end REF_MEASUREMENT
/end GROUP
/begin GROUP S7_DetQuitInitSrc "RDM_GetTrunkPos/RDM_GetTrunkPos_Main_sys/DetInitMode/DetQuitInitSrc"
 /begin REF_CHARACTERISTIC CalC_TrnkClsVldMinHallPos CalC_TrnkDualLvrMaxPosTol CalC_TrnkRelsSwLstInitHdTm_sec /end REF_CHARACTERISTIC
/end GROUP
/begin GROUP S7_DoorMovSts "POD_HallHandleModule_TZCU/POD_HallHandleModule/HallHandleModule/HallHandleModuleL/DoorMovSts"
 /begin SUB_GROUP S53_DoorMovSts_Chart S53_ElecMov S53_Hold S53_IMUseMinAge S53_ManualMov S53_POD_GetSector S53_PreOpenOrClsd /end SUB_GROUP
/end GROUP
/begin GROUP S7_DualLeverStallStop "RDM_CtrlLeverMtr/RDM_CtrlLeverMtr_Main_sys/DetStallStopCond/DualLeverStallStop" /begin REF_CHARACTERISTIC CalC_TrnkClsStlStpMaxTmTol_ms CalC_TrnkOpnStlStpMaxPosTol /end REF_CHARACTERISTIC /end GROUP
/begin GROUP S7_ElecToAssist "POD_TipToRun/POD_TipToRun/TipToRun/TipToRunL/ManAsstRqst/ElecToAssist"
 /begin SUB_GROUP S15_ElecMovInBrkgIMUSpdJudge S15_ElecMovOutBrkgIMUSpdJudge S15_ElecToAssistCloseJudge S15_ElecToAssistIMUErrorSpdOrAccJudge S15_ElecToAssistIMUSpdJudge S15_ElecToAssistOpenJudge S15_ElecToManualCloseIMUAccJudge S15_ElecToManualOpenIMUAccJudge S15_ForR_Para /end SUB_GROUP
/end GROUP
/begin GROUP S7_HallCntrHandle "POD_HallHandleModule_TZCU/POD_HallHandleModule/HallHandleModule/HallHandleModuleL/HallCntrHandle" /begin SUB_GROUP S54_HallPosition S54_HallSpeed /end SUB_GROUP /end GROUP
/begin GROUP S7_HallErrorProcess "POD_HallHandleModule_TZCU/POD_HallHandleModule/HallHandleModule/HallHandleModuleL/HallErrorProcess"
 /begin SUB_GROUP S55_HALL_AFault S55_HALL_BFault S55_HallJudgeCondition S55_SenorErr S55_SenorErr_Reset /end SUB_GROUP
/end GROUP
/begin GROUP S7_ManualSpdBack "POD_TipToRun/POD_TipToRun/TipToRun/TipToRunL/ManAsstRqst/ManualSpdBack"
 /begin SUB_GROUP S17_ForR_Para S17_ManualAssistJudge S17_ManualCloseToOpenJudge S17_ManualOpenOrCloseMaxPos S17_ManualOpenToCloseJudge /end SUB_GROUP
/end GROUP
/begin GROUP S7_StopToAssist "POD_TipToRun/POD_TipToRun/TipToRun/TipToRunL/ManAsstRqst/StopToAssist"
 /begin SUB_GROUP S18_Rising_Debounce S18_Rising_Debounce1 S18_Rising_Debounce2 S18_Rising_Debounce3 /end SUB_GROUP
 /begin REF_MEASUREMENT monr_VbTTR_HoldModeManAssistLTTR_flg monr_VbTTR_HoldPosExitLTTR_flg monr_VbTTR_StopToAssistCloseLTTR_flg monr_VbTTR_StopToAssistOpenLTTR_flg monr_VsTTR_PluseHoldPosLTTR_deg /end REF_MEASUREMENT
/end GROUP
/begin GROUP S7_Switch "POD_MCML/POD_MotorCtrlModuleL_Step_sys/POD_MotorCtrlModuleL/Signal_Override3/Switch" /begin REF_MEASUREMENT monr_VuMCM_MotorCtrlDuty2L_NULL /end REF_MEASUREMENT /end GROUP
/begin GROUP S83_ArrayProces1 "POD_FaultHandle/POD_FaultHandle/FaultHandle/FMS/FMSL/ArrayProces1" /begin SUB_GROUP S87_Byte1 S87_Byte2 S87_Byte4 /end SUB_GROUP /end GROUP
/begin GROUP S83_Event "POD_FaultHandle/POD_FaultHandle/FaultHandle/FMS/FMSL/Event" /begin SUB_GROUP S88_CEM S88_System /end SUB_GROUP /end GROUP
/begin GROUP S83_Event1 "POD_FaultHandle/POD_FaultHandle/FaultHandle/FMS/FMSL/Event1" /begin SUB_GROUP S89_RdrTimeout /end SUB_GROUP /begin REF_MEASUREMENT monr_VbFH_MotOvrheatProtL_flg /end REF_MEASUREMENT /end GROUP
/begin GROUP S83_FIM "POD_FaultHandle/POD_FaultHandle/FaultHandle/FMS/FMSL/FIM" /begin REF_MEASUREMENT monr_VbFH_FrbdMaiMotWrkL_flg /end REF_MEASUREMENT /end GROUP
/begin GROUP S84_ArrayProces1 "POD_FaultHandle/POD_FaultHandle/FaultHandle/FMS/FMSR/ArrayProces1" /begin SUB_GROUP S127_Byte1 S127_Byte2 S127_Byte4 /end SUB_GROUP /end GROUP
/begin GROUP S84_Event "POD_FaultHandle/POD_FaultHandle/FaultHandle/FMS/FMSR/Event" /begin SUB_GROUP S128_CEM S128_System /end SUB_GROUP /end GROUP
/begin GROUP S84_Event1 "POD_FaultHandle/POD_FaultHandle/FaultHandle/FMS/FMSR/Event1" /begin SUB_GROUP S129_RdrTimeout /end SUB_GROUP /begin REF_MEASUREMENT monr_VbFH_MotOvrheatProtR_flg /end REF_MEASUREMENT /end GROUP
/begin GROUP S84_FIM "POD_FaultHandle/POD_FaultHandle/FaultHandle/FMS/FMSR/FIM" /begin REF_MEASUREMENT monr_VbFH_FrbdMaiMotWrkR_flg /end REF_MEASUREMENT /end GROUP
/begin GROUP S87_BaseThreshold "RDM_AntiPinch/RDM_AntiPinch_Main_sys/AntiPinchThresh/ThreshPatch/BaseThreshold"
 /begin REF_CHARACTERISTIC CalC_TrnkClsAPMtrSpdThrTbl_200mm CalC_TrnkClsAPMtrSpdThrTbl_20mm CalC_TrnkClsAPMtrSpdThrTbl_50mm CalC_TrnkClsAPThrTblPosArr /end REF_CHARACTERISTIC
/end GROUP
/begin GROUP S87_Byte1 "POD_FaultHandle/POD_FaultHandle/FaultHandle/FMS/FMSL/ArrayProces1/Byte1"
 /begin REF_MEASUREMENT monr_VbFMS_MaiMotOCErrL_flg monr_VbFMS_MaiMotSCBErrL_flg monr_VbFMS_MaiMotSCGErrL_flg monr_VbFMS_MaiMotVDSULErrL_flg /end REF_MEASUREMENT
/end GROUP
/begin GROUP S87_Byte2 "POD_FaultHandle/POD_FaultHandle/FaultHandle/FMS/FMSL/ArrayProces1/Byte2" /begin REF_MEASUREMENT monr_VbFMS_HallBSCGErrL_flg monr_VbFMS_RAMErrL_flg /end REF_MEASUREMENT /end GROUP
/begin GROUP S87_Byte4 "POD_FaultHandle/POD_FaultHandle/FaultHandle/FMS/FMSL/ArrayProces1/Byte4" /begin REF_MEASUREMENT monr_VeFMS_MaiMotErrL_NULL /end REF_MEASUREMENT /end GROUP
/begin GROUP S87_Signal_Holding_Boolean "POD_AntiPinch/POD_AntiPinch/AntiPinch/AntiPinchL/Tip2RunAntiPinch/Time Holding Boolean/Signal Holding Boolean" /begin REF_MEASUREMENT monr_VbAP_Tip2RunAntiPinchL_flg /end REF_MEASUREMENT /end GROUP
/begin GROUP S87_SlopePatch "RDM_AntiPinch/RDM_AntiPinch_Main_sys/AntiPinchThresh/ThreshPatch/SlopePatch"
 /begin REF_CHARACTERISTIC CalC_TrnkClsAPThrTblPosArr Cal_SlopePatch Cal_SlopeSpdPatch /end REF_CHARACTERISTIC
/end GROUP
/begin GROUP S88_CEM "POD_FaultHandle/POD_FaultHandle/FaultHandle/FMS/FMSL/Event/CEM"
 /begin REF_MEASUREMENT monr_VbFH_FrntIncinAgFltL_flg monr_VbFH_SideIncinAgFltL_flg /end REF_MEASUREMENT
/end GROUP
/begin GROUP S88_System "POD_FaultHandle/POD_FaultHandle/FaultHandle/FMS/FMSL/Event/System" /begin REF_MEASUREMENT monr_VbFH_GyroSigFltL_flg /end REF_MEASUREMENT /end GROUP
/begin GROUP S89_RdrTimeout "POD_FaultHandle/POD_FaultHandle/FaultHandle/FMS/FMSL/Event1/RdrTimeout" /begin REF_MEASUREMENT monr_VbFH_RdrTioutL_flg monr_VbFMS_RdrTimeOutRawL_flg /end REF_MEASUREMENT /end GROUP
/begin GROUP S8_AngleConversion "POD_HallHandleModule_TZCU/POD_HallHandleModule/HallHandleModule/HallHandleModuleR/AngleConversion"
 /begin SUB_GROUP S250_DoorHallPosition S250_DoorOpenTargetPosition S250_PercPosn2AndPosn2 S250_TopDegforDoorOpen /end SUB_GROUP
/end GROUP
/begin GROUP S8_AntiPinchEvent "POD_AntiPinch/POD_AntiPinch/AntiPinch/AntiPinchL/AntiPinch_Detection/AntiPinchEvent" /begin SUB_GROUP S66_Rising_Debounce S66_Rising_Debounce1 /end SUB_GROUP
 /begin REF_CHARACTERISTIC K_ADP_Value_CurDiffAntiPinchforMinPntClose K_ADP_Value_ErrPositionDiff K_ADP_Value_MainMotoCurrentMaxDiff k_ADP_Value_CurrentRefPositionDiffforAntiPinch /end REF_CHARACTERISTIC
 /begin REF_MEASUREMENT monr_VbAP_AntiPinchforMinPntCloseLAP_flg monr_VbAP_CurrJudgeDurNormrunLAP_flg monr_VbAP_DiffJudgeDurNormrunLAP_flg /end REF_MEASUREMENT
/end GROUP
/begin GROUP S8_AntiplayStatus "POD_FaultHandle/POD_FaultHandle/FaultHandle/AntiPlay/AntiPlayR/AntiplayStatus" /begin SUB_GROUP S47_ADPPara S47_AntiPlayState /end SUB_GROUP
 /begin REF_MEASUREMENT monr_ADP_Value_FastPointerR monr_ADP_Value_HistoricalTimerR monr_ADP_Value_SlowPointerR monr_ADP_Value_TimeStampR monr_ADP_Value_TimerR /end REF_MEASUREMENT
/end GROUP
/begin GROUP S8_cnt "POD_AntiPinch/POD_AntiPinch/AntiPinch/AntiPinchL/AntiPinch_Detection/cnt" /begin REF_CHARACTERISTIC k_ADP_Ti_AllowforAntiPinchTimer /end REF_CHARACTERISTIC /end GROUP
/begin GROUP S8_DetPosZone "RDM_GetTrunkPos/RDM_GetTrunkPos_Main_sys/DivideTrunkZone/DetPosZone"
 /begin REF_CHARACTERISTIC CalC_hIPLGCloseOnlyHallTol_cnt CalEn_Debug_TgatePosSts CalVal_Debug_TgatePosSts /end REF_CHARACTERISTIC
/end GROUP
/begin GROUP S8_DoorMovSts "POD_HallHandleModule_TZCU/POD_HallHandleModule/HallHandleModule/HallHandleModuleR/DoorMovSts"
 /begin SUB_GROUP S252_DoorMovSts_Chart S252_ElecMov S252_Hold S252_IMUseMinAge S252_ManualMov S252_POD_GetSector S252_PreOpenOrClsd /end SUB_GROUP
/end GROUP
/begin GROUP S8_HallCntrHandle "POD_HallHandleModule_TZCU/POD_HallHandleModule/HallHandleModule/HallHandleModuleR/HallCntrHandle" /begin SUB_GROUP S253_HallPosition S253_HallSpeed /end SUB_GROUP /end GROUP
/begin GROUP S8_HallErrorProcess "POD_HallHandleModule_TZCU/POD_HallHandleModule/HallHandleModule/HallHandleModuleR/HallErrorProcess"
 /begin SUB_GROUP S254_HALL_AFault S254_HALL_BFault S254_HallJudgeCondition S254_SenorErr S254_SenorErr_Reset /end SUB_GROUP
/end GROUP
/begin GROUP S8_Signal_Override "POD_AntiPinch/POD_AntiPinch/AntiPinch/AntiPinchL/AntiPinch_Detection/Signal_Override" /begin REF_CHARACTERISTIC k_ADP_Boolean_Value k_ADP_Boolean_flg /end REF_CHARACTERISTIC /end GROUP
/begin GROUP S8_Subsystem "RDM_CtrlLeverMtr/RDM_CtrlLeverMtr_Main_sys/For Each Subsystem/Subsystem" /begin REF_CHARACTERISTIC CalC_TrnkAntiPinchBrakeTm_msec CalC_TrnkLvrMtrStpBrkTm_ms /end REF_CHARACTERISTIC /end GROUP
/begin GROUP S8_Time_Holding_Boolean "POD_AntiPinch/POD_AntiPinch/AntiPinch/AntiPinchL/AntiPinch_Detection/Time Holding Boolean" /begin SUB_GROUP S69_Signal_Holding_Boolean S69_Timer_Debounce /end SUB_GROUP /end GROUP
/begin GROUP S94_CurrentCmp "POD_AntiPinch/POD_AntiPinch/AntiPinch/AntiPinchR/AntiPinchCurOffset/CurrentCmp" /begin SUB_GROUP S103_CloseDoor S103_OpenDoor /end SUB_GROUP /begin REF_MEASUREMENT monr_VfAP_ValueCurrentCmpRAP_MA /end REF_MEASUREMENT /end GROUP
/begin GROUP S94_ReferenceCurrent "POD_AntiPinch/POD_AntiPinch/AntiPinch/AntiPinchR/AntiPinchCurOffset/ReferenceCurrent"
 /begin SUB_GROUP S104_KeepReferenceCurrentFlag S104_ReferenceCurrent S104_ReferenceCurrentCompensation /end SUB_GROUP
 /begin REF_CHARACTERISTIC k_ADP_Value_RefCurrentLimitMax /end REF_CHARACTERISTIC
 /begin REF_MEASUREMENT monr_VfAP_ValueReferenceCurrentSumRAP_MA /end REF_MEASUREMENT
/end GROUP
/begin GROUP S94_SectorCompensation "POD_AntiPinch/POD_AntiPinch/AntiPinch/AntiPinchR/AntiPinchCurOffset/SectorCompensation" /begin SUB_GROUP S105_CloseDoor S105_OpenDoor /end SUB_GROUP /end GROUP
/begin GROUP S95_AntiPinchConditions_Current "POD_AntiPinch/POD_AntiPinch/AntiPinch/AntiPinchR/AntiPinchTrig/AntiPinchConditions_Current"
 /begin SUB_GROUP S135_Rising_Debounce S135_Rising_Debounce1 S135_Rising_Debounce2 S135_Rising_Debounce3 /end SUB_GROUP
 /begin REF_CHARACTERISTIC k_ADP_Value_CurrentMinRefDiffforAntiPinch k_ADP_Value_CurrentMinRefHallSpeedforAntiPinch k_ADP_Value_CurrentMinRefPntDiffforAntiPinch k_ADP_Value_CurrentMinRefPntforAntiPinch /end REF_CHARACTERISTIC
 /begin REF_MEASUREMENT monr_VbAP_JudgeCurAntiPinchRAP_flg monr_VbAP_JudgeCurAntiPinchforMinPntCloseRAP_flg /end REF_MEASUREMENT
/end GROUP
/begin GROUP S95_AntiPinchConditions_Speed "POD_AntiPinch/POD_AntiPinch/AntiPinch/AntiPinchR/AntiPinchTrig/AntiPinchConditions_Speed" /begin SUB_GROUP S136_Rising_Debounce4 /end SUB_GROUP /begin REF_CHARACTERISTIC k_ADP_Value_DieMinimumSpeedforAntiPinch /end REF_CHARACTERISTIC /end GROUP
/begin GROUP S96_AntiPinchEvent "POD_AntiPinch/POD_AntiPinch/AntiPinch/AntiPinchR/AntiPinch_Detection/AntiPinchEvent" /begin SUB_GROUP S154_Rising_Debounce S154_Rising_Debounce1 /end SUB_GROUP
 /begin REF_CHARACTERISTIC K_ADP_Value_CurDiffAntiPinchforMinPntClose K_ADP_Value_ErrPositionDiff K_ADP_Value_MainMotoCurrentMaxDiff k_ADP_Value_CurrentRefPositionDiffforAntiPinch /end REF_CHARACTERISTIC
 /begin REF_MEASUREMENT monr_VbAP_AntiPinchforMinPntCloseRAP_flg monr_VbAP_CurrJudgeDurNormrunRAP_flg monr_VbAP_DiffJudgeDurNormrunRAP_flg /end REF_MEASUREMENT
/end GROUP
/begin GROUP S96_cnt "POD_AntiPinch/POD_AntiPinch/AntiPinch/AntiPinchR/AntiPinch_Detection/cnt" /begin REF_CHARACTERISTIC k_ADP_Ti_AllowforAntiPinchTimer /end REF_CHARACTERISTIC /end GROUP
/begin GROUP S96_Signal_Override "POD_AntiPinch/POD_AntiPinch/AntiPinch/AntiPinchR/AntiPinch_Detection/Signal_Override" /begin REF_CHARACTERISTIC k_ADP_Boolean_Value k_ADP_Boolean_flg /end REF_CHARACTERISTIC /end GROUP
/begin GROUP S96_Time_Holding_Boolean "POD_AntiPinch/POD_AntiPinch/AntiPinch/AntiPinchR/AntiPinch_Detection/Time Holding Boolean" /begin SUB_GROUP S157_Signal_Holding_Boolean S157_Timer_Debounce /end SUB_GROUP /end GROUP
/begin GROUP S9_ADPPara "POD_FaultHandle/POD_FaultHandle/FaultHandle/AntiPlay/AntiPlayL/AntiplayStatus/ADPPara"
 /begin REF_CHARACTERISTIC k_ADP_Ti_TimeSpanActiveThreshold k_APD_Num_AntiPlayNumThreshold /end REF_CHARACTERISTIC
/end GROUP
/begin GROUP S9_AntiPlayState "POD_FaultHandle/POD_FaultHandle/FaultHandle/AntiPlay/AntiPlayL/AntiplayStatus/AntiPlayState"
 /begin SUB_GROUP S13_AntiPlayActiveCounter S13_Signal_Override S13_Time_Holding_Boolean /end SUB_GROUP
 /begin REF_CHARACTERISTIC k_APD_Boolean_AntiPlayEnable /end REF_CHARACTERISTIC
/end GROUP
/begin GROUP S9_DetLvrPos "RDM_GetTrunkPos/RDM_GetTrunkPos_Main_sys/LearnPos/DetLvrPos" /begin SUB_GROUP S109_DetLvrPos /end SUB_GROUP /end GROUP
/begin GROUP S9_DetSftStpOpnHallPos "RDM_GetTrunkPos/RDM_GetTrunkPos_Main_sys/LearnPos/DetSftStpOpnHallPos" /begin SUB_GROUP S110_Subsystem /end SUB_GROUP /end GROUP
/begin GROUP S9_Subsystem "RDM_DetLeverMtrStallSt/RDM_DetLeverMtrStallSt_Main_sys/For Each Subsystem/Subsystem" /begin REF_CHARACTERISTIC CalC_TrnkLvrMtrStlCurr CalC_TrnkLvrMtrStlTm_msec /end REF_CHARACTERISTIC /end GROUP
/begin GROUP TMS "TMS" ROOT /begin SUB_GROUP TMS_TMSTZCUAppCyclic10Hook_sys /end SUB_GROUP /begin REF_MEASUREMENT gdu16 gdu8 mA_u16 /end REF_MEASUREMENT /end GROUP
/begin GROUP TMS_TMSTZCUAppCyclic10Hook_sys "TMS/TMSTZCUAppCyclic10Hook_sys" /begin SUB_GROUP TMS_TMSTZCUAppCyclic10Hook_sys_Compare_To_Constant1 /end SUB_GROUP
 /begin REF_CHARACTERISTIC CIL_3rModFlapMotCtr_BypS CIL_3rModFlapMotCtr_BypV CIL_3rTempFlapMotCtr_BypS CIL_3rTempFlapMotCtr_BypV CIL_ICanNmRxInd_BypS CIL_ICanNmRxInd_BypV CIL_TMCCanComReq_BypS CIL_TMCCanComReq_BypV COL_3rEvapDuctTempRaw_BypS COL_3rEvapDuctTempRaw_BypV COL_3rFaceDuctTempRaw_BypS COL_3rFaceDuctTempRaw_BypV COL_3rFootDuctTempRaw_BypS COL_3rFootDuctTempRaw_BypV COL_3rModFlapMotVolFb_BypS COL_3rModFlapMotVolFb_BypV COL_3rTempFlapVolFb_BypS COL_3rTempFlapVolFb_BypV COL_RrModMotCtr_BypS COL_RrModMotCtr_BypV /end REF_CHARACTERISTIC
 /begin REF_MEASUREMENT CIL_3rModFlapMotCtr CIL_3rTempFlapMotCtr CIL_ICanNmRxInd CIL_RrEvapDuctTempSnsr CIL_RrFaceDuctTempSnsr CIL_RrFootDuctTempSnsr CIL_RrModMotPosnFb CIL_TMCCanComReq CIL_TZcuKL30DcV COL_3rTempFlapVolFb gdu16 gdu8 mA_u16 /end REF_MEASUREMENT
/end GROUP
/begin GROUP TMS_TMSTZCUAppCyclic10Hook_sys_Compare_To_Constant1 "TMS/TMSTZCUAppCyclic10Hook_sys/Compare\r\nTo Constant1" /begin REF_MEASUREMENT gdu8 /end REF_MEASUREMENT /end GROUP
/begin GROUP TZCUbody_DTC "TZCUbody_DTC" ROOT /begin SUB_GROUP Root_TZCUbody_DTC_Main_sys /end SUB_GROUP /end GROUP
/begin RECORD_LAYOUT Record_UBYTE FNC_VALUES 1 UBYTE COLUMN_DIR DIRECT /end RECORD_LAYOUT
/begin RECORD_LAYOUT Record_UWORD FNC_VALUES 1 UWORD COLUMN_DIR DIRECT /end RECORD_LAYOUT
/begin RECORD_LAYOUT Scalar_FLOAT32_IEEE FNC_VALUES 1 FLOAT32_IEEE COLUMN_DIR DIRECT /end RECORD_LAYOUT
/begin RECORD_LAYOUT Scalar_SWORD FNC_VALUES 1 SWORD COLUMN_DIR DIRECT /end RECORD_LAYOUT
/begin RECORD_LAYOUT Scalar_UBYTE FNC_VALUES 1 UBYTE COLUMN_DIR DIRECT /end RECORD_LAYOUT
/begin RECORD_LAYOUT Scalar_UWORD FNC_VALUES 1 UWORD COLUMN_DIR DIRECT /end RECORD_LAYOUT
/begin RECORD_LAYOUT __ULONG_S FNC_VALUES 1 ULONG COLUMN_DIR DIRECT /end RECORD_LAYOUT
/begin RECORD_LAYOUT __SBYTE_S FNC_VALUES 1 SBYTE COLUMN_DIR DIRECT /end RECORD_LAYOUT
/begin RECORD_LAYOUT __SWORD_S FNC_VALUES 1 SWORD COLUMN_DIR DIRECT /end RECORD_LAYOUT
/begin RECORD_LAYOUT __SLONG_S FNC_VALUES 1 SLONG COLUMN_DIR DIRECT /end RECORD_LAYOUT
/begin RECORD_LAYOUT __FLOAT32_IEEE_S FNC_VALUES 1 FLOAT32_IEEE COLUMN_DIR DIRECT /end RECORD_LAYOUT
/begin RECORD_LAYOUT __FLOAT64_IEEE_S FNC_VALUES 1 FLOAT64_IEEE COLUMN_DIR DIRECT /end RECORD_LAYOUT
/begin RECORD_LAYOUT SSV__UBYTE_S AXIS_PTS_X 1 UBYTE INDEX_INCR DIRECT /end RECORD_LAYOUT
/begin RECORD_LAYOUT SSV__UWORD_S AXIS_PTS_X 1 UWORD INDEX_INCR DIRECT /end RECORD_LAYOUT
/begin RECORD_LAYOUT SSV__ULONG_S AXIS_PTS_X 1 ULONG INDEX_INCR DIRECT /end RECORD_LAYOUT
/begin RECORD_LAYOUT SSV__SBYTE_S AXIS_PTS_X 1 SBYTE INDEX_INCR DIRECT /end RECORD_LAYOUT
/begin RECORD_LAYOUT SSV__SWORD_S AXIS_PTS_X 1 SWORD INDEX_INCR DIRECT /end RECORD_LAYOUT
/begin RECORD_LAYOUT SSV__SLONG_S AXIS_PTS_X 1 SLONG INDEX_INCR DIRECT /end RECORD_LAYOUT
/begin RECORD_LAYOUT SSV__FLOAT32_IEEE_S AXIS_PTS_X 1 FLOAT32_IEEE INDEX_INCR DIRECT /end RECORD_LAYOUT
/begin RECORD_LAYOUT SSV__FLOAT64_IEEE_S AXIS_PTS_X 1 FLOAT64_IEEE INDEX_INCR DIRECT /end RECORD_LAYOUT
/begin RECORD_LAYOUT __A_UINT64_Z FNC_VALUES 1 A_UINT64 ROW_DIR DIRECT /end RECORD_LAYOUT
/begin RECORD_LAYOUT __A_INT64_Z FNC_VALUES 1 A_INT64 ROW_DIR DIRECT /end RECORD_LAYOUT
/begin RECORD_LAYOUT __A_UINT64_S FNC_VALUES 1 A_UINT64 COLUMN_DIR DIRECT /end RECORD_LAYOUT
/begin RECORD_LAYOUT __A_INT64_S FNC_VALUES 1 A_INT64 COLUMN_DIR DIRECT /end RECORD_LAYOUT
/begin RECORD_LAYOUT SSV__A_UINT64_S AXIS_PTS_X 1 A_UINT64 INDEX_INCR DIRECT /end RECORD_LAYOUT
/begin RECORD_LAYOUT SSV__A_INT64_S AXIS_PTS_X 1 A_INT64 INDEX_INCR DIRECT /end RECORD_LAYOUT
/end MODULE
/end PROJECT
