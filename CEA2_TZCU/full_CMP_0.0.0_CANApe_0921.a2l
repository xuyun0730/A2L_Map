/****************** COPYRIGHT (C) : CARIAD *********************/
/*******************************************************************************
* Source file : CANFD Template.a2l
* Module Full Name : CANFD XCP A2L File
* Description : This is a Template A2L File For CANFD XCP
* Environment : INCA 7.3
* Operation System : NA
* Guidelines : A2L 1.6
* Created by : di.peng@cariad-technology.cn
* Created Date : 2026.03.01
* Module Version : 1.0
* History Record : 2026-03-01, It is created for the first time.
*******************************************************************************/
/* generated by ASAP2 Studio 2.2.12.8318 */
ASAP2_VERSION 1 70
/begin PROJECT ProjectName "CARIAD XCP On CAN"
/begin MODULE ZCU "this is a module for XCP A2l"
/begin MOD_PAR "" VERSION "Entry_XCP_1" SUPPLIER "Xp Supply" CUSTOMER "Customer" CUSTOMER_NO "XPENG MOTORS" USER "" PHONE_NO "" ECU "E38RDCU" CPU_TYPE "RH850U2A" /*EPK "RTA_SK_XCP_1"*/ /*EPROM identifier*/ /*ADDR_EPK 0x0000*/ /*TODO: use linker symbol*/ NO_OF_INTERFACES 1
 /begin MEMORY_SEGMENT Code "Internal Flash Code Space 1" CODE FLASH INTERN 0x80030000 /*$temp_ProgramRomAddr*/ 0x9cffff /*$temp_ProgramRomSize*/ -1 -1 -1 -1 -1 /end MEMORY_SEGMENT
 /begin MEMORY_SEGMENT CALFALSH0 "Calibration calibration0" DATA FLASH INTERN 0xB0006000 0x1C000 -1 -1 -1 -1 -1
  /begin IF_DATA XCP
   /begin SEGMENT 0x00 0x02 0x00 0x00 0x00 /begin CHECKSUM XCP_ADD_14 MAX_BLOCK_SIZE 0x1C000 /end CHECKSUM
    /begin PAGE 0x0 ECU_ACCESS_WITH_XCP_ONLY XCP_READ_ACCESS_WITH_ECU_ONLY XCP_WRITE_ACCESS_NOT_ALLOWED /end PAGE
    /begin PAGE 0x1 ECU_ACCESS_WITH_XCP_ONLY XCP_READ_ACCESS_WITH_ECU_ONLY XCP_WRITE_ACCESS_WITH_ECU_ONLY /end PAGE
    /begin ADDRESS_MAPPING 0xB0006000 0xB0006000 0x1C000 /end ADDRESS_MAPPING
   /end SEGMENT
  /end IF_DATA
 /end MEMORY_SEGMENT
 /begin MEMORY_SEGMENT CALFALSH1 "Calibration calibration1" DATA FLASH INTERN 0xB0004000 0x2000 -1 -1 -1 -1 -1
  /begin IF_DATA XCP
   /begin SEGMENT 0x00 0x02 0x00 0x00 0x00 /begin CHECKSUM XCP_ADD_14 MAX_BLOCK_SIZE 0x2000 /end CHECKSUM
    /begin PAGE 0x0 ECU_ACCESS_WITH_XCP_ONLY XCP_READ_ACCESS_WITH_ECU_ONLY XCP_WRITE_ACCESS_NOT_ALLOWED /end PAGE
    /begin PAGE 0x1 ECU_ACCESS_WITH_XCP_ONLY XCP_READ_ACCESS_WITH_ECU_ONLY XCP_WRITE_ACCESS_WITH_ECU_ONLY /end PAGE
    /begin ADDRESS_MAPPING 0xB0004000 0xB0004000 0x2000 /end ADDRESS_MAPPING
   /end SEGMENT
  /end IF_DATA
 /end MEMORY_SEGMENT
 /begin MEMORY_SEGMENT CALFALSH2 "Calibration calibration2" DATA FLASH INTERN 0xB0082000 0x55000 -1 -1 -1 -1 -1
  /begin IF_DATA XCP
   /begin SEGMENT 0x00 0x02 0x00 0x00 0x00 /begin CHECKSUM XCP_ADD_14 MAX_BLOCK_SIZE 0x55000 /end CHECKSUM
    /begin PAGE 0x0 ECU_ACCESS_WITH_XCP_ONLY XCP_READ_ACCESS_WITH_ECU_ONLY XCP_WRITE_ACCESS_NOT_ALLOWED /end PAGE
    /begin PAGE 0x1 ECU_ACCESS_WITH_XCP_ONLY XCP_READ_ACCESS_WITH_ECU_ONLY XCP_WRITE_ACCESS_WITH_ECU_ONLY /end PAGE
    /begin ADDRESS_MAPPING 0xB0082000 0xB0082000 0x55000 /end ADDRESS_MAPPING
   /end SEGMENT
  /end IF_DATA
 /end MEMORY_SEGMENT
 /begin MEMORY_SEGMENT CALFALSH3 "Calibration calibration3" DATA FLASH INTERN 0xB0080000 0x2000 -1 -1 -1 -1 -1
  /begin IF_DATA XCP
   /begin SEGMENT 0x00 0x02 0x00 0x00 0x00 /begin CHECKSUM XCP_ADD_14 MAX_BLOCK_SIZE 0x2000 /end CHECKSUM
    /begin PAGE 0x0 ECU_ACCESS_WITH_XCP_ONLY XCP_READ_ACCESS_WITH_ECU_ONLY XCP_WRITE_ACCESS_NOT_ALLOWED /end PAGE
    /begin PAGE 0x1 ECU_ACCESS_WITH_XCP_ONLY XCP_READ_ACCESS_WITH_ECU_ONLY XCP_WRITE_ACCESS_WITH_ECU_ONLY /end PAGE
    /begin ADDRESS_MAPPING 0xB0080000 0xB0080000 0x2000 /end ADDRESS_MAPPING
   /end SEGMENT
  /end IF_DATA
 /end MEMORY_SEGMENT
/end MOD_PAR
/begin MOD_COMMON "" ALIGNMENT_BYTE 1 ALIGNMENT_WORD 2 ALIGNMENT_LONG 4 ALIGNMENT_FLOAT32_IEEE 4 ALIGNMENT_FLOAT64_IEEE 8 ALIGNMENT_INT64 8 /end MOD_COMMON
/begin IF_DATA XCP
 /begin PROTOCOL_LAYER 0x0100 0x07D0 0x2710 0x00 0x00 0x00 0x00 0x00 0x08 0x08 BYTE_ORDER_MSB_LAST ADDRESS_GRANULARITY_BYTE OPTIONAL_CMD ALLOC_ODT_ENTRY OPTIONAL_CMD ALLOC_ODT OPTIONAL_CMD ALLOC_DAQ OPTIONAL_CMD FREE_DAQ OPTIONAL_CMD GET_DAQ_EVENT_INFO OPTIONAL_CMD GET_DAQ_RESOLUTION_INFO OPTIONAL_CMD GET_DAQ_PROCESSOR_INFO OPTIONAL_CMD GET_DAQ_CLOCK OPTIONAL_CMD START_STOP_SYNCH OPTIONAL_CMD START_STOP_DAQ_LIST OPTIONAL_CMD GET_DAQ_LIST_MODE OPTIONAL_CMD SET_DAQ_LIST_MODE OPTIONAL_CMD WRITE_DAQ OPTIONAL_CMD SET_DAQ_PTR OPTIONAL_CMD CLEAR_DAQ_LIST OPTIONAL_CMD DOWNLOAD OPTIONAL_CMD UPLOAD OPTIONAL_CMD SET_MTA COMMUNICATION_MODE_SUPPORTED BLOCK SLAVE /end PROTOCOL_LAYER
 /begin DAQ DYNAMIC 0x00 0x02 0x00 OPTIMISATION_TYPE_DEFAULT ADDRESS_EXTENSION_FREE IDENTIFICATION_FIELD_TYPE_ABSOLUTE GRANULARITY_ODT_ENTRY_SIZE_DAQ_BYTE 0xFF OVERLOAD_INDICATION_EVENT PRESCALER_SUPPORTED /begin EVENT "10ms" "10ms" 0x00 DAQ 0x01 0x01 0x07 0x08 /end EVENT /begin EVENT "100ms" "100ms" 0x01 DAQ 0x01 0x01 0x08 0x0A /end EVENT /end DAQ
 /begin PAG 0x00 /end PAG
 /begin PGM PGM_MODE_ABSOLUTE 0x00 0x00 /end PGM
 /begin XCP_ON_CAN 0x0100 CAN_ID_MASTER 0x40000691 CAN_ID_SLAVE 0x40000692 BAUDRATE 0x07A120 SAMPLE_POINT 0x4B SAMPLE_RATE SINGLE BTL_CYCLES 0x08 SJW 0x02 SYNC_EDGE SINGLE /end XCP_ON_CAN
/end IF_DATA
/begin RECORD_LAYOUT __SWORD_S FNC_VALUES 1 SWORD COLUMN_DIR DIRECT /end RECORD_LAYOUT
/begin RECORD_LAYOUT __UBYTE_S FNC_VALUES 1 UBYTE COLUMN_DIR DIRECT /end RECORD_LAYOUT
/begin RECORD_LAYOUT SSV__UBYTE_S AXIS_PTS_X 1 UBYTE INDEX_INCR DIRECT /end RECORD_LAYOUT
/begin RECORD_LAYOUT SSV__SBYTE_S AXIS_PTS_X 1 SBYTE INDEX_INCR DIRECT /end RECORD_LAYOUT
/begin RECORD_LAYOUT SSV__UWORD_S AXIS_PTS_X 1 UWORD INDEX_INCR DIRECT /end RECORD_LAYOUT
/begin RECORD_LAYOUT SSV__SWORD_S AXIS_PTS_X 1 SWORD INDEX_INCR DIRECT /end RECORD_LAYOUT
/begin RECORD_LAYOUT SSV__ULONG_S AXIS_PTS_X 1 ULONG INDEX_INCR DIRECT /end RECORD_LAYOUT
/begin RECORD_LAYOUT SSV__SLONG_S AXIS_PTS_X 1 SLONG INDEX_INCR DIRECT /end RECORD_LAYOUT
/***************** ******Add the matlab A2L Generate Code From This*****************************/
/begin RECORD_LAYOUT Scalar_UBYTE FNC_VALUES 1 UBYTE COLUMN_DIR DIRECT /end RECORD_LAYOUT
/begin RECORD_LAYOUT Scalar_UWORD FNC_VALUES 1 UWORD COLUMN_DIR DIRECT /end RECORD_LAYOUT
/begin RECORD_LAYOUT Scalar_SWORD FNC_VALUES 1 SWORD COLUMN_DIR DIRECT /end RECORD_LAYOUT
/begin RECORD_LAYOUT Scalar_FLOAT32_IEEE FNC_VALUES 1 FLOAT32_IEEE COLUMN_DIR DIRECT /end RECORD_LAYOUT
/begin CHARACTERISTIC k_ADP_Value_ThresholdAdjast "" CURVE 0xb000637c /* @ECU_Address@k_ADP_Value_ThresholdAdjast@ */ Lookup1D_FLOAT32_IEEE 0 POD_AntiPinch_CM_single -3.4E+38 3.4E+38
 /begin AXIS_DESCR COM_AXIS monr_VfMCM_ldlToAntipinchLAP_MA POD_AntiPinch_CM_single 8 -3.4E+38 3.4E+38 AXIS_PTS_REF k_ADP_Value_ElecComBreakPoints /end AXIS_DESCR
/end CHARACTERISTIC
/begin AXIS_PTS k_ADP_Value_ElecComBreakPoints "" 0x80773314 /* @ECU_Address@k_ADP_Value_ElecComBreakPoints@ */ monr_VfMCM_ldlToAntipinchLAP_MA Lookup1D_X_FLOAT32_IEEE 0 POD_AntiPinch_CM_single 8 -3.4E+38 3.4E+38 /end AXIS_PTS
/begin CHARACTERISTIC K_ADP_Value_ErrPositionDiff "" CURVE 0xb0006cf4 /* @ECU_Address@K_ADP_Value_ErrPositionDiff@ */ Lookup1D_FLOAT32_IEEE 0 POD_AntiPinch_CM_single -3.4E+38 3.4E+38
 /begin AXIS_DESCR COM_AXIS monr_VfMCM_ldlToAntipinchLAP_MA POD_AntiPinch_CM_single 8 -3.4E+38 3.4E+38 AXIS_PTS_REF k_ADP_Value_ElecComBreakPoints /end AXIS_DESCR
/end CHARACTERISTIC
/begin CHARACTERISTIC k_ADP_Value_BatVoltageCOCCurrentCloseFactor "" CURVE 0xb00061fc /* @ECU_Address@k_ADP_Value_BatVoltageCOCCurrentCloseFactor@ */ Lookup1D_FLOAT32_IEEE 0 POD_AntiPinch_CM_single -3.4E+38 3.4E+38
 /begin AXIS_DESCR COM_AXIS monr_ADP_Value_BatVoltaget_DiffLAP POD_AntiPinch_CM_single 15 -3.4E+38 3.4E+38 AXIS_PTS_REF k_ADP_Value_BatVoltageCOCCurrentCloseOffset /end AXIS_DESCR
/end CHARACTERISTIC
/begin AXIS_PTS k_ADP_Value_BatVoltageCOCCurrentCloseOffset "" 0x80773238 /* @ECU_Address@k_ADP_Value_BatVoltageCOCCurrentCloseOffset@ */ monr_ADP_Value_BatVoltaget_DiffLAP Lookup1D_X_FLOAT32_IEEE 0 POD_AntiPinch_CM_single 15 -3.4E+38 3.4E+38 /end AXIS_PTS
/begin CHARACTERISTIC k_ADP_Value_AmbTrawCOCCloseCurrentFactor "" CURVE 0xb0006170 /* @ECU_Address@k_ADP_Value_AmbTrawCOCCloseCurrentFactor@ */ Lookup1D_FLOAT32_IEEE 0 POD_AntiPinch_CM_single -3.4E+38 3.4E+38
 /begin AXIS_DESCR COM_AXIS monr_VfSHM_AmbTempAP_C POD_AntiPinch_CM_single 10 -3.4E+38 3.4E+38 AXIS_PTS_REF k_ADP_Value_AmbTrawBP /end AXIS_DESCR
/end CHARACTERISTIC
/begin AXIS_PTS k_ADP_Value_AmbTrawBP "" 0x807731ac /* @ECU_Address@k_ADP_Value_AmbTrawBP@ */ monr_VfSHM_AmbTempAP_C Lookup1D_X_FLOAT32_IEEE 0 POD_AntiPinch_CM_single 10 -3.4E+38 3.4E+38 /end AXIS_PTS
/begin CHARACTERISTIC k_ADP_Value_BatVoltageCOCCurrentFactor "" CURVE 0xb0006274 /* @ECU_Address@k_ADP_Value_BatVoltageCOCCurrentFactor@ */ Lookup1D_FLOAT32_IEEE 0 POD_AntiPinch_CM_single -3.4E+38 3.4E+38
 /begin AXIS_DESCR COM_AXIS monr_ADP_Value_BatVoltaget_DiffLAP POD_AntiPinch_CM_single 15 -3.4E+38 3.4E+38 AXIS_PTS_REF k_ADP_Value_BatVoltageCOCCurrentOffset /end AXIS_DESCR
/end CHARACTERISTIC
/begin AXIS_PTS k_ADP_Value_BatVoltageCOCCurrentOffset "" 0x807732b0 /* @ECU_Address@k_ADP_Value_BatVoltageCOCCurrentOffset@ */ monr_ADP_Value_BatVoltaget_DiffLAP Lookup1D_X_FLOAT32_IEEE 0 POD_AntiPinch_CM_single 15 -3.4E+38 3.4E+38 /end AXIS_PTS
/begin CHARACTERISTIC k_ADP_Value_AmbTrawCOCCurrentFactor "" CURVE 0xb00061d4 /* @ECU_Address@k_ADP_Value_AmbTrawCOCCurrentFactor@ */ Lookup1D_FLOAT32_IEEE 0 POD_AntiPinch_CM_single -3.4E+38 3.4E+38
 /begin AXIS_DESCR COM_AXIS monr_VfSHM_AmbTempAP_C POD_AntiPinch_CM_single 10 -3.4E+38 3.4E+38 AXIS_PTS_REF k_ADP_Value_AmbTrawBP /end AXIS_DESCR
/end CHARACTERISTIC
/begin CHARACTERISTIC k_ADP_Value_PosErrHoldRateforAntiPinch "" CURVE 0xb0006334 /* @ECU_Address@k_ADP_Value_PosErrHoldRateforAntiPinch@ */ Lookup1D_FLOAT32_IEEE 0 POD_AntiPinch_CM_single -3.4E+38 3.4E+38
 /begin AXIS_DESCR COM_AXIS monr_VfMCM_ldlToAntipinchLAP_MA POD_AntiPinch_CM_single 8 -3.4E+38 3.4E+38 AXIS_PTS_REF k_ADP_Value_ElecComBreakPoints /end AXIS_DESCR
/end CHARACTERISTIC
/begin CHARACTERISTIC K_ADP_Value_CurDiffAntiPinchforMinPntClose "" VALUE 0xb0006cf0 /* @ECU_Address@K_ADP_Value_CurDiffAntiPinchforMinPntClose@ */ Scalar_FLOAT32_IEEE 0 POD_AntiPinch_CM_single -3.4E+38 3.4E+38 /end CHARACTERISTIC
/begin CHARACTERISTIC K_ADP_Value_ErrPositionDiffMin "" VALUE 0xb0006d14 /* @ECU_Address@K_ADP_Value_ErrPositionDiffMin@ */ Scalar_FLOAT32_IEEE 0 POD_AntiPinch_CM_single -3.4E+38 3.4E+38 /end CHARACTERISTIC
/begin CHARACTERISTIC K_ADP_Value_MainMotoCurrentMaxDiff "" VALUE 0xb0006d18 /* @ECU_Address@K_ADP_Value_MainMotoCurrentMaxDiff@ */ Scalar_FLOAT32_IEEE 0 POD_AntiPinch_CM_single -3.4E+38 3.4E+38 /end CHARACTERISTIC
/begin CHARACTERISTIC k_ADP_Ti_AllowforAntiPinchTimer "" VALUE 0xb0006100 /* @ECU_Address@k_ADP_Ti_AllowforAntiPinchTimer@ */ Scalar_FLOAT32_IEEE 0 POD_AntiPinch_CM_single -3.4E+38 3.4E+38 /end CHARACTERISTIC
/begin CHARACTERISTIC k_ADP_Ti_AntiPinchCloseSpeedPerStartTimer "" VALUE 0xb0006104 /* @ECU_Address@k_ADP_Ti_AntiPinchCloseSpeedPerStartTimer@ */ Scalar_FLOAT32_IEEE 0 POD_AntiPinch_CM_single -3.4E+38 3.4E+38 /end CHARACTERISTIC
/begin CHARACTERISTIC k_ADP_Ti_AntiPinchHoldingTimer "" VALUE 0xb000610c /* @ECU_Address@k_ADP_Ti_AntiPinchHoldingTimer@ */ Scalar_FLOAT32_IEEE 0 POD_AntiPinch_CM_single -3.4E+38 3.4E+38 /end CHARACTERISTIC
/begin CHARACTERISTIC k_ADP_Ti_AntiPinchOpenSpeedPerStartTimer "" VALUE 0xb0006114 /* @ECU_Address@k_ADP_Ti_AntiPinchOpenSpeedPerStartTimer@ */ Scalar_FLOAT32_IEEE 0 POD_AntiPinch_CM_single -3.4E+38 3.4E+38 /end CHARACTERISTIC
/begin CHARACTERISTIC k_ADP_Ti_AntiPinchSequenceTimer "" VALUE 0xb0006118 /* @ECU_Address@k_ADP_Ti_AntiPinchSequenceTimer@ */ Scalar_FLOAT32_IEEE 0 POD_AntiPinch_CM_single -3.4E+38 3.4E+38 /end CHARACTERISTIC
/begin CHARACTERISTIC k_ADP_Ti_AntiPinchforMinErrPositionDelayTimer "" VALUE 0xb0006108 /* @ECU_Address@k_ADP_Ti_AntiPinchforMinErrPositionDelayTimer@ */ Scalar_FLOAT32_IEEE 0 POD_AntiPinch_CM_single -3.4E+38 3.4E+38 /end CHARACTERISTIC
/begin CHARACTERISTIC k_ADP_Ti_CurAntiPinchforMinPntCloseDelayTimer "" VALUE 0xb0006120 /* @ECU_Address@k_ADP_Ti_CurAntiPinchforMinPntCloseDelayTimer@ */ Scalar_FLOAT32_IEEE 0 POD_AntiPinch_CM_single -3.4E+38 3.4E+38 /end CHARACTERISTIC
/begin CHARACTERISTIC k_ADP_Ti_CurAntiPinchforMinPntCloseStartTimer "" VALUE 0xb0006124 /* @ECU_Address@k_ADP_Ti_CurAntiPinchforMinPntCloseStartTimer@ */ Scalar_FLOAT32_IEEE 0 POD_AntiPinch_CM_single -3.4E+38 3.4E+38 /end CHARACTERISTIC
/begin CHARACTERISTIC k_ADP_Ti_CurrentIncreaseTimer "" VALUE 0xb0006128 /* @ECU_Address@k_ADP_Ti_CurrentIncreaseTimer@ */ Scalar_FLOAT32_IEEE 0 POD_AntiPinch_CM_single -3.4E+38 3.4E+38 /end CHARACTERISTIC
/begin CHARACTERISTIC k_ADP_Ti_DieMinimumSpeedJudgeTimer "" VALUE 0xb000612c /* @ECU_Address@k_ADP_Ti_DieMinimumSpeedJudgeTimer@ */ Scalar_FLOAT32_IEEE 0 POD_AntiPinch_CM_single -3.4E+38 3.4E+38 /end CHARACTERISTIC
/begin CHARACTERISTIC k_ADP_Ti_MinPositionDelayTimer "" VALUE 0xb0006130 /* @ECU_Address@k_ADP_Ti_MinPositionDelayTimer@ */ Scalar_FLOAT32_IEEE 0 POD_AntiPinch_CM_single -3.4E+38 3.4E+38 /end CHARACTERISTIC
/begin CHARACTERISTIC k_ADP_Ti_RefCurrResTimer "" VALUE 0xb0006134 /* @ECU_Address@k_ADP_Ti_RefCurrResTimer@ */ Scalar_FLOAT32_IEEE 0 POD_AntiPinch_CM_single -3.4E+38 3.4E+38 /end CHARACTERISTIC
/begin CHARACTERISTIC k_ADP_Ti_StateRunDelayTimer "" VALUE 0xb0006138 /* @ECU_Address@k_ADP_Ti_StateRunDelayTimer@ */ Scalar_FLOAT32_IEEE 0 POD_AntiPinch_CM_single -3.4E+38 3.4E+38 /end CHARACTERISTIC
/begin CHARACTERISTIC k_ADP_Value_CalCurrentLimitBasicAntiPinch "" VALUE 0xb0006140 /* @ECU_Address@k_ADP_Value_CalCurrentLimitBasicAntiPinch@ */ Scalar_FLOAT32_IEEE 0 POD_AntiPinch_CM_single -3.4E+38 3.4E+38 /end CHARACTERISTIC
/begin CHARACTERISTIC k_ADP_Value_CurrentCompensateLimitMax "" VALUE 0xb0006144 /* @ECU_Address@k_ADP_Value_CurrentCompensateLimitMax@ */ Scalar_FLOAT32_IEEE 0 POD_AntiPinch_CM_single -3.4E+38 3.4E+38 /end CHARACTERISTIC
/begin CHARACTERISTIC k_ADP_Value_CurrentIncMinRateforAntiPinch "" VALUE 0xb0006148 /* @ECU_Address@k_ADP_Value_CurrentIncMinRateforAntiPinch@ */ Scalar_FLOAT32_IEEE 0 POD_AntiPinch_CM_single -3.4E+38 3.4E+38 /end CHARACTERISTIC
/begin CHARACTERISTIC k_ADP_Value_CurrentLimitClose "" VAL_BLK 0xb00062ec /* @ECU_Address@k_ADP_Value_CurrentLimitClose@ */ Scalar_FLOAT32_IEEE 0 POD_AntiPinch_CM_single -3.4E+38 3.4E+38 NUMBER 5 /end CHARACTERISTIC
/begin CHARACTERISTIC k_ADP_Value_CurrentLimitMinPntClose "" VALUE 0xb000614c /* @ECU_Address@k_ADP_Value_CurrentLimitMinPntClose@ */ Scalar_FLOAT32_IEEE 0 POD_AntiPinch_CM_single -3.4E+38 3.4E+38 /end CHARACTERISTIC
/begin CHARACTERISTIC k_ADP_Value_CurrentLimitOpen "" VAL_BLK 0xb0006300 /* @ECU_Address@k_ADP_Value_CurrentLimitOpen@ */ Scalar_FLOAT32_IEEE 0 POD_AntiPinch_CM_single -3.4E+38 3.4E+38 NUMBER 5 /end CHARACTERISTIC
/begin CHARACTERISTIC k_ADP_Value_CurrentMinRefDiffforAntiPinch "" VALUE 0xb0006150 /* @ECU_Address@k_ADP_Value_CurrentMinRefDiffforAntiPinch@ */ Scalar_FLOAT32_IEEE 0 POD_AntiPinch_CM_single -3.4E+38 3.4E+38 /end CHARACTERISTIC
/begin CHARACTERISTIC k_ADP_Value_ErrPosCurMinRateforAntiPinch "" VALUE 0xb0006160 /* @ECU_Address@k_ADP_Value_ErrPosCurMinRateforAntiPinch@ */ Scalar_FLOAT32_IEEE 0 POD_AntiPinch_CM_single -3.4E+38 3.4E+38 /end CHARACTERISTIC
/begin CHARACTERISTIC k_ADP_Value_PIDPosRateforAntiPinch "" VALUE 0xb0006164 /* @ECU_Address@k_ADP_Value_PIDPosRateforAntiPinch@ */ Scalar_FLOAT32_IEEE 0 POD_AntiPinch_CM_single -3.4E+38 3.4E+38 /end CHARACTERISTIC
/begin CHARACTERISTIC k_ADP_Value_RefCurrentLimitMax "" VALUE 0xb0006168 /* @ECU_Address@k_ADP_Value_RefCurrentLimitMax@ */ Scalar_FLOAT32_IEEE 0 POD_AntiPinch_CM_single -3.4E+38 3.4E+38 /end CHARACTERISTIC
/begin CHARACTERISTIC k_ADP_Value_ThresholdValueOfPosition "" VALUE 0xb000616c /* @ECU_Address@k_ADP_Value_ThresholdValueOfPosition@ */ Scalar_FLOAT32_IEEE 0 POD_AntiPinch_CM_single -3.4E+38 3.4E+38 /end CHARACTERISTIC
/begin CHARACTERISTIC k_ADP_Value_AllowRelPositionforAntiPinch "" VALUE 0xb000613c /* @ECU_Address@k_ADP_Value_AllowRelPositionforAntiPinch@ */ Scalar_SWORD 0 POD_AntiPinch_CM_int16 -32768 32767 /end CHARACTERISTIC
/begin CHARACTERISTIC k_ADP_Value_CurrentMinRefHallSpeedforAntiPinch "" VALUE 0xb0006154 /* @ECU_Address@k_ADP_Value_CurrentMinRefHallSpeedforAntiPinch@ */ Scalar_SWORD 0 POD_AntiPinch_CM_int16 -32768 32767 /end CHARACTERISTIC
/begin CHARACTERISTIC k_ADP_Value_CurrentMinRefPntDiffforAntiPinch "" VALUE 0xb0006156 /* @ECU_Address@k_ADP_Value_CurrentMinRefPntDiffforAntiPinch@ */ Scalar_SWORD 0 POD_AntiPinch_CM_int16 -32768 32767 /end CHARACTERISTIC
/begin CHARACTERISTIC k_ADP_Value_CurrentMinRefPntforAntiPinch "" VALUE 0xb0006158 /* @ECU_Address@k_ADP_Value_CurrentMinRefPntforAntiPinch@ */ Scalar_SWORD 0 POD_AntiPinch_CM_int16 -32768 32767 /end CHARACTERISTIC
/begin CHARACTERISTIC k_ADP_Value_CurrentRefPositionDiffforAntiPinch "" VALUE 0xb000615a /* @ECU_Address@k_ADP_Value_CurrentRefPositionDiffforAntiPinch@ */ Scalar_SWORD 0 POD_AntiPinch_CM_int16 -32768 32767 /end CHARACTERISTIC
/begin CHARACTERISTIC k_ADP_Value_CurrentRefPositionforAntiPinch "" VALUE 0xb000615c /* @ECU_Address@k_ADP_Value_CurrentRefPositionforAntiPinch@ */ Scalar_SWORD 0 POD_AntiPinch_CM_int16 -32768 32767 /end CHARACTERISTIC
/begin CHARACTERISTIC k_ADP_Value_DieMinimumSpeedforAntiPinch "" VALUE 0xb000615e /* @ECU_Address@k_ADP_Value_DieMinimumSpeedforAntiPinch@ */ Scalar_SWORD 0 POD_AntiPinch_CM_int16 -32768 32767 /end CHARACTERISTIC
/begin CHARACTERISTIC k_ADP_Boolean_APHDEnable "" VALUE 0xb00060fc /* @ECU_Address@k_ADP_Boolean_APHDEnable@ */ Scalar_BOOLEAN 0 POD_AntiPinch_CM_boolean 0 1 /end CHARACTERISTIC
/begin CHARACTERISTIC k_ADP_Boolean_Value "防夹标志强标值" VALUE 0xb0006099 /* @ECU_Address@k_ADP_Boolean_Value@ */ Scalar_BOOLEAN 0 POD_AntiPinch_CM_boolean 0 1 /end CHARACTERISTIC
/begin CHARACTERISTIC k_ADP_Boolean_flg "防夹标志强标使能" VALUE 0xb0006098 /* @ECU_Address@k_ADP_Boolean_flg@ */ Scalar_BOOLEAN 0 POD_AntiPinch_CM_boolean 0 1 /end CHARACTERISTIC
/begin MEASUREMENT monr_VfSHM_MainMotoCurrentLAP_MA "" FLOAT32_IEEE POD_AntiPinch_CM_single 0 0 -3.4E+38 3.4E+38 ECU_ADDRESS 0xb005595c /* @ECU_Address@monr_VfSHM_MainMotoCurrentLAP_MA@ */ /end MEASUREMENT
/begin MEASUREMENT monr_VfMCM_TarPosLAP_NULL "" FLOAT32_IEEE POD_AntiPinch_CM_single 0 0 -3.4E+38 3.4E+38 ECU_ADDRESS 0xb005593c /* @ECU_Address@monr_VfMCM_TarPosLAP_NULL@ */ /end MEASUREMENT
/begin MEASUREMENT monr_ADP_Value_ErrPositionLAP "" FLOAT32_IEEE POD_AntiPinch_CM_single 0 0 -3.4E+38 3.4E+38 ECU_ADDRESS 0xb0055894 /* @ECU_Address@monr_ADP_Value_ErrPositionLAP@ */ /end MEASUREMENT
/begin MEASUREMENT monr_VfMCM_ldlToAntipinchLAP_MA "" FLOAT32_IEEE POD_AntiPinch_CM_single 0 0 -3.4E+38 3.4E+38 ECU_ADDRESS 0xb0055924 /* @ECU_Address@monr_VfMCM_ldlToAntipinchLAP_MA@ */ /end MEASUREMENT
/begin MEASUREMENT monr_ADP_PIDErrPosLAP "" FLOAT32_IEEE POD_AntiPinch_CM_single 0 0 -3.4E+38 3.4E+38 ECU_ADDRESS 0xb005587c /* @ECU_Address@monr_ADP_PIDErrPosLAP@ */ /end MEASUREMENT
/begin MEASUREMENT monr_VfAP_ValueMainMotoCurrentBaseLAP_MA "" FLOAT32_IEEE POD_AntiPinch_CM_single 0 0 -3.4E+38 3.4E+38 ECU_ADDRESS 0xb00558cc /* @ECU_Address@monr_VfAP_ValueMainMotoCurrentBaseLAP_MA@ */ /end MEASUREMENT
/begin MEASUREMENT monr_ADP_Value_MainMotoCurrent_DiffLAP "" FLOAT32_IEEE POD_AntiPinch_CM_single 0 0 -3.4E+38 3.4E+38 ECU_ADDRESS 0xb005589c /* @ECU_Address@monr_ADP_Value_MainMotoCurrent_DiffLAP@ */ /end MEASUREMENT
/begin MEASUREMENT monr_ADP_Value_ErrPosition_DiffLAP "" FLOAT32_IEEE POD_AntiPinch_CM_single 0 0 -3.4E+38 3.4E+38 ECU_ADDRESS 0xb005588c /* @ECU_Address@monr_ADP_Value_ErrPosition_DiffLAP@ */ /end MEASUREMENT
/begin MEASUREMENT monr_VfMCM_MotorCtrlDutyLAP_NULL "" FLOAT32_IEEE POD_AntiPinch_CM_single 0 0 -3.4E+38 3.4E+38 ECU_ADDRESS 0xb0055934 /* @ECU_Address@monr_VfMCM_MotorCtrlDutyLAP_NULL@ */ /end MEASUREMENT
/begin MEASUREMENT monr_VfAP_ValueReferenceCurrentLAP_MA "" FLOAT32_IEEE POD_AntiPinch_CM_single 0 0 -3.4E+38 3.4E+38 ECU_ADDRESS 0xb00558dc /* @ECU_Address@monr_VfAP_ValueReferenceCurrentLAP_MA@ */ /end MEASUREMENT
/begin MEASUREMENT monr_VfAP_ValueSlopeCompenLAP_MA "" FLOAT32_IEEE POD_AntiPinch_CM_single 0 0 -3.4E+38 3.4E+38 ECU_ADDRESS 0xb00558ec /* @ECU_Address@monr_VfAP_ValueSlopeCompenLAP_MA@ */ /end MEASUREMENT
/begin MEASUREMENT monr_VfAP_ValueBrkgCompenLAP_MA "" FLOAT32_IEEE POD_AntiPinch_CM_single 0 0 -3.4E+38 3.4E+38 ECU_ADDRESS 0xb00558bc /* @ECU_Address@monr_VfAP_ValueBrkgCompenLAP_MA@ */ /end MEASUREMENT
/begin MEASUREMENT monr_VfAP_ValueReferenceCurrentCmpLAP_MA "" FLOAT32_IEEE POD_AntiPinch_CM_single 0 0 -3.4E+38 3.4E+38 ECU_ADDRESS 0xb00558d4 /* @ECU_Address@monr_VfAP_ValueReferenceCurrentCmpLAP_MA@ */ /end MEASUREMENT
/begin MEASUREMENT monr_VfAP_ValueReferenceCurrentSumLAP_MA "" FLOAT32_IEEE POD_AntiPinch_CM_single 0 0 -3.4E+38 3.4E+38 ECU_ADDRESS 0xb00558e4 /* @ECU_Address@monr_VfAP_ValueReferenceCurrentSumLAP_MA@ */ /end MEASUREMENT
/begin MEASUREMENT monr_VfSHM_BatVoltageValueAP_MV "" FLOAT32_IEEE POD_AntiPinch_CM_single 0 0 -3.4E+38 3.4E+38 ECU_ADDRESS 0xb0055950 /* @ECU_Address@monr_VfSHM_BatVoltageValueAP_MV@ */ /end MEASUREMENT
/begin MEASUREMENT monr_VfAP_ValueBatVoltagetBaseLAP_MV "" FLOAT32_IEEE POD_AntiPinch_CM_single 0 0 -3.4E+38 3.4E+38 ECU_ADDRESS 0xb00558b4 /* @ECU_Address@monr_VfAP_ValueBatVoltagetBaseLAP_MV@ */ /end MEASUREMENT
/begin MEASUREMENT monr_ADP_Value_BatVoltaget_DiffLAP "" FLOAT32_IEEE POD_AntiPinch_CM_single 0 0 -3.4E+38 3.4E+38 ECU_ADDRESS 0xb0055884 /* @ECU_Address@monr_ADP_Value_BatVoltaget_DiffLAP@ */ /end MEASUREMENT
/begin MEASUREMENT monr_VfSHM_AmbTempAP_C "" FLOAT32_IEEE POD_AntiPinch_CM_single 0 0 -3.4E+38 3.4E+38 ECU_ADDRESS 0xb005594c /* @ECU_Address@monr_VfSHM_AmbTempAP_C@ */ /end MEASUREMENT
/begin MEASUREMENT monr_VfAP_ValueCurrentCmpLAP_MA "" FLOAT32_IEEE POD_AntiPinch_CM_single 0 0 -3.4E+38 3.4E+38 ECU_ADDRESS 0xb00558c4 /* @ECU_Address@monr_VfAP_ValueCurrentCmpLAP_MA@ */ /end MEASUREMENT
/begin MEASUREMENT monr_VfAP_ValueTriggMotCurAddLAP_MA "" FLOAT32_IEEE POD_AntiPinch_CM_single 0 0 -3.4E+38 3.4E+38 ECU_ADDRESS 0xb00558f4 /* @ECU_Address@monr_VfAP_ValueTriggMotCurAddLAP_MA@ */ /end MEASUREMENT
/begin MEASUREMENT monr_VfSHM_MainMotoCurrentRAP_MA "" FLOAT32_IEEE POD_AntiPinch_CM_single 0 0 -3.4E+38 3.4E+38 ECU_ADDRESS 0xb0055960 /* @ECU_Address@monr_VfSHM_MainMotoCurrentRAP_MA@ */ /end MEASUREMENT
/begin MEASUREMENT monr_VfMCM_TarPosRAP_NULL "" FLOAT32_IEEE POD_AntiPinch_CM_single 0 0 -3.4E+38 3.4E+38 ECU_ADDRESS 0xb0055940 /* @ECU_Address@monr_VfMCM_TarPosRAP_NULL@ */ /end MEASUREMENT
/begin MEASUREMENT monr_ADP_Value_ErrPositionRAP "" FLOAT32_IEEE POD_AntiPinch_CM_single 0 0 -3.4E+38 3.4E+38 ECU_ADDRESS 0xb0055898 /* @ECU_Address@monr_ADP_Value_ErrPositionRAP@ */ /end MEASUREMENT
/begin MEASUREMENT monr_VfMCM_ldlToAntipinchRAP_MA "" FLOAT32_IEEE POD_AntiPinch_CM_single 0 0 -3.4E+38 3.4E+38 ECU_ADDRESS 0xb0055928 /* @ECU_Address@monr_VfMCM_ldlToAntipinchRAP_MA@ */ /end MEASUREMENT
/begin MEASUREMENT monr_ADP_PIDErrPosRAP "" FLOAT32_IEEE POD_AntiPinch_CM_single 0 0 -3.4E+38 3.4E+38 ECU_ADDRESS 0xb0055880 /* @ECU_Address@monr_ADP_PIDErrPosRAP@ */ /end MEASUREMENT
/begin MEASUREMENT monr_VfAP_ValueMainMotoCurrentBaseRAP_MA "" FLOAT32_IEEE POD_AntiPinch_CM_single 0 0 -3.4E+38 3.4E+38 ECU_ADDRESS 0xb00558d0 /* @ECU_Address@monr_VfAP_ValueMainMotoCurrentBaseRAP_MA@ */ /end MEASUREMENT
/begin MEASUREMENT monr_ADP_Value_MainMotoCurrent_DiffRAP "" FLOAT32_IEEE POD_AntiPinch_CM_single 0 0 -3.4E+38 3.4E+38 ECU_ADDRESS 0xb00558a0 /* @ECU_Address@monr_ADP_Value_MainMotoCurrent_DiffRAP@ */ /end MEASUREMENT
/begin MEASUREMENT monr_ADP_Value_ErrPosition_DiffRAP "" FLOAT32_IEEE POD_AntiPinch_CM_single 0 0 -3.4E+38 3.4E+38 ECU_ADDRESS 0xb0055890 /* @ECU_Address@monr_ADP_Value_ErrPosition_DiffRAP@ */ /end MEASUREMENT
/begin MEASUREMENT monr_VfMCM_MotorCtrlDutyRAP_NULL "" FLOAT32_IEEE POD_AntiPinch_CM_single 0 0 -3.4E+38 3.4E+38 ECU_ADDRESS 0xb0055938 /* @ECU_Address@monr_VfMCM_MotorCtrlDutyRAP_NULL@ */ /end MEASUREMENT
/begin MEASUREMENT monr_VfAP_ValueReferenceCurrentRAP_MA "" FLOAT32_IEEE POD_AntiPinch_CM_single 0 0 -3.4E+38 3.4E+38 ECU_ADDRESS 0xb00558e0 /* @ECU_Address@monr_VfAP_ValueReferenceCurrentRAP_MA@ */ /end MEASUREMENT
/begin MEASUREMENT monr_VfAP_ValueSlopeCompenRAP_MA "" FLOAT32_IEEE POD_AntiPinch_CM_single 0 0 -3.4E+38 3.4E+38 ECU_ADDRESS 0xb00558f0 /* @ECU_Address@monr_VfAP_ValueSlopeCompenRAP_MA@ */ /end MEASUREMENT
/begin MEASUREMENT monr_VfAP_ValueBrkgCompenRAP_MA "" FLOAT32_IEEE POD_AntiPinch_CM_single 0 0 -3.4E+38 3.4E+38 ECU_ADDRESS 0xb00558c0 /* @ECU_Address@monr_VfAP_ValueBrkgCompenRAP_MA@ */ /end MEASUREMENT
/begin MEASUREMENT monr_VfAP_ValueReferenceCurrentCmpRAP_MA "" FLOAT32_IEEE POD_AntiPinch_CM_single 0 0 -3.4E+38 3.4E+38 ECU_ADDRESS 0xb00558d8 /* @ECU_Address@monr_VfAP_ValueReferenceCurrentCmpRAP_MA@ */ /end MEASUREMENT
/begin MEASUREMENT monr_VfAP_ValueReferenceCurrentSumRAP_MA "" FLOAT32_IEEE POD_AntiPinch_CM_single 0 0 -3.4E+38 3.4E+38 ECU_ADDRESS 0xb00558e8 /* @ECU_Address@monr_VfAP_ValueReferenceCurrentSumRAP_MA@ */ /end MEASUREMENT
/begin MEASUREMENT monr_VfAP_ValueBatVoltagetBaseRAP_MV "" FLOAT32_IEEE POD_AntiPinch_CM_single 0 0 -3.4E+38 3.4E+38 ECU_ADDRESS 0xb00558b8 /* @ECU_Address@monr_VfAP_ValueBatVoltagetBaseRAP_MV@ */ /end MEASUREMENT
/begin MEASUREMENT monr_ADP_Value_BatVoltaget_DiffRAP "" FLOAT32_IEEE POD_AntiPinch_CM_single 0 0 -3.4E+38 3.4E+38 ECU_ADDRESS 0xb0055888 /* @ECU_Address@monr_ADP_Value_BatVoltaget_DiffRAP@ */ /end MEASUREMENT
/begin MEASUREMENT monr_VfAP_ValueCurrentCmpRAP_MA "" FLOAT32_IEEE POD_AntiPinch_CM_single 0 0 -3.4E+38 3.4E+38 ECU_ADDRESS 0xb00558c8 /* @ECU_Address@monr_VfAP_ValueCurrentCmpRAP_MA@ */ /end MEASUREMENT
/begin MEASUREMENT monr_VfAP_ValueTriggMotCurAddRAP_MA "" FLOAT32_IEEE POD_AntiPinch_CM_single 0 0 -3.4E+38 3.4E+38 ECU_ADDRESS 0xb00558f8 /* @ECU_Address@monr_VfAP_ValueTriggMotCurAddRAP_MA@ */ /end MEASUREMENT
/begin MEASUREMENT monr_VfMCM_TarSpdLAP_NULL "" FLOAT32_IEEE POD_AntiPinch_CM_single 0 0 -3.4E+38 3.4E+38 ECU_ADDRESS 0xb0055944 /* @ECU_Address@monr_VfMCM_TarSpdLAP_NULL@ */ /end MEASUREMENT
/begin MEASUREMENT monr_VfMCM_TarSpdRAP_NULL "" FLOAT32_IEEE POD_AntiPinch_CM_single 0 0 -3.4E+38 3.4E+38 ECU_ADDRESS 0xb0055948 /* @ECU_Address@monr_VfMCM_TarSpdRAP_NULL@ */ /end MEASUREMENT
/begin MEASUREMENT monr_VfIMU_AgSpdLAP_degps "" FLOAT32_IEEE POD_AntiPinch_CM_single 0 0 -3.4E+38 3.4E+38 ECU_ADDRESS 0xb0055914 /* @ECU_Address@monr_VfIMU_AgSpdLAP_degps@ */ /end MEASUREMENT
/begin MEASUREMENT monr_VfIMU_AgSpdRAP_degps "" FLOAT32_IEEE POD_AntiPinch_CM_single 0 0 -3.4E+38 3.4E+38 ECU_ADDRESS 0xb0055918 /* @ECU_Address@monr_VfIMU_AgSpdRAP_degps@ */ /end MEASUREMENT
/begin MEASUREMENT monr_VfMCM_lrefToAntipinchLAP_MA "" FLOAT32_IEEE POD_AntiPinch_CM_single 0 0 -3.4E+38 3.4E+38 ECU_ADDRESS 0xb005592c /* @ECU_Address@monr_VfMCM_lrefToAntipinchLAP_MA@ */ /end MEASUREMENT
/begin MEASUREMENT monr_VfMCM_lrefToAntipinchRAP_MA "" FLOAT32_IEEE POD_AntiPinch_CM_single 0 0 -3.4E+38 3.4E+38 ECU_ADDRESS 0xb0055930 /* @ECU_Address@monr_VfMCM_lrefToAntipinchRAP_MA@ */ /end MEASUREMENT
/begin MEASUREMENT monr_VfMCM_BrakingTorqueLAP_NULL "" FLOAT32_IEEE POD_AntiPinch_CM_single 0 0 -3.4E+38 3.4E+38 ECU_ADDRESS 0xb005591c /* @ECU_Address@monr_VfMCM_BrakingTorqueLAP_NULL@ */ /end MEASUREMENT
/begin MEASUREMENT monr_VfMCM_BrakingTorqueRAP_NULL "" FLOAT32_IEEE POD_AntiPinch_CM_single 0 0 -3.4E+38 3.4E+38 ECU_ADDRESS 0xb0055920 /* @ECU_Address@monr_VfMCM_BrakingTorqueRAP_NULL@ */ /end MEASUREMENT
/begin MEASUREMENT monr_VfSHM_VehSpdLgtAP_mps "" FLOAT32_IEEE POD_AntiPinch_CM_single 0 0 -3.4E+38 3.4E+38 ECU_ADDRESS 0xb005596c /* @ECU_Address@monr_VfSHM_VehSpdLgtAP_mps@ */ /end MEASUREMENT
/begin MEASUREMENT monr_VfSHM_FrntIncinAgLAP_deg "" FLOAT32_IEEE POD_AntiPinch_CM_single 0 0 -3.4E+38 3.4E+38 ECU_ADDRESS 0xb0055954 /* @ECU_Address@monr_VfSHM_FrntIncinAgLAP_deg@ */ /end MEASUREMENT
/begin MEASUREMENT monr_VfSHM_FrntIncinAgRAP_deg "" FLOAT32_IEEE POD_AntiPinch_CM_single 0 0 -3.4E+38 3.4E+38 ECU_ADDRESS 0xb0055958 /* @ECU_Address@monr_VfSHM_FrntIncinAgRAP_deg@ */ /end MEASUREMENT
/begin MEASUREMENT monr_VfSHM_SideIncinAgLAP_deg "" FLOAT32_IEEE POD_AntiPinch_CM_single 0 0 -3.4E+38 3.4E+38 ECU_ADDRESS 0xb0055964 /* @ECU_Address@monr_VfSHM_SideIncinAgLAP_deg@ */ /end MEASUREMENT
/begin MEASUREMENT monr_VfSHM_SideIncinAgRAP_deg "" FLOAT32_IEEE POD_AntiPinch_CM_single 0 0 -3.4E+38 3.4E+38 ECU_ADDRESS 0xb0055968 /* @ECU_Address@monr_VfSHM_SideIncinAgRAP_deg@ */ /end MEASUREMENT
/begin MEASUREMENT monr_VuHHM_HallPWMLAP_Hz "" UWORD POD_AntiPinch_CM_uint16 0 0 0 65535 ECU_ADDRESS 0xb005597c /* @ECU_Address@monr_VuHHM_HallPWMLAP_Hz@ */ /end MEASUREMENT
/begin MEASUREMENT monr_VuHHM_HallPWMRAP_Hz "" UWORD POD_AntiPinch_CM_uint16 0 0 0 65535 ECU_ADDRESS 0xb005597e /* @ECU_Address@monr_VuHHM_HallPWMRAP_Hz@ */ /end MEASUREMENT
/begin MEASUREMENT monr_VsHHM_AswHallPositionLAP_NULL "" SWORD POD_AntiPinch_CM_int16 0 0 -32768 32767 ECU_ADDRESS 0xb0055974 /* @ECU_Address@monr_VsHHM_AswHallPositionLAP_NULL@ */ /end MEASUREMENT
/begin MEASUREMENT monr_VsHHM_AswHallSpeedLAP_rpm "" SWORD POD_AntiPinch_CM_int16 0 0 -32768 32767 ECU_ADDRESS 0xb0055978 /* @ECU_Address@monr_VsHHM_AswHallSpeedLAP_rpm@ */ /end MEASUREMENT
/begin MEASUREMENT monr_VsHHM_AntiPinchHallPositionLAP_NULL "" SWORD POD_AntiPinch_CM_int16 0 0 -32768 32767 ECU_ADDRESS 0xb0055970 /* @ECU_Address@monr_VsHHM_AntiPinchHallPositionLAP_NULL@ */ /end MEASUREMENT
/begin MEASUREMENT monr_VsHHM_AswHallPositionRAP_NULL "" SWORD POD_AntiPinch_CM_int16 0 0 -32768 32767 ECU_ADDRESS 0xb0055976 /* @ECU_Address@monr_VsHHM_AswHallPositionRAP_NULL@ */ /end MEASUREMENT
/begin MEASUREMENT monr_VsHHM_AswHallSpeedRAP_rpm "" SWORD POD_AntiPinch_CM_int16 0 0 -32768 32767 ECU_ADDRESS 0xb005597a /* @ECU_Address@monr_VsHHM_AswHallSpeedRAP_rpm@ */ /end MEASUREMENT
/begin MEASUREMENT monr_VsHHM_AntiPinchHallPositionRAP_NULL "" SWORD POD_AntiPinch_CM_int16 0 0 -32768 32767 ECU_ADDRESS 0xb0055972 /* @ECU_Address@monr_VsHHM_AntiPinchHallPositionRAP_NULL@ */ /end MEASUREMENT
/begin MEASUREMENT monr_VeSMM_MotorCtrlStateLAP_enum "" UBYTE POD_AntiPinch_CM_uint8 0 0 0 255 ECU_ADDRESS 0xb0055910 /* @ECU_Address@monr_VeSMM_MotorCtrlStateLAP_enum@ */ /end MEASUREMENT
/begin MEASUREMENT monr_VeSMM_MotorCtrlModeLAP_enum "" UBYTE POD_AntiPinch_CM_uint8 0 0 0 255 ECU_ADDRESS 0xb005590e /* @ECU_Address@monr_VeSMM_MotorCtrlModeLAP_enum@ */ /end MEASUREMENT
/begin MEASUREMENT monr_VeSMM_DOPFcnStateLAP_enum "" UBYTE POD_AntiPinch_CM_uint8 0 0 0 255 ECU_ADDRESS 0xb005590a /* @ECU_Address@monr_VeSMM_DOPFcnStateLAP_enum@ */ /end MEASUREMENT
/begin MEASUREMENT monr_VeSMM_StopEventLAP_enum "" UBYTE POD_AntiPinch_CM_uint8 0 0 0 255 ECU_ADDRESS 0xb0055912 /* @ECU_Address@monr_VeSMM_StopEventLAP_enum@ */ /end MEASUREMENT
/begin MEASUREMENT monr_VeHHM_SectorIndexLAP_enum "" UBYTE POD_AntiPinch_CM_uint8 0 0 0 255 ECU_ADDRESS 0xb0055906 /* @ECU_Address@monr_VeHHM_SectorIndexLAP_enum@ */ /end MEASUREMENT
/begin MEASUREMENT monr_VeSMM_MotorCtrlStateRAP_enum "" UBYTE POD_AntiPinch_CM_uint8 0 0 0 255 ECU_ADDRESS 0xb0055911 /* @ECU_Address@monr_VeSMM_MotorCtrlStateRAP_enum@ */ /end MEASUREMENT
/begin MEASUREMENT monr_VeSMM_MotorCtrlModeRAP_enum "" UBYTE POD_AntiPinch_CM_uint8 0 0 0 255 ECU_ADDRESS 0xb005590f /* @ECU_Address@monr_VeSMM_MotorCtrlModeRAP_enum@ */ /end MEASUREMENT
/begin MEASUREMENT monr_VeSMM_DOPFcnStateRAP_enum "" UBYTE POD_AntiPinch_CM_uint8 0 0 0 255 ECU_ADDRESS 0xb005590b /* @ECU_Address@monr_VeSMM_DOPFcnStateRAP_enum@ */ /end MEASUREMENT
/begin MEASUREMENT monr_VeSMM_StopEventRAP_enum "" UBYTE POD_AntiPinch_CM_uint8 0 0 0 255 ECU_ADDRESS 0xb0055913 /* @ECU_Address@monr_VeSMM_StopEventRAP_enum@ */ /end MEASUREMENT
/begin MEASUREMENT monr_VeHHM_SectorIndexRAP_enum "" UBYTE POD_AntiPinch_CM_uint8 0 0 0 255 ECU_ADDRESS 0xb0055907 /* @ECU_Address@monr_VeHHM_SectorIndexRAP_enum@ */ /end MEASUREMENT
/begin MEASUREMENT monr_VeSHM_DoorTypCfgAP_enum "" UBYTE POD_AntiPinch_CM_uint8 0 0 0 255 ECU_ADDRESS 0xb0055909 /* @ECU_Address@monr_VeSHM_DoorTypCfgAP_enum@ */ /end MEASUREMENT
/begin MEASUREMENT monr_VeSMM_HoverModCtrlLAP_enum "" UBYTE POD_AntiPinch_CM_uint8 0 0 0 255 ECU_ADDRESS 0xb005590c /* @ECU_Address@monr_VeSMM_HoverModCtrlLAP_enum@ */ /end MEASUREMENT
/begin MEASUREMENT monr_VeSMM_HoverModCtrlRAP_enum "" UBYTE POD_AntiPinch_CM_uint8 0 0 0 255 ECU_ADDRESS 0xb005590d /* @ECU_Address@monr_VeSMM_HoverModCtrlRAP_enum@ */ /end MEASUREMENT
/begin MEASUREMENT monr_VeFH_DoorLckPstnLAP_enum "" UBYTE POD_AntiPinch_CM_uint8 0 0 0 255 ECU_ADDRESS 0xb0055904 /* @ECU_Address@monr_VeFH_DoorLckPstnLAP_enum@ */ /end MEASUREMENT
/begin MEASUREMENT monr_VeFH_DoorLckPstnRAP_enum "" UBYTE POD_AntiPinch_CM_uint8 0 0 0 255 ECU_ADDRESS 0xb0055905 /* @ECU_Address@monr_VeFH_DoorLckPstnRAP_enum@ */ /end MEASUREMENT
/begin MEASUREMENT monr_VeSHM_CbnPressLvlAP_enum "" UBYTE POD_AntiPinch_CM_uint8 0 0 0 255 ECU_ADDRESS 0xb0055908 /* @ECU_Address@monr_VeSHM_CbnPressLvlAP_enum@ */ /end MEASUREMENT
/begin MEASUREMENT monr_VbHHM_DoorOpenLAP_flg "" UBYTE POD_AntiPinch_CM_boolean 0 0 0 1 ECU_ADDRESS 0xb0055900 /* @ECU_Address@monr_VbHHM_DoorOpenLAP_flg@ */ /end MEASUREMENT
/begin MEASUREMENT monr_VbAP_JudgeCurAntiPinchLAP_flg "" UBYTE POD_AntiPinch_CM_boolean 0 0 0 1 ECU_ADDRESS 0xb00558ab /* @ECU_Address@monr_VbAP_JudgeCurAntiPinchLAP_flg@ */ /end MEASUREMENT
/begin MEASUREMENT monr_ADP_ErrPosition_FlagLAP "" UBYTE POD_AntiPinch_CM_boolean 0 0 0 1 ECU_ADDRESS 0xb0055981 /* @ECU_Address@monr_ADP_ErrPosition_FlagLAP@ */ /end MEASUREMENT
/begin MEASUREMENT monr_VbAP_ReferenceCurrentResLAP_flg "" UBYTE POD_AntiPinch_CM_boolean 0 0 0 1 ECU_ADDRESS 0xb00558af /* @ECU_Address@monr_VbAP_ReferenceCurrentResLAP_flg@ */ /end MEASUREMENT
/begin MEASUREMENT monr_VbAP_ReferenceCurrentSetLAP_flg "" UBYTE POD_AntiPinch_CM_boolean 0 0 0 1 ECU_ADDRESS 0xb00558b1 /* @ECU_Address@monr_VbAP_ReferenceCurrentSetLAP_flg@ */ /end MEASUREMENT
/begin MEASUREMENT monr_VbAP_KeepReferenceCurrentLAP_flg "" UBYTE POD_AntiPinch_CM_boolean 0 0 0 1 ECU_ADDRESS 0xb00558ad /* @ECU_Address@monr_VbAP_KeepReferenceCurrentLAP_flg@ */ /end MEASUREMENT
/begin MEASUREMENT monr_VbAP_JudgeCurAntiPinchforMinPntCloseLAP_flg "" UBYTE POD_AntiPinch_CM_boolean 0 0 0 1 ECU_ADDRESS 0xb0055980 /* @ECU_Address@monr_VbAP_JudgeCurAntiPinchforMinPntCloseLAP_flg@ */ /end MEASUREMENT
/begin MEASUREMENT monr_VbAP_DiffJudgeDurNormrunLAP_flg "" UBYTE POD_AntiPinch_CM_boolean 0 0 0 1 ECU_ADDRESS 0xb00558a8 /* @ECU_Address@monr_VbAP_DiffJudgeDurNormrunLAP_flg@ */ /end MEASUREMENT
/begin MEASUREMENT monr_VbAP_CurrJudgeDurNormrunLAP_flg "" UBYTE POD_AntiPinch_CM_boolean 0 0 0 1 ECU_ADDRESS 0xb00558a6 /* @ECU_Address@monr_VbAP_CurrJudgeDurNormrunLAP_flg@ */ /end MEASUREMENT
/begin MEASUREMENT monr_VbAP_AntiPinchforMinPntCloseLAP_flg "" UBYTE POD_AntiPinch_CM_boolean 0 0 0 1 ECU_ADDRESS 0xb00558a4 /* @ECU_Address@monr_VbAP_AntiPinchforMinPntCloseLAP_flg@ */ /end MEASUREMENT
/begin MEASUREMENT monr_VbAP_AntiPinchStsDspL_flg "" UBYTE POD_AntiPinch_CM_boolean 0 0 0 1 ECU_ADDRESS 0xb00558fc /* @ECU_Address@monr_VbAP_AntiPinchStsDspL_flg@ */ /end MEASUREMENT
/begin MEASUREMENT monr_VbAP_Tip2RunAntiPinchL_flg "" UBYTE POD_AntiPinch_CM_boolean 0 0 0 1 ECU_ADDRESS 0xb00558fe /* @ECU_Address@monr_VbAP_Tip2RunAntiPinchL_flg@ */ /end MEASUREMENT
/begin MEASUREMENT monr_VbHHM_DoorOpenRAP_flg "" UBYTE POD_AntiPinch_CM_boolean 0 0 0 1 ECU_ADDRESS 0xb0055901 /* @ECU_Address@monr_VbHHM_DoorOpenRAP_flg@ */ /end MEASUREMENT
/begin MEASUREMENT monr_VbAP_JudgeCurAntiPinchRAP_flg "" UBYTE POD_AntiPinch_CM_boolean 0 0 0 1 ECU_ADDRESS 0xb00558ac /* @ECU_Address@monr_VbAP_JudgeCurAntiPinchRAP_flg@ */ /end MEASUREMENT
/begin MEASUREMENT monr_ADP_ErrPosition_FlagRAP "" UBYTE POD_AntiPinch_CM_boolean 0 0 0 1 ECU_ADDRESS 0xb0055878 /* @ECU_Address@monr_ADP_ErrPosition_FlagRAP@ */ /end MEASUREMENT
/begin MEASUREMENT monr_VbAP_ReferenceCurrentResRAP_flg "" UBYTE POD_AntiPinch_CM_boolean 0 0 0 1 ECU_ADDRESS 0xb00558b0 /* @ECU_Address@monr_VbAP_ReferenceCurrentResRAP_flg@ */ /end MEASUREMENT
/begin MEASUREMENT monr_VbAP_ReferenceCurrentSetRAP_flg "" UBYTE POD_AntiPinch_CM_boolean 0 0 0 1 ECU_ADDRESS 0xb00558b2 /* @ECU_Address@monr_VbAP_ReferenceCurrentSetRAP_flg@ */ /end MEASUREMENT
/begin MEASUREMENT monr_VbAP_KeepReferenceCurrentRAP_flg "" UBYTE POD_AntiPinch_CM_boolean 0 0 0 1 ECU_ADDRESS 0xb00558ae /* @ECU_Address@monr_VbAP_KeepReferenceCurrentRAP_flg@ */ /end MEASUREMENT
/begin MEASUREMENT monr_VbAP_JudgeCurAntiPinchforMinPntCloseRAP_flg "" UBYTE POD_AntiPinch_CM_boolean 0 0 0 1 ECU_ADDRESS 0xb00558aa /* @ECU_Address@monr_VbAP_JudgeCurAntiPinchforMinPntCloseRAP_flg@ */ /end MEASUREMENT
/begin MEASUREMENT monr_VbAP_DiffJudgeDurNormrunRAP_flg "" UBYTE POD_AntiPinch_CM_boolean 0 0 0 1 ECU_ADDRESS 0xb00558a9 /* @ECU_Address@monr_VbAP_DiffJudgeDurNormrunRAP_flg@ */ /end MEASUREMENT
/begin MEASUREMENT monr_VbAP_CurrJudgeDurNormrunRAP_flg "" UBYTE POD_AntiPinch_CM_boolean 0 0 0 1 ECU_ADDRESS 0xb00558a7 /* @ECU_Address@monr_VbAP_CurrJudgeDurNormrunRAP_flg@ */ /end MEASUREMENT
/begin MEASUREMENT monr_VbAP_AntiPinchforMinPntCloseRAP_flg "" UBYTE POD_AntiPinch_CM_boolean 0 0 0 1 ECU_ADDRESS 0xb00558a5 /* @ECU_Address@monr_VbAP_AntiPinchforMinPntCloseRAP_flg@ */ /end MEASUREMENT
/begin MEASUREMENT monr_VbAP_AntiPinchStsDspR_flg "" UBYTE POD_AntiPinch_CM_boolean 0 0 0 1 ECU_ADDRESS 0xb00558fd /* @ECU_Address@monr_VbAP_AntiPinchStsDspR_flg@ */ /end MEASUREMENT
/begin MEASUREMENT monr_VbAP_Tip2RunAntiPinchR_flg "" UBYTE POD_AntiPinch_CM_boolean 0 0 0 1 ECU_ADDRESS 0xb00558ff /* @ECU_Address@monr_VbAP_Tip2RunAntiPinchR_flg@ */ /end MEASUREMENT
/begin COMPU_METHOD POD_AntiPinch_CM_single "Q = V" RAT_FUNC "%8.6" "" COEFFS 0 1 0 0 0 1 /end COMPU_METHOD
/begin COMPU_METHOD POD_AntiPinch_CM_int16 "Q = V" RAT_FUNC "%5.0" "" COEFFS 0 1 0 0 0 1 /end COMPU_METHOD
/begin COMPU_METHOD POD_AntiPinch_CM_boolean "Q = V" RAT_FUNC "%1.0" "" COEFFS 0 1 0 0 0 1 /end COMPU_METHOD
/begin COMPU_METHOD POD_AntiPinch_CM_uint16 "Q = V" RAT_FUNC "%5.0" "" COEFFS 0 1 0 0 0 1 /end COMPU_METHOD
/begin COMPU_METHOD POD_AntiPinch_CM_uint8 "Q = V" RAT_FUNC "%3.0" "" COEFFS 0 1 0 0 0 1 /end COMPU_METHOD
/begin GROUP POD_AntiPinch "POD_AntiPinch" ROOT /begin SUB_GROUP Root_POD_AntiPinch /end SUB_GROUP /end GROUP
/begin GROUP Root_POD_AntiPinch "POD_AntiPinch/POD_AntiPinch" /begin SUB_GROUP S2_AntiPinch /end SUB_GROUP
 /begin REF_MEASUREMENT monr_VbHHM_DoorOpenLAP_flg monr_VbHHM_DoorOpenRAP_flg monr_VeFH_DoorLckPstnLAP_enum monr_VeFH_DoorLckPstnRAP_enum monr_VeHHM_SectorIndexLAP_enum monr_VeHHM_SectorIndexRAP_enum monr_VeSHM_CbnPressLvlAP_enum monr_VeSHM_DoorTypCfgAP_enum monr_VeSMM_DOPFcnStateLAP_enum monr_VeSMM_DOPFcnStateRAP_enum monr_VeSMM_HoverModCtrlLAP_enum monr_VeSMM_HoverModCtrlRAP_enum monr_VeSMM_MotorCtrlModeLAP_enum monr_VeSMM_MotorCtrlModeRAP_enum monr_VeSMM_MotorCtrlStateLAP_enum monr_VeSMM_MotorCtrlStateRAP_enum monr_VeSMM_StopEventLAP_enum monr_VeSMM_StopEventRAP_enum monr_VfIMU_AgSpdLAP_degps monr_VfIMU_AgSpdRAP_degps monr_VfMCM_BrakingTorqueLAP_NULL monr_VfMCM_BrakingTorqueRAP_NULL monr_VfMCM_MotorCtrlDutyLAP_NULL monr_VfMCM_MotorCtrlDutyRAP_NULL monr_VfMCM_TarPosLAP_NULL monr_VfMCM_TarPosRAP_NULL monr_VfMCM_TarSpdLAP_NULL monr_VfMCM_TarSpdRAP_NULL monr_VfMCM_ldlToAntipinchLAP_MA monr_VfMCM_ldlToAntipinchRAP_MA monr_VfMCM_lrefToAntipinchLAP_MA monr_VfMCM_lrefToAntipinchRAP_MA monr_VfSHM_AmbTempAP_C monr_VfSHM_BatVoltageValueAP_MV monr_VfSHM_FrntIncinAgLAP_deg monr_VfSHM_FrntIncinAgRAP_deg monr_VfSHM_MainMotoCurrentLAP_MA monr_VfSHM_MainMotoCurrentRAP_MA monr_VfSHM_SideIncinAgLAP_deg monr_VfSHM_SideIncinAgRAP_deg monr_VfSHM_VehSpdLgtAP_mps monr_VsHHM_AntiPinchHallPositionLAP_NULL monr_VsHHM_AntiPinchHallPositionRAP_NULL monr_VsHHM_AswHallPositionLAP_NULL monr_VsHHM_AswHallPositionRAP_NULL monr_VsHHM_AswHallSpeedLAP_rpm monr_VsHHM_AswHallSpeedRAP_rpm monr_VuHHM_HallPWMLAP_Hz monr_VuHHM_HallPWMRAP_Hz /end REF_MEASUREMENT
/end GROUP
/begin GROUP S2_AntiPinch "POD_AntiPinch/POD_AntiPinch/AntiPinch" /begin SUB_GROUP S3_AntiPinchL S3_AntiPinchR /end SUB_GROUP /end GROUP
/begin GROUP S3_AntiPinchL "POD_AntiPinch/POD_AntiPinch/AntiPinch/AntiPinchL"
 /begin SUB_GROUP S4_AntiPinchCurOffset S4_AntiPinchTrig S4_AntiPinch_Detection S4_BaseBatVoltage S4_BaseMainMotoCurrent S4_ErrPosition S4_MotoCurrentOrBatVoltageDiff S4_Tip2RunAntiPinch /end SUB_GROUP
/end GROUP
/begin GROUP S3_AntiPinchR "POD_AntiPinch/POD_AntiPinch/AntiPinch/AntiPinchR"
 /begin SUB_GROUP S5_AntiPinchCurOffset S5_AntiPinchTrig S5_AntiPinch_Detection S5_BaseBatVoltage S5_BaseMainMotoCurrent S5_ErrPosition S5_MotoCurrentOrBatVoltageDiff S5_Tip2RunAntiPinch /end SUB_GROUP
/end GROUP
/begin GROUP S4_AntiPinchCurOffset "POD_AntiPinch/POD_AntiPinch/AntiPinch/AntiPinchL/AntiPinchCurOffset" /begin SUB_GROUP S6_CurrentCmp S6_ReferenceCurrent S6_SectorCompensation /end SUB_GROUP /begin REF_CHARACTERISTIC k_ADP_Value_CalCurrentLimitBasicAntiPinch /end REF_CHARACTERISTIC /begin REF_MEASUREMENT monr_VfAP_ValueTriggMotCurAddLAP_MA /end REF_MEASUREMENT /end GROUP
/begin GROUP S4_AntiPinchTrig "POD_AntiPinch/POD_AntiPinch/AntiPinch/AntiPinchL/AntiPinchTrig"
 /begin SUB_GROUP S7_AntiPinchConditions_Current S7_AntiPinchConditions_Speed /end SUB_GROUP
/end GROUP
/begin GROUP S4_AntiPinch_Detection "POD_AntiPinch/POD_AntiPinch/AntiPinch/AntiPinchL/AntiPinch_Detection"
 /begin SUB_GROUP S8_AntiPinchEvent S8_Signal_Override S8_Time_Holding_Boolean S8_cnt /end SUB_GROUP
 /begin REF_CHARACTERISTIC k_ADP_Boolean_APHDEnable k_ADP_Value_AllowRelPositionforAntiPinch /end REF_CHARACTERISTIC
/end GROUP
/begin GROUP S4_BaseBatVoltage "POD_AntiPinch/POD_AntiPinch/AntiPinch/AntiPinchL/BaseBatVoltage" /begin REF_MEASUREMENT monr_VfAP_ValueBatVoltagetBaseLAP_MV /end REF_MEASUREMENT /end GROUP
/begin GROUP S4_BaseMainMotoCurrent "POD_AntiPinch/POD_AntiPinch/AntiPinch/AntiPinchL/BaseMainMotoCurrent" /begin REF_MEASUREMENT monr_VfAP_ValueMainMotoCurrentBaseLAP_MA /end REF_MEASUREMENT /end GROUP
/begin GROUP S4_ErrPosition "POD_AntiPinch/POD_AntiPinch/AntiPinch/AntiPinchL/ErrPosition"
 /begin REF_CHARACTERISTIC k_ADP_Value_PIDPosRateforAntiPinch k_ADP_Value_ThresholdAdjast k_ADP_Value_ThresholdValueOfPosition /end REF_CHARACTERISTIC
 /begin REF_MEASUREMENT monr_ADP_ErrPosition_FlagLAP monr_ADP_PIDErrPosLAP monr_ADP_Value_ErrPositionLAP monr_ADP_Value_ErrPosition_DiffLAP /end REF_MEASUREMENT
/end GROUP
/begin GROUP S4_MotoCurrentOrBatVoltageDiff "POD_AntiPinch/POD_AntiPinch/AntiPinch/AntiPinchL/MotoCurrentOrBatVoltageDiff"
 /begin REF_MEASUREMENT monr_ADP_Value_BatVoltaget_DiffLAP monr_ADP_Value_MainMotoCurrent_DiffLAP /end REF_MEASUREMENT
/end GROUP
/begin GROUP S4_Tip2RunAntiPinch "POD_AntiPinch/POD_AntiPinch/AntiPinch/AntiPinchL/Tip2RunAntiPinch" /begin SUB_GROUP S13_Time_Holding_Boolean /end SUB_GROUP /begin REF_CHARACTERISTIC k_ADP_Boolean_APHDEnable /end REF_CHARACTERISTIC /end GROUP
/begin GROUP S5_AntiPinchCurOffset "POD_AntiPinch/POD_AntiPinch/AntiPinch/AntiPinchR/AntiPinchCurOffset" /begin SUB_GROUP S94_CurrentCmp S94_ReferenceCurrent S94_SectorCompensation /end SUB_GROUP /begin REF_CHARACTERISTIC k_ADP_Value_CalCurrentLimitBasicAntiPinch /end REF_CHARACTERISTIC /begin REF_MEASUREMENT monr_VfAP_ValueTriggMotCurAddRAP_MA /end REF_MEASUREMENT /end GROUP
/begin GROUP S5_AntiPinchTrig "POD_AntiPinch/POD_AntiPinch/AntiPinch/AntiPinchR/AntiPinchTrig"
 /begin SUB_GROUP S95_AntiPinchConditions_Current S95_AntiPinchConditions_Speed /end SUB_GROUP
/end GROUP
/begin GROUP S5_AntiPinch_Detection "POD_AntiPinch/POD_AntiPinch/AntiPinch/AntiPinchR/AntiPinch_Detection"
 /begin SUB_GROUP S96_AntiPinchEvent S96_Signal_Override S96_Time_Holding_Boolean S96_cnt /end SUB_GROUP
 /begin REF_CHARACTERISTIC k_ADP_Boolean_APHDEnable k_ADP_Value_AllowRelPositionforAntiPinch /end REF_CHARACTERISTIC
/end GROUP
/begin GROUP S5_BaseBatVoltage "POD_AntiPinch/POD_AntiPinch/AntiPinch/AntiPinchR/BaseBatVoltage" /begin REF_MEASUREMENT monr_VfAP_ValueBatVoltagetBaseRAP_MV /end REF_MEASUREMENT /end GROUP
/begin GROUP S5_BaseMainMotoCurrent "POD_AntiPinch/POD_AntiPinch/AntiPinch/AntiPinchR/BaseMainMotoCurrent" /begin REF_MEASUREMENT monr_VfAP_ValueMainMotoCurrentBaseRAP_MA /end REF_MEASUREMENT /end GROUP
/begin GROUP S5_ErrPosition "POD_AntiPinch/POD_AntiPinch/AntiPinch/AntiPinchR/ErrPosition"
 /begin REF_CHARACTERISTIC k_ADP_Value_PIDPosRateforAntiPinch k_ADP_Value_ThresholdAdjast k_ADP_Value_ThresholdValueOfPosition /end REF_CHARACTERISTIC
 /begin REF_MEASUREMENT monr_ADP_ErrPosition_FlagRAP monr_ADP_PIDErrPosRAP monr_ADP_Value_ErrPositionRAP monr_ADP_Value_ErrPosition_DiffRAP /end REF_MEASUREMENT
/end GROUP
/begin GROUP S5_MotoCurrentOrBatVoltageDiff "POD_AntiPinch/POD_AntiPinch/AntiPinch/AntiPinchR/MotoCurrentOrBatVoltageDiff"
 /begin REF_MEASUREMENT monr_ADP_Value_BatVoltaget_DiffRAP monr_ADP_Value_MainMotoCurrent_DiffRAP /end REF_MEASUREMENT
/end GROUP
/begin GROUP S5_Tip2RunAntiPinch "POD_AntiPinch/POD_AntiPinch/AntiPinch/AntiPinchR/Tip2RunAntiPinch" /begin SUB_GROUP S101_Time_Holding_Boolean /end SUB_GROUP /begin REF_CHARACTERISTIC k_ADP_Boolean_APHDEnable /end REF_CHARACTERISTIC /end GROUP
/begin GROUP S6_CurrentCmp "POD_AntiPinch/POD_AntiPinch/AntiPinch/AntiPinchL/AntiPinchCurOffset/CurrentCmp" /begin SUB_GROUP S15_CloseDoor S15_OpenDoor /end SUB_GROUP /begin REF_MEASUREMENT monr_VfAP_ValueCurrentCmpLAP_MA /end REF_MEASUREMENT /end GROUP
/begin GROUP S6_ReferenceCurrent "POD_AntiPinch/POD_AntiPinch/AntiPinch/AntiPinchL/AntiPinchCurOffset/ReferenceCurrent"
 /begin SUB_GROUP S16_KeepReferenceCurrentFlag S16_ReferenceCurrent S16_ReferenceCurrentCompensation /end SUB_GROUP
 /begin REF_CHARACTERISTIC k_ADP_Value_RefCurrentLimitMax /end REF_CHARACTERISTIC
 /begin REF_MEASUREMENT monr_VfAP_ValueReferenceCurrentSumLAP_MA /end REF_MEASUREMENT
/end GROUP
/begin GROUP S6_SectorCompensation "POD_AntiPinch/POD_AntiPinch/AntiPinch/AntiPinchL/AntiPinchCurOffset/SectorCompensation" /begin SUB_GROUP S17_CloseDoor S17_OpenDoor /end SUB_GROUP /end GROUP
/begin GROUP S7_AntiPinchConditions_Current "POD_AntiPinch/POD_AntiPinch/AntiPinch/AntiPinchL/AntiPinchTrig/AntiPinchConditions_Current"
 /begin SUB_GROUP S47_Rising_Debounce S47_Rising_Debounce1 S47_Rising_Debounce2 S47_Rising_Debounce3 /end SUB_GROUP
 /begin REF_CHARACTERISTIC k_ADP_Value_CurrentMinRefDiffforAntiPinch k_ADP_Value_CurrentMinRefHallSpeedforAntiPinch k_ADP_Value_CurrentMinRefPntDiffforAntiPinch k_ADP_Value_CurrentMinRefPntforAntiPinch k_ADP_Value_CurrentRefPositionforAntiPinch /end REF_CHARACTERISTIC
 /begin REF_MEASUREMENT monr_VbAP_JudgeCurAntiPinchLAP_flg monr_VbAP_JudgeCurAntiPinchforMinPntCloseLAP_flg /end REF_MEASUREMENT
/end GROUP
/begin GROUP S7_AntiPinchConditions_Speed "POD_AntiPinch/POD_AntiPinch/AntiPinch/AntiPinchL/AntiPinchTrig/AntiPinchConditions_Speed" /begin SUB_GROUP S48_Rising_Debounce4 /end SUB_GROUP /begin REF_CHARACTERISTIC k_ADP_Value_DieMinimumSpeedforAntiPinch /end REF_CHARACTERISTIC /end GROUP
/begin GROUP S8_AntiPinchEvent "POD_AntiPinch/POD_AntiPinch/AntiPinch/AntiPinchL/AntiPinch_Detection/AntiPinchEvent" /begin SUB_GROUP S66_Rising_Debounce S66_Rising_Debounce1 /end SUB_GROUP
 /begin REF_CHARACTERISTIC K_ADP_Value_CurDiffAntiPinchforMinPntClose K_ADP_Value_ErrPositionDiff K_ADP_Value_MainMotoCurrentMaxDiff k_ADP_Value_CurrentRefPositionDiffforAntiPinch /end REF_CHARACTERISTIC
 /begin REF_MEASUREMENT monr_VbAP_AntiPinchforMinPntCloseLAP_flg monr_VbAP_CurrJudgeDurNormrunLAP_flg monr_VbAP_DiffJudgeDurNormrunLAP_flg /end REF_MEASUREMENT
/end GROUP
/begin GROUP S8_Signal_Override "POD_AntiPinch/POD_AntiPinch/AntiPinch/AntiPinchL/AntiPinch_Detection/Signal_Override" /begin REF_CHARACTERISTIC k_ADP_Boolean_Value k_ADP_Boolean_flg /end REF_CHARACTERISTIC /end GROUP
/begin GROUP S8_Time_Holding_Boolean "POD_AntiPinch/POD_AntiPinch/AntiPinch/AntiPinchL/AntiPinch_Detection/Time Holding Boolean" /begin SUB_GROUP S69_Signal_Holding_Boolean S69_Timer_Debounce /end SUB_GROUP /end GROUP
/begin GROUP S8_cnt "POD_AntiPinch/POD_AntiPinch/AntiPinch/AntiPinchL/AntiPinch_Detection/cnt"
 /begin REF_CHARACTERISTIC k_ADP_Ti_AllowforAntiPinchTimer k_ADP_Ti_AntiPinchSequenceTimer /end REF_CHARACTERISTIC
/end GROUP
/begin GROUP S13_Time_Holding_Boolean "POD_AntiPinch/POD_AntiPinch/AntiPinch/AntiPinchL/Tip2RunAntiPinch/Time Holding Boolean" /begin SUB_GROUP S87_Signal_Holding_Boolean S87_Timer_Debounce /end SUB_GROUP /end GROUP
/begin GROUP S94_CurrentCmp "POD_AntiPinch/POD_AntiPinch/AntiPinch/AntiPinchR/AntiPinchCurOffset/CurrentCmp" /begin SUB_GROUP S103_CloseDoor S103_OpenDoor /end SUB_GROUP /begin REF_MEASUREMENT monr_VfAP_ValueCurrentCmpRAP_MA /end REF_MEASUREMENT /end GROUP
/begin GROUP S94_ReferenceCurrent "POD_AntiPinch/POD_AntiPinch/AntiPinch/AntiPinchR/AntiPinchCurOffset/ReferenceCurrent"
 /begin SUB_GROUP S104_KeepReferenceCurrentFlag S104_ReferenceCurrent S104_ReferenceCurrentCompensation /end SUB_GROUP
 /begin REF_CHARACTERISTIC k_ADP_Value_RefCurrentLimitMax /end REF_CHARACTERISTIC
 /begin REF_MEASUREMENT monr_VfAP_ValueReferenceCurrentSumRAP_MA /end REF_MEASUREMENT
/end GROUP
/begin GROUP S94_SectorCompensation "POD_AntiPinch/POD_AntiPinch/AntiPinch/AntiPinchR/AntiPinchCurOffset/SectorCompensation" /begin SUB_GROUP S105_CloseDoor S105_OpenDoor /end SUB_GROUP /end GROUP
/begin GROUP S95_AntiPinchConditions_Current "POD_AntiPinch/POD_AntiPinch/AntiPinch/AntiPinchR/AntiPinchTrig/AntiPinchConditions_Current"
 /begin SUB_GROUP S135_Rising_Debounce S135_Rising_Debounce1 S135_Rising_Debounce2 S135_Rising_Debounce3 /end SUB_GROUP
 /begin REF_CHARACTERISTIC k_ADP_Value_CurrentMinRefDiffforAntiPinch k_ADP_Value_CurrentMinRefHallSpeedforAntiPinch k_ADP_Value_CurrentMinRefPntDiffforAntiPinch k_ADP_Value_CurrentMinRefPntforAntiPinch k_ADP_Value_CurrentRefPositionforAntiPinch /end REF_CHARACTERISTIC
 /begin REF_MEASUREMENT monr_VbAP_JudgeCurAntiPinchRAP_flg monr_VbAP_JudgeCurAntiPinchforMinPntCloseRAP_flg /end REF_MEASUREMENT
/end GROUP
/begin GROUP S95_AntiPinchConditions_Speed "POD_AntiPinch/POD_AntiPinch/AntiPinch/AntiPinchR/AntiPinchTrig/AntiPinchConditions_Speed" /begin SUB_GROUP S136_Rising_Debounce4 /end SUB_GROUP /begin REF_CHARACTERISTIC k_ADP_Value_DieMinimumSpeedforAntiPinch /end REF_CHARACTERISTIC /end GROUP
/begin GROUP S96_AntiPinchEvent "POD_AntiPinch/POD_AntiPinch/AntiPinch/AntiPinchR/AntiPinch_Detection/AntiPinchEvent" /begin SUB_GROUP S154_Rising_Debounce S154_Rising_Debounce1 /end SUB_GROUP
 /begin REF_CHARACTERISTIC K_ADP_Value_CurDiffAntiPinchforMinPntClose K_ADP_Value_ErrPositionDiff K_ADP_Value_MainMotoCurrentMaxDiff k_ADP_Value_CurrentRefPositionDiffforAntiPinch /end REF_CHARACTERISTIC
 /begin REF_MEASUREMENT monr_VbAP_AntiPinchforMinPntCloseRAP_flg monr_VbAP_CurrJudgeDurNormrunRAP_flg monr_VbAP_DiffJudgeDurNormrunRAP_flg /end REF_MEASUREMENT
/end GROUP
/begin GROUP S96_Signal_Override "POD_AntiPinch/POD_AntiPinch/AntiPinch/AntiPinchR/AntiPinch_Detection/Signal_Override" /begin REF_CHARACTERISTIC k_ADP_Boolean_Value k_ADP_Boolean_flg /end REF_CHARACTERISTIC /end GROUP
/begin GROUP S96_Time_Holding_Boolean "POD_AntiPinch/POD_AntiPinch/AntiPinch/AntiPinchR/AntiPinch_Detection/Time Holding Boolean" /begin SUB_GROUP S157_Signal_Holding_Boolean S157_Timer_Debounce /end SUB_GROUP /end GROUP
/begin GROUP S96_cnt "POD_AntiPinch/POD_AntiPinch/AntiPinch/AntiPinchR/AntiPinch_Detection/cnt"
 /begin REF_CHARACTERISTIC k_ADP_Ti_AllowforAntiPinchTimer k_ADP_Ti_AntiPinchSequenceTimer /end REF_CHARACTERISTIC
/end GROUP
/begin GROUP S101_Time_Holding_Boolean "POD_AntiPinch/POD_AntiPinch/AntiPinch/AntiPinchR/Tip2RunAntiPinch/Time Holding Boolean" /begin SUB_GROUP S175_Signal_Holding_Boolean S175_Timer_Debounce /end SUB_GROUP /end GROUP
/begin GROUP S15_CloseDoor "POD_AntiPinch/POD_AntiPinch/AntiPinch/AntiPinchL/AntiPinchCurOffset/CurrentCmp/CloseDoor"
 /begin REF_CHARACTERISTIC k_ADP_Value_AmbTrawCOCCloseCurrentFactor k_ADP_Value_BatVoltageCOCCurrentCloseFactor /end REF_CHARACTERISTIC
/end GROUP
/begin GROUP S15_OpenDoor "POD_AntiPinch/POD_AntiPinch/AntiPinch/AntiPinchL/AntiPinchCurOffset/CurrentCmp/OpenDoor"
 /begin REF_CHARACTERISTIC k_ADP_Value_AmbTrawCOCCurrentFactor k_ADP_Value_BatVoltageCOCCurrentFactor /end REF_CHARACTERISTIC
/end GROUP
/begin GROUP S16_KeepReferenceCurrentFlag "POD_AntiPinch/POD_AntiPinch/AntiPinch/AntiPinchL/AntiPinchCurOffset/ReferenceCurrent/KeepReferenceCurrentFlag" /begin SUB_GROUP S21_RS S21_ReferenceCurrentRes S21_ReferenceCurrentSet /end SUB_GROUP /end GROUP
/begin GROUP S16_ReferenceCurrent "POD_AntiPinch/POD_AntiPinch/AntiPinch/AntiPinchL/AntiPinchCurOffset/ReferenceCurrent/ReferenceCurrent" /begin SUB_GROUP S22_Rising_Debounce /end SUB_GROUP /begin REF_CHARACTERISTIC k_ADP_Value_CurrentRefPositionforAntiPinch /end REF_CHARACTERISTIC /begin REF_MEASUREMENT monr_VfAP_ValueReferenceCurrentLAP_MA /end REF_MEASUREMENT /end GROUP
/begin GROUP S16_ReferenceCurrentCompensation "POD_AntiPinch/POD_AntiPinch/AntiPinch/AntiPinchL/AntiPinchCurOffset/ReferenceCurrent/ReferenceCurrentCompensation" /begin REF_CHARACTERISTIC k_ADP_Value_CurrentCompensateLimitMax /end REF_CHARACTERISTIC
 /begin REF_MEASUREMENT monr_VfAP_ValueBrkgCompenLAP_MA monr_VfAP_ValueReferenceCurrentCmpLAP_MA monr_VfAP_ValueSlopeCompenLAP_MA /end REF_MEASUREMENT
/end GROUP
/begin GROUP S17_CloseDoor "POD_AntiPinch/POD_AntiPinch/AntiPinch/AntiPinchL/AntiPinchCurOffset/SectorCompensation/CloseDoor"
 /begin REF_CHARACTERISTIC k_ADP_Value_CurrentLimitClose k_ADP_Value_CurrentLimitMinPntClose k_ADP_Value_CurrentRefPositionforAntiPinch /end REF_CHARACTERISTIC
/end GROUP
/begin GROUP S17_OpenDoor "POD_AntiPinch/POD_AntiPinch/AntiPinch/AntiPinchL/AntiPinchCurOffset/SectorCompensation/OpenDoor" /begin REF_CHARACTERISTIC k_ADP_Value_CurrentLimitOpen /end REF_CHARACTERISTIC /end GROUP
/begin GROUP S47_Rising_Debounce "POD_AntiPinch/POD_AntiPinch/AntiPinch/AntiPinchL/AntiPinchTrig/AntiPinchConditions_Current/Rising Debounce"
 /begin REF_CHARACTERISTIC k_ADP_Ti_AntiPinchOpenSpeedPerStartTimer k_ADP_Ti_AntiPinchSequenceTimer /end REF_CHARACTERISTIC
/end GROUP
/begin GROUP S47_Rising_Debounce1 "POD_AntiPinch/POD_AntiPinch/AntiPinch/AntiPinchL/AntiPinchTrig/AntiPinchConditions_Current/Rising Debounce1"
 /begin REF_CHARACTERISTIC k_ADP_Ti_AntiPinchCloseSpeedPerStartTimer k_ADP_Ti_AntiPinchSequenceTimer /end REF_CHARACTERISTIC
/end GROUP
/begin GROUP S47_Rising_Debounce2 "POD_AntiPinch/POD_AntiPinch/AntiPinch/AntiPinchL/AntiPinchTrig/AntiPinchConditions_Current/Rising Debounce2"
 /begin REF_CHARACTERISTIC k_ADP_Ti_AntiPinchCloseSpeedPerStartTimer k_ADP_Ti_AntiPinchSequenceTimer /end REF_CHARACTERISTIC
/end GROUP
/begin GROUP S47_Rising_Debounce3 "POD_AntiPinch/POD_AntiPinch/AntiPinch/AntiPinchL/AntiPinchTrig/AntiPinchConditions_Current/Rising Debounce3"
 /begin REF_CHARACTERISTIC k_ADP_Ti_AntiPinchSequenceTimer k_ADP_Ti_CurAntiPinchforMinPntCloseStartTimer /end REF_CHARACTERISTIC
/end GROUP
/begin GROUP S48_Rising_Debounce4 "POD_AntiPinch/POD_AntiPinch/AntiPinch/AntiPinchL/AntiPinchTrig/AntiPinchConditions_Speed/Rising Debounce4"
 /begin REF_CHARACTERISTIC k_ADP_Ti_AntiPinchSequenceTimer k_ADP_Ti_DieMinimumSpeedJudgeTimer /end REF_CHARACTERISTIC
/end GROUP
/begin GROUP S66_Rising_Debounce "POD_AntiPinch/POD_AntiPinch/AntiPinch/AntiPinchL/AntiPinch_Detection/AntiPinchEvent/Rising Debounce"
 /begin REF_CHARACTERISTIC k_ADP_Ti_AntiPinchSequenceTimer k_ADP_Ti_StateRunDelayTimer /end REF_CHARACTERISTIC
/end GROUP
/begin GROUP S66_Rising_Debounce1 "POD_AntiPinch/POD_AntiPinch/AntiPinch/AntiPinchL/AntiPinch_Detection/AntiPinchEvent/Rising Debounce1"
 /begin REF_CHARACTERISTIC k_ADP_Ti_AntiPinchSequenceTimer k_ADP_Ti_CurAntiPinchforMinPntCloseDelayTimer /end REF_CHARACTERISTIC
/end GROUP
/begin GROUP S69_Signal_Holding_Boolean "POD_AntiPinch/POD_AntiPinch/AntiPinch/AntiPinchL/AntiPinch_Detection/Time Holding Boolean/Signal Holding Boolean" /begin REF_MEASUREMENT monr_VbAP_AntiPinchStsDspL_flg /end REF_MEASUREMENT /end GROUP
/begin GROUP S69_Timer_Debounce "POD_AntiPinch/POD_AntiPinch/AntiPinch/AntiPinchL/AntiPinch_Detection/Time Holding Boolean/Timer Debounce"
 /begin REF_CHARACTERISTIC k_ADP_Ti_AntiPinchHoldingTimer k_ADP_Ti_AntiPinchSequenceTimer /end REF_CHARACTERISTIC
/end GROUP
/begin GROUP S87_Signal_Holding_Boolean "POD_AntiPinch/POD_AntiPinch/AntiPinch/AntiPinchL/Tip2RunAntiPinch/Time Holding Boolean/Signal Holding Boolean" /begin REF_MEASUREMENT monr_VbAP_Tip2RunAntiPinchL_flg /end REF_MEASUREMENT /end GROUP
/begin GROUP S87_Timer_Debounce "POD_AntiPinch/POD_AntiPinch/AntiPinch/AntiPinchL/Tip2RunAntiPinch/Time Holding Boolean/Timer Debounce"
 /begin REF_CHARACTERISTIC k_ADP_Ti_AntiPinchHoldingTimer k_ADP_Ti_AntiPinchSequenceTimer /end REF_CHARACTERISTIC
/end GROUP
/begin GROUP S103_CloseDoor "POD_AntiPinch/POD_AntiPinch/AntiPinch/AntiPinchR/AntiPinchCurOffset/CurrentCmp/CloseDoor"
 /begin REF_CHARACTERISTIC k_ADP_Value_AmbTrawCOCCloseCurrentFactor k_ADP_Value_BatVoltageCOCCurrentCloseFactor /end REF_CHARACTERISTIC
/end GROUP
/begin GROUP S103_OpenDoor "POD_AntiPinch/POD_AntiPinch/AntiPinch/AntiPinchR/AntiPinchCurOffset/CurrentCmp/OpenDoor"
 /begin REF_CHARACTERISTIC k_ADP_Value_AmbTrawCOCCurrentFactor k_ADP_Value_BatVoltageCOCCurrentFactor /end REF_CHARACTERISTIC
/end GROUP
/begin GROUP S104_KeepReferenceCurrentFlag "POD_AntiPinch/POD_AntiPinch/AntiPinch/AntiPinchR/AntiPinchCurOffset/ReferenceCurrent/KeepReferenceCurrentFlag" /begin SUB_GROUP S109_RS S109_ReferenceCurrentRes S109_ReferenceCurrentSet /end SUB_GROUP /end GROUP
/begin GROUP S104_ReferenceCurrent "POD_AntiPinch/POD_AntiPinch/AntiPinch/AntiPinchR/AntiPinchCurOffset/ReferenceCurrent/ReferenceCurrent" /begin SUB_GROUP S110_Rising_Debounce /end SUB_GROUP /begin REF_CHARACTERISTIC k_ADP_Value_CurrentRefPositionforAntiPinch /end REF_CHARACTERISTIC /begin REF_MEASUREMENT monr_VfAP_ValueReferenceCurrentRAP_MA /end REF_MEASUREMENT /end GROUP
/begin GROUP S104_ReferenceCurrentCompensation "POD_AntiPinch/POD_AntiPinch/AntiPinch/AntiPinchR/AntiPinchCurOffset/ReferenceCurrent/ReferenceCurrentCompensation" /begin REF_CHARACTERISTIC k_ADP_Value_CurrentCompensateLimitMax /end REF_CHARACTERISTIC
 /begin REF_MEASUREMENT monr_VfAP_ValueBrkgCompenRAP_MA monr_VfAP_ValueReferenceCurrentCmpRAP_MA monr_VfAP_ValueSlopeCompenRAP_MA /end REF_MEASUREMENT
/end GROUP
/begin GROUP S105_CloseDoor "POD_AntiPinch/POD_AntiPinch/AntiPinch/AntiPinchR/AntiPinchCurOffset/SectorCompensation/CloseDoor"
 /begin REF_CHARACTERISTIC k_ADP_Value_CurrentLimitClose k_ADP_Value_CurrentLimitMinPntClose k_ADP_Value_CurrentRefPositionforAntiPinch /end REF_CHARACTERISTIC
/end GROUP
/begin GROUP S105_OpenDoor "POD_AntiPinch/POD_AntiPinch/AntiPinch/AntiPinchR/AntiPinchCurOffset/SectorCompensation/OpenDoor" /begin REF_CHARACTERISTIC k_ADP_Value_CurrentLimitOpen /end REF_CHARACTERISTIC /end GROUP
/begin GROUP S135_Rising_Debounce "POD_AntiPinch/POD_AntiPinch/AntiPinch/AntiPinchR/AntiPinchTrig/AntiPinchConditions_Current/Rising Debounce"
 /begin REF_CHARACTERISTIC k_ADP_Ti_AntiPinchOpenSpeedPerStartTimer k_ADP_Ti_AntiPinchSequenceTimer /end REF_CHARACTERISTIC
/end GROUP
/begin GROUP S135_Rising_Debounce1 "POD_AntiPinch/POD_AntiPinch/AntiPinch/AntiPinchR/AntiPinchTrig/AntiPinchConditions_Current/Rising Debounce1"
 /begin REF_CHARACTERISTIC k_ADP_Ti_AntiPinchCloseSpeedPerStartTimer k_ADP_Ti_AntiPinchSequenceTimer /end REF_CHARACTERISTIC
/end GROUP
/begin GROUP S135_Rising_Debounce2 "POD_AntiPinch/POD_AntiPinch/AntiPinch/AntiPinchR/AntiPinchTrig/AntiPinchConditions_Current/Rising Debounce2"
 /begin REF_CHARACTERISTIC k_ADP_Ti_AntiPinchCloseSpeedPerStartTimer k_ADP_Ti_AntiPinchSequenceTimer /end REF_CHARACTERISTIC
/end GROUP
/begin GROUP S135_Rising_Debounce3 "POD_AntiPinch/POD_AntiPinch/AntiPinch/AntiPinchR/AntiPinchTrig/AntiPinchConditions_Current/Rising Debounce3"
 /begin REF_CHARACTERISTIC k_ADP_Ti_AntiPinchSequenceTimer k_ADP_Ti_CurAntiPinchforMinPntCloseStartTimer /end REF_CHARACTERISTIC
/end GROUP
/begin GROUP S136_Rising_Debounce4 "POD_AntiPinch/POD_AntiPinch/AntiPinch/AntiPinchR/AntiPinchTrig/AntiPinchConditions_Speed/Rising Debounce4"
 /begin REF_CHARACTERISTIC k_ADP_Ti_AntiPinchSequenceTimer k_ADP_Ti_DieMinimumSpeedJudgeTimer /end REF_CHARACTERISTIC
/end GROUP
/begin GROUP S154_Rising_Debounce "POD_AntiPinch/POD_AntiPinch/AntiPinch/AntiPinchR/AntiPinch_Detection/AntiPinchEvent/Rising Debounce"
 /begin REF_CHARACTERISTIC k_ADP_Ti_AntiPinchSequenceTimer k_ADP_Ti_StateRunDelayTimer /end REF_CHARACTERISTIC
/end GROUP
/begin GROUP S154_Rising_Debounce1 "POD_AntiPinch/POD_AntiPinch/AntiPinch/AntiPinchR/AntiPinch_Detection/AntiPinchEvent/Rising Debounce1"
 /begin REF_CHARACTERISTIC k_ADP_Ti_AntiPinchSequenceTimer k_ADP_Ti_CurAntiPinchforMinPntCloseDelayTimer /end REF_CHARACTERISTIC
/end GROUP
/begin GROUP S157_Signal_Holding_Boolean "POD_AntiPinch/POD_AntiPinch/AntiPinch/AntiPinchR/AntiPinch_Detection/Time Holding Boolean/Signal Holding Boolean" /begin REF_MEASUREMENT monr_VbAP_AntiPinchStsDspR_flg /end REF_MEASUREMENT /end GROUP
/begin GROUP S157_Timer_Debounce "POD_AntiPinch/POD_AntiPinch/AntiPinch/AntiPinchR/AntiPinch_Detection/Time Holding Boolean/Timer Debounce"
 /begin REF_CHARACTERISTIC k_ADP_Ti_AntiPinchHoldingTimer k_ADP_Ti_AntiPinchSequenceTimer /end REF_CHARACTERISTIC
/end GROUP
/begin GROUP S175_Signal_Holding_Boolean "POD_AntiPinch/POD_AntiPinch/AntiPinch/AntiPinchR/Tip2RunAntiPinch/Time Holding Boolean/Signal Holding Boolean" /begin REF_MEASUREMENT monr_VbAP_Tip2RunAntiPinchR_flg /end REF_MEASUREMENT /end GROUP
/begin GROUP S175_Timer_Debounce "POD_AntiPinch/POD_AntiPinch/AntiPinch/AntiPinchR/Tip2RunAntiPinch/Time Holding Boolean/Timer Debounce"
 /begin REF_CHARACTERISTIC k_ADP_Ti_AntiPinchHoldingTimer k_ADP_Ti_AntiPinchSequenceTimer /end REF_CHARACTERISTIC
/end GROUP
/begin GROUP S21_RS "POD_AntiPinch/POD_AntiPinch/AntiPinch/AntiPinchL/AntiPinchCurOffset/ReferenceCurrent/KeepReferenceCurrentFlag/RS" /begin SUB_GROUP S24_Switch1 /end SUB_GROUP /end GROUP
/begin GROUP S21_ReferenceCurrentRes "POD_AntiPinch/POD_AntiPinch/AntiPinch/AntiPinchL/AntiPinchCurOffset/ReferenceCurrent/KeepReferenceCurrentFlag/ReferenceCurrentRes" /begin SUB_GROUP S25_Rising_Debounce1 /end SUB_GROUP /begin REF_MEASUREMENT monr_VbAP_ReferenceCurrentResLAP_flg /end REF_MEASUREMENT /end GROUP
/begin GROUP S21_ReferenceCurrentSet "POD_AntiPinch/POD_AntiPinch/AntiPinch/AntiPinchL/AntiPinchCurOffset/ReferenceCurrent/KeepReferenceCurrentFlag/ReferenceCurrentSet" /begin SUB_GROUP S26_Rising_Debounce S26_Rising_Debounce2 /end SUB_GROUP
 /begin REF_CHARACTERISTIC K_ADP_Value_ErrPositionDiffMin k_ADP_Value_CurrentIncMinRateforAntiPinch k_ADP_Value_ErrPosCurMinRateforAntiPinch k_ADP_Value_PosErrHoldRateforAntiPinch /end REF_CHARACTERISTIC
 /begin REF_MEASUREMENT monr_VbAP_ReferenceCurrentSetLAP_flg /end REF_MEASUREMENT
/end GROUP
/begin GROUP S22_Rising_Debounce "POD_AntiPinch/POD_AntiPinch/AntiPinch/AntiPinchL/AntiPinchCurOffset/ReferenceCurrent/ReferenceCurrent/Rising Debounce"
 /begin REF_CHARACTERISTIC k_ADP_Ti_AntiPinchSequenceTimer k_ADP_Ti_MinPositionDelayTimer /end REF_CHARACTERISTIC
/end GROUP
/begin GROUP S109_RS "POD_AntiPinch/POD_AntiPinch/AntiPinch/AntiPinchR/AntiPinchCurOffset/ReferenceCurrent/KeepReferenceCurrentFlag/RS" /begin SUB_GROUP S112_Switch1 /end SUB_GROUP /end GROUP
/begin GROUP S109_ReferenceCurrentRes "POD_AntiPinch/POD_AntiPinch/AntiPinch/AntiPinchR/AntiPinchCurOffset/ReferenceCurrent/KeepReferenceCurrentFlag/ReferenceCurrentRes" /begin SUB_GROUP S113_Rising_Debounce1 /end SUB_GROUP /begin REF_MEASUREMENT monr_VbAP_ReferenceCurrentResRAP_flg /end REF_MEASUREMENT /end GROUP
/begin GROUP S109_ReferenceCurrentSet "POD_AntiPinch/POD_AntiPinch/AntiPinch/AntiPinchR/AntiPinchCurOffset/ReferenceCurrent/KeepReferenceCurrentFlag/ReferenceCurrentSet" /begin SUB_GROUP S114_Rising_Debounce S114_Rising_Debounce2 /end SUB_GROUP
 /begin REF_CHARACTERISTIC K_ADP_Value_ErrPositionDiffMin k_ADP_Value_CurrentIncMinRateforAntiPinch k_ADP_Value_ErrPosCurMinRateforAntiPinch k_ADP_Value_PosErrHoldRateforAntiPinch /end REF_CHARACTERISTIC
 /begin REF_MEASUREMENT monr_VbAP_ReferenceCurrentSetRAP_flg /end REF_MEASUREMENT
/end GROUP
/begin GROUP S110_Rising_Debounce "POD_AntiPinch/POD_AntiPinch/AntiPinch/AntiPinchR/AntiPinchCurOffset/ReferenceCurrent/ReferenceCurrent/Rising Debounce"
 /begin REF_CHARACTERISTIC k_ADP_Ti_AntiPinchSequenceTimer k_ADP_Ti_MinPositionDelayTimer /end REF_CHARACTERISTIC
/end GROUP
/begin GROUP S24_Switch1 "POD_AntiPinch/POD_AntiPinch/AntiPinch/AntiPinchL/AntiPinchCurOffset/ReferenceCurrent/KeepReferenceCurrentFlag/RS/Switch1" /begin REF_MEASUREMENT monr_VbAP_KeepReferenceCurrentLAP_flg /end REF_MEASUREMENT /end GROUP
/begin GROUP S25_Rising_Debounce1 "POD_AntiPinch/POD_AntiPinch/AntiPinch/AntiPinchL/AntiPinchCurOffset/ReferenceCurrent/KeepReferenceCurrentFlag/ReferenceCurrentRes/Rising Debounce1" /begin REF_CHARACTERISTIC k_ADP_Ti_AntiPinchSequenceTimer k_ADP_Ti_RefCurrResTimer /end REF_CHARACTERISTIC /end GROUP
/begin GROUP S26_Rising_Debounce "POD_AntiPinch/POD_AntiPinch/AntiPinch/AntiPinchL/AntiPinchCurOffset/ReferenceCurrent/KeepReferenceCurrentFlag/ReferenceCurrentSet/Rising Debounce"
 /begin REF_CHARACTERISTIC k_ADP_Ti_AntiPinchSequenceTimer k_ADP_Ti_CurrentIncreaseTimer /end REF_CHARACTERISTIC
/end GROUP
/begin GROUP S26_Rising_Debounce2 "POD_AntiPinch/POD_AntiPinch/AntiPinch/AntiPinchL/AntiPinchCurOffset/ReferenceCurrent/KeepReferenceCurrentFlag/ReferenceCurrentSet/Rising Debounce2"
 /begin REF_CHARACTERISTIC k_ADP_Ti_AntiPinchSequenceTimer k_ADP_Ti_AntiPinchforMinErrPositionDelayTimer /end REF_CHARACTERISTIC
/end GROUP
/begin GROUP S112_Switch1 "POD_AntiPinch/POD_AntiPinch/AntiPinch/AntiPinchR/AntiPinchCurOffset/ReferenceCurrent/KeepReferenceCurrentFlag/RS/Switch1" /begin REF_MEASUREMENT monr_VbAP_KeepReferenceCurrentRAP_flg /end REF_MEASUREMENT /end GROUP
/begin GROUP S113_Rising_Debounce1 "POD_AntiPinch/POD_AntiPinch/AntiPinch/AntiPinchR/AntiPinchCurOffset/ReferenceCurrent/KeepReferenceCurrentFlag/ReferenceCurrentRes/Rising Debounce1" /begin REF_CHARACTERISTIC k_ADP_Ti_AntiPinchSequenceTimer k_ADP_Ti_RefCurrResTimer /end REF_CHARACTERISTIC /end GROUP
/begin GROUP S114_Rising_Debounce "POD_AntiPinch/POD_AntiPinch/AntiPinch/AntiPinchR/AntiPinchCurOffset/ReferenceCurrent/KeepReferenceCurrentFlag/ReferenceCurrentSet/Rising Debounce"
 /begin REF_CHARACTERISTIC k_ADP_Ti_AntiPinchSequenceTimer k_ADP_Ti_CurrentIncreaseTimer /end REF_CHARACTERISTIC
/end GROUP
/begin GROUP S114_Rising_Debounce2 "POD_AntiPinch/POD_AntiPinch/AntiPinch/AntiPinchR/AntiPinchCurOffset/ReferenceCurrent/KeepReferenceCurrentFlag/ReferenceCurrentSet/Rising Debounce2"
 /begin REF_CHARACTERISTIC k_ADP_Ti_AntiPinchSequenceTimer k_ADP_Ti_AntiPinchforMinErrPositionDelayTimer /end REF_CHARACTERISTIC
/end GROUP
/begin CHARACTERISTIC k_ADP_Ti_AntiPlaySequenceTimer "" VALUE 0xb00063a0 /* @ECU_Address@k_ADP_Ti_AntiPlaySequenceTimer@ */ Scalar_FLOAT32_IEEE 0 POD_FaultHandle_CM_single -3.4E+38 3.4E+38 /end CHARACTERISTIC
/begin CHARACTERISTIC k_ADP_Ti_TimeActiveProtectionThreshold "防玩禁用电动功能的时间(ms)" VALUE 0xb00063a4 /* @ECU_Address@k_ADP_Ti_TimeActiveProtectionThreshold@ */ Scalar_FLOAT32_IEEE 0 POD_FaultHandle_CM_single_ms -3.4E+38 3.4E+38 /end CHARACTERISTIC
/begin CHARACTERISTIC k_ADP_Ti_TimeSpanActiveThreshold "" VALUE 0xb00063a8 /* @ECU_Address@k_ADP_Ti_TimeSpanActiveThreshold@ */ Scalar_FLOAT32_IEEE 0 POD_FaultHandle_CM_single -3.4E+38 3.4E+38 /end CHARACTERISTIC
/begin CHARACTERISTIC KuLVM_DoorHallChgDebTi_s "" VALUE 0xb0007054 /* @ECU_Address@KuLVM_DoorHallChgDebTi_s@ */ Scalar_UWORD 0 POD_FaultHandle_CM_uint16_s 0 65535 /end CHARACTERISTIC
/begin CHARACTERISTIC k_ADP_Boolean_AntiPlayValue "" VALUE 0xb000639d /* @ECU_Address@k_ADP_Boolean_AntiPlayValue@ */ Scalar_BOOLEAN 0 POD_FaultHandle_CM_boolean 0 1 /end CHARACTERISTIC
/begin CHARACTERISTIC k_ADP_Boolean_AntiPlayflg "" VALUE 0xb000639c /* @ECU_Address@k_ADP_Boolean_AntiPlayflg@ */ Scalar_BOOLEAN 0 POD_FaultHandle_CM_boolean 0 1 /end CHARACTERISTIC
/begin CHARACTERISTIC k_APD_Boolean_AntiPlayEnable "" VALUE 0xb00063ac /* @ECU_Address@k_APD_Boolean_AntiPlayEnable@ */ Scalar_BOOLEAN 0 POD_FaultHandle_CM_boolean 0 1 /end CHARACTERISTIC
/begin CHARACTERISTIC k_APD_Num_AntiPlayNumThreshold "" VALUE 0xb00063ad /* @ECU_Address@k_APD_Num_AntiPlayNumThreshold@ */ Scalar_UBYTE 0 POD_FaultHandle_CM_uint8 0 255 /end CHARACTERISTIC
/begin MEASUREMENT monr_ADP_Value_TimerR "" FLOAT32_IEEE POD_FaultHandle_CM_single 0 0 -3.4E+38 3.4E+38 ECU_ADDRESS 0xb0055a94 /* @ECU_Address@monr_ADP_Value_TimerR@ */ /end MEASUREMENT
/begin MEASUREMENT monr_ADP_Value_TimeStampR "" FLOAT32_IEEE POD_FaultHandle_CM_single 0 0 -3.4E+38 3.4E+38 ECU_ADDRESS 0xb0055a8c /* @ECU_Address@monr_ADP_Value_TimeStampR@ */ /end MEASUREMENT
/begin MEASUREMENT monr_ADP_Value_HistoricalTimerR "" FLOAT32_IEEE POD_FaultHandle_CM_single 0 0 -3.4E+38 3.4E+38 ECU_ADDRESS 0xb0055a7c /* @ECU_Address@monr_ADP_Value_HistoricalTimerR@ */ /end MEASUREMENT
/begin MEASUREMENT monr_ADP_Value_SlowPointerR "" FLOAT32_IEEE POD_FaultHandle_CM_single 0 0 -3.4E+38 3.4E+38 ECU_ADDRESS 0xb0055a84 /* @ECU_Address@monr_ADP_Value_SlowPointerR@ */ /end MEASUREMENT
/begin MEASUREMENT monr_VfSHM_VehSpdLgtFH_mps "" FLOAT32_IEEE POD_FaultHandle_CM_single 0 0 -3.4E+38 3.4E+38 ECU_ADDRESS 0xb0055b78 /* @ECU_Address@monr_VfSHM_VehSpdLgtFH_mps@ */ /end MEASUREMENT
/begin MEASUREMENT monr_ADP_Value_FastPointerR "" FLOAT32_IEEE POD_FaultHandle_CM_single 0 0 -3.4E+38 3.4E+38 ECU_ADDRESS 0xb0055b90 /* @ECU_Address@monr_ADP_Value_FastPointerR@ */ /end MEASUREMENT
/begin MEASUREMENT monr_ADP_Value_TimerL "" FLOAT32_IEEE POD_FaultHandle_CM_single 0 0 -3.4E+38 3.4E+38 ECU_ADDRESS 0xb0055a90 /* @ECU_Address@monr_ADP_Value_TimerL@ */ /end MEASUREMENT
/begin MEASUREMENT monr_ADP_Value_TimeStampL "" FLOAT32_IEEE POD_FaultHandle_CM_single 0 0 -3.4E+38 3.4E+38 ECU_ADDRESS 0xb0055a88 /* @ECU_Address@monr_ADP_Value_TimeStampL@ */ /end MEASUREMENT
/begin MEASUREMENT monr_ADP_Value_HistoricalTimerL "" FLOAT32_IEEE POD_FaultHandle_CM_single 0 0 -3.4E+38 3.4E+38 ECU_ADDRESS 0xb0055b88 /* @ECU_Address@monr_ADP_Value_HistoricalTimerL@ */ /end MEASUREMENT
/begin MEASUREMENT monr_ADP_Value_SlowPointerL "" FLOAT32_IEEE POD_FaultHandle_CM_single 0 0 -3.4E+38 3.4E+38 ECU_ADDRESS 0xb0055a80 /* @ECU_Address@monr_ADP_Value_SlowPointerL@ */ /end MEASUREMENT
/begin MEASUREMENT monr_ADP_Value_FastPointerL "" FLOAT32_IEEE POD_FaultHandle_CM_single 0 0 -3.4E+38 3.4E+38 ECU_ADDRESS 0xb0055b8c /* @ECU_Address@monr_ADP_Value_FastPointerL@ */ /end MEASUREMENT
/begin MEASUREMENT monr_VfSHM_DoorRdrAgLFH_deg "" FLOAT32_IEEE POD_FaultHandle_CM_single 0 0 -3.4E+38 3.4E+38 ECU_ADDRESS 0xb0055b54 /* @ECU_Address@monr_VfSHM_DoorRdrAgLFH_deg@ */ /end MEASUREMENT
/begin MEASUREMENT monr_VfSHM_DoorRdrAgRFH_deg "" FLOAT32_IEEE POD_FaultHandle_CM_single 0 0 -3.4E+38 3.4E+38 ECU_ADDRESS 0xb0055b58 /* @ECU_Address@monr_VfSHM_DoorRdrAgRFH_deg@ */ /end MEASUREMENT
/begin MEASUREMENT monr_VfSHM_BatVoltageValueFH_MV "" FLOAT32_IEEE POD_FaultHandle_CM_single 0 0 -3.4E+38 3.4E+38 ECU_ADDRESS 0xb0055b50 /* @ECU_Address@monr_VfSHM_BatVoltageValueFH_MV@ */ /end MEASUREMENT
/begin MEASUREMENT monr_VfSHM_FrntIncinAgLFH_deg "" FLOAT32_IEEE POD_FaultHandle_CM_single 0 0 -3.4E+38 3.4E+38 ECU_ADDRESS 0xb0055b5c /* @ECU_Address@monr_VfSHM_FrntIncinAgLFH_deg@ */ /end MEASUREMENT
/begin MEASUREMENT monr_VfSHM_FrntIncinAgRFH_deg "" FLOAT32_IEEE POD_FaultHandle_CM_single 0 0 -3.4E+38 3.4E+38 ECU_ADDRESS 0xb0055b60 /* @ECU_Address@monr_VfSHM_FrntIncinAgRFH_deg@ */ /end MEASUREMENT
/begin MEASUREMENT monr_VfSHM_SideIncinAgLFH_deg "" FLOAT32_IEEE POD_FaultHandle_CM_single 0 0 -3.4E+38 3.4E+38 ECU_ADDRESS 0xb0055b6c /* @ECU_Address@monr_VfSHM_SideIncinAgLFH_deg@ */ /end MEASUREMENT
/begin MEASUREMENT monr_VfSHM_SideIncinAgRFH_deg "" FLOAT32_IEEE POD_FaultHandle_CM_single 0 0 -3.4E+38 3.4E+38 ECU_ADDRESS 0xb0055b70 /* @ECU_Address@monr_VfSHM_SideIncinAgRFH_deg@ */ /end MEASUREMENT
/begin MEASUREMENT monr_VfSHM_VehLVBattFH_V "" FLOAT32_IEEE POD_FaultHandle_CM_single 0 0 -3.4E+38 3.4E+38 ECU_ADDRESS 0xb0055b74 /* @ECU_Address@monr_VfSHM_VehLVBattFH_V@ */ /end MEASUREMENT
/begin MEASUREMENT monr_VfIMU_VehRollLFH_deg "" FLOAT32_IEEE POD_FaultHandle_CM_single 0 0 -3.4E+38 3.4E+38 ECU_ADDRESS 0xb0055b48 /* @ECU_Address@monr_VfIMU_VehRollLFH_deg@ */ /end MEASUREMENT
/begin MEASUREMENT monr_VfIMU_VehRollRFH_deg "" FLOAT32_IEEE POD_FaultHandle_CM_single 0 0 -3.4E+38 3.4E+38 ECU_ADDRESS 0xb0055b4c /* @ECU_Address@monr_VfIMU_VehRollRFH_deg@ */ /end MEASUREMENT
/begin MEASUREMENT monr_VfIMU_VehPitchLFH_deg "" FLOAT32_IEEE POD_FaultHandle_CM_single 0 0 -3.4E+38 3.4E+38 ECU_ADDRESS 0xb0055b40 /* @ECU_Address@monr_VfIMU_VehPitchLFH_deg@ */ /end MEASUREMENT
/begin MEASUREMENT monr_VfIMU_VehPitchRFH_deg "" FLOAT32_IEEE POD_FaultHandle_CM_single 0 0 -3.4E+38 3.4E+38 ECU_ADDRESS 0xb0055b44 /* @ECU_Address@monr_VfIMU_VehPitchRFH_deg@ */ /end MEASUREMENT
/begin MEASUREMENT monr_VfIMU_AgSpdLFH_degps "" FLOAT32_IEEE POD_FaultHandle_CM_single 0 0 -3.4E+38 3.4E+38 ECU_ADDRESS 0xb0055b38 /* @ECU_Address@monr_VfIMU_AgSpdLFH_degps@ */ /end MEASUREMENT
/begin MEASUREMENT monr_VfIMU_AgSpdRFH_degps "" FLOAT32_IEEE POD_FaultHandle_CM_single 0 0 -3.4E+38 3.4E+38 ECU_ADDRESS 0xb0055b3c /* @ECU_Address@monr_VfIMU_AgSpdRFH_degps@ */ /end MEASUREMENT
/begin MEASUREMENT monr_VfSHM_MainMotoCurrentLFH_MA "" FLOAT32_IEEE POD_FaultHandle_CM_single 0 0 -3.4E+38 3.4E+38 ECU_ADDRESS 0xb0055b64 /* @ECU_Address@monr_VfSHM_MainMotoCurrentLFH_MA@ */ /end MEASUREMENT
/begin MEASUREMENT monr_VfSHM_MainMotoCurrentRFH_MA "" FLOAT32_IEEE POD_FaultHandle_CM_single 0 0 -3.4E+38 3.4E+38 ECU_ADDRESS 0xb0055b68 /* @ECU_Address@monr_VfSHM_MainMotoCurrentRFH_MA@ */ /end MEASUREMENT
/begin MEASUREMENT monr_VuHHM_HallPWMLFH_Hz "" UWORD POD_FaultHandle_CM_uint16 0 0 0 65535 ECU_ADDRESS 0xb0055b80 /* @ECU_Address@monr_VuHHM_HallPWMLFH_Hz@ */ /end MEASUREMENT
/begin MEASUREMENT monr_VuHHM_HallPWMRFH_Hz "" UWORD POD_FaultHandle_CM_uint16 0 0 0 65535 ECU_ADDRESS 0xb0055b82 /* @ECU_Address@monr_VuHHM_HallPWMRFH_Hz@ */ /end MEASUREMENT
/begin MEASUREMENT monr_ADP_Value_AntiPlayActiveCounterR "" SWORD POD_FaultHandle_CM_int16 0 0 -32768 32767 ECU_ADDRESS 0xb0055b86 /* @ECU_Address@monr_ADP_Value_AntiPlayActiveCounterR@ */ /end MEASUREMENT
/begin MEASUREMENT monr_ADP_Value_AntiPlayActiveCounterL "" SWORD POD_FaultHandle_CM_int16 0 0 -32768 32767 ECU_ADDRESS 0xb0055b84 /* @ECU_Address@monr_ADP_Value_AntiPlayActiveCounterL@ */ /end MEASUREMENT
/begin MEASUREMENT monr_VsHHM_HallCntrLFH_NULL "" SWORD POD_FaultHandle_CM_int16 0 0 -32768 32767 ECU_ADDRESS 0xb0055b7c /* @ECU_Address@monr_VsHHM_HallCntrLFH_NULL@ */ /end MEASUREMENT
/begin MEASUREMENT monr_VsHHM_HallCntrRFH_NULL "" SWORD POD_FaultHandle_CM_int16 0 0 -32768 32767 ECU_ADDRESS 0xb0055b7e /* @ECU_Address@monr_VsHHM_HallCntrRFH_NULL@ */ /end MEASUREMENT
/begin MEASUREMENT monr_VeHHM_DoorMovStsLFH_NULL "" UBYTE POD_FaultHandle_CM_uint8 0 0 0 255 ECU_ADDRESS 0xb0055b0f /* @ECU_Address@monr_VeHHM_DoorMovStsLFH_NULL@ */ /end MEASUREMENT
/begin MEASUREMENT monr_VeHHM_DoorMovStsRFH_NULL "" UBYTE POD_FaultHandle_CM_uint8 0 0 0 255 ECU_ADDRESS 0xb0055b10 /* @ECU_Address@monr_VeHHM_DoorMovStsRFH_NULL@ */ /end MEASUREMENT
/begin MEASUREMENT monr_VeFMS_MaiMotErrL_NULL "" UBYTE POD_FaultHandle_CM_uint8 0 0 0 255 ECU_ADDRESS 0xb0055b0b /* @ECU_Address@monr_VeFMS_MaiMotErrL_NULL@ */ /end MEASUREMENT
/begin MEASUREMENT monr_VeSHM_VehSpdLgtQlyFH_enum "" UBYTE POD_FaultHandle_CM_uint8 0 0 0 255 ECU_ADDRESS 0xb0055b26 /* @ECU_Address@monr_VeSHM_VehSpdLgtQlyFH_enum@ */ /end MEASUREMENT
/begin MEASUREMENT monr_VeFMS_MaiMotErrR_NULL "" UBYTE POD_FaultHandle_CM_uint8 0 0 0 255 ECU_ADDRESS 0xb0055b0c /* @ECU_Address@monr_VeFMS_MaiMotErrR_NULL@ */ /end MEASUREMENT
/begin MEASUREMENT monr_VeSHM_DoorLckPstnLFH_enum "" UBYTE POD_FaultHandle_CM_uint8 0 0 0 255 ECU_ADDRESS 0xb0055b17 /* @ECU_Address@monr_VeSHM_DoorLckPstnLFH_enum@ */ /end MEASUREMENT
/begin MEASUREMENT monr_VeFH_DoorLckPstnL_enum "" UBYTE POD_FaultHandle_CM_uint8 0 0 0 255 ECU_ADDRESS 0xb0055b04 /* @ECU_Address@monr_VeFH_DoorLckPstnL_enum@ */ /end MEASUREMENT
/begin MEASUREMENT monr_VeSHM_WakeUpTypLFH_NULL "" UBYTE POD_FaultHandle_CM_uint8 0 0 0 255 ECU_ADDRESS 0xb0055b28 /* @ECU_Address@monr_VeSHM_WakeUpTypLFH_NULL@ */ /end MEASUREMENT
/begin MEASUREMENT monr_VeSHM_DoorLckPstnRFH_enum "" UBYTE POD_FaultHandle_CM_uint8 0 0 0 255 ECU_ADDRESS 0xb0055b18 /* @ECU_Address@monr_VeSHM_DoorLckPstnRFH_enum@ */ /end MEASUREMENT
/begin MEASUREMENT monr_VeFH_DoorLckPstnR_enum "" UBYTE POD_FaultHandle_CM_uint8 0 0 0 255 ECU_ADDRESS 0xb0055b05 /* @ECU_Address@monr_VeFH_DoorLckPstnR_enum@ */ /end MEASUREMENT
/begin MEASUREMENT monr_VeSHM_WakeUpTypRFH_NULL "" UBYTE POD_FaultHandle_CM_uint8 0 0 0 255 ECU_ADDRESS 0xb0055b29 /* @ECU_Address@monr_VeSHM_WakeUpTypRFH_NULL@ */ /end MEASUREMENT
/begin MEASUREMENT monr_VeMCM_CmdStateRFH_NULL "" UBYTE POD_FaultHandle_CM_uint8 0 0 0 255 ECU_ADDRESS 0xb0055b16 /* @ECU_Address@monr_VeMCM_CmdStateRFH_NULL@ */ /end MEASUREMENT
/begin MEASUREMENT monr_VeHHM_UsrSetMaxPstnLFH_pct "" UBYTE POD_FaultHandle_CM_uint8 0 0 0 255 ECU_ADDRESS 0xb0055b11 /* @ECU_Address@monr_VeHHM_UsrSetMaxPstnLFH_pct@ */ /end MEASUREMENT
/begin MEASUREMENT monr_VeHHM_UsrSetMaxPstnRFH_pct "" UBYTE POD_FaultHandle_CM_uint8 0 0 0 255 ECU_ADDRESS 0xb0055b12 /* @ECU_Address@monr_VeHHM_UsrSetMaxPstnRFH_pct@ */ /end MEASUREMENT
/begin MEASUREMENT monr_VeSHM_DoorModStsFH_enum "" UBYTE POD_FaultHandle_CM_uint8 0 0 0 255 ECU_ADDRESS 0xb0055b19 /* @ECU_Address@monr_VeSHM_DoorModStsFH_enum@ */ /end MEASUREMENT
/begin MEASUREMENT monr_VeSMM_DOPFcnStateLFH_enum "" UBYTE POD_FaultHandle_CM_uint8 0 0 0 255 ECU_ADDRESS 0xb0055b2a /* @ECU_Address@monr_VeSMM_DOPFcnStateLFH_enum@ */ /end MEASUREMENT
/begin MEASUREMENT monr_VeSMM_DOPFcnStateRFH_enum "" UBYTE POD_FaultHandle_CM_uint8 0 0 0 255 ECU_ADDRESS 0xb0055b2b /* @ECU_Address@monr_VeSMM_DOPFcnStateRFH_enum@ */ /end MEASUREMENT
/begin MEASUREMENT monr_VeSHM_FrntIncinAgQlyLFH_enum "" UBYTE POD_FaultHandle_CM_uint8 0 0 0 255 ECU_ADDRESS 0xb0055b1e /* @ECU_Address@monr_VeSHM_FrntIncinAgQlyLFH_enum@ */ /end MEASUREMENT
/begin MEASUREMENT monr_VeSHM_FrntIncinAgQlyRFH_enum "" UBYTE POD_FaultHandle_CM_uint8 0 0 0 255 ECU_ADDRESS 0xb0055b1f /* @ECU_Address@monr_VeSHM_FrntIncinAgQlyRFH_enum@ */ /end MEASUREMENT
/begin MEASUREMENT monr_VeSHM_SideIncinAgQlyLFH_enum "" UBYTE POD_FaultHandle_CM_uint8 0 0 0 255 ECU_ADDRESS 0xb0055b22 /* @ECU_Address@monr_VeSHM_SideIncinAgQlyLFH_enum@ */ /end MEASUREMENT
/begin MEASUREMENT monr_VeSHM_SideIncinAgQlyRFH_enum "" UBYTE POD_FaultHandle_CM_uint8 0 0 0 255 ECU_ADDRESS 0xb0055b23 /* @ECU_Address@monr_VeSHM_SideIncinAgQlyRFH_enum@ */ /end MEASUREMENT
/begin MEASUREMENT monr_VeSHM_VehSptStsFH_enum "" UBYTE POD_FaultHandle_CM_uint8 0 0 0 255 ECU_ADDRESS 0xb0055b27 /* @ECU_Address@monr_VeSHM_VehSptStsFH_enum@ */ /end MEASUREMENT
/begin MEASUREMENT monr_VeSHM_DoorTypCfgFH_enum "" UBYTE POD_FaultHandle_CM_uint8 0 0 0 255 ECU_ADDRESS 0xb0055b1a /* @ECU_Address@monr_VeSHM_DoorTypCfgFH_enum@ */ /end MEASUREMENT
/begin MEASUREMENT monr_VeSHM_DoorWrkReqLFH_enum "" UBYTE POD_FaultHandle_CM_uint8 0 0 0 255 ECU_ADDRESS 0xb0055b1b /* @ECU_Address@monr_VeSHM_DoorWrkReqLFH_enum@ */ /end MEASUREMENT
/begin MEASUREMENT monr_VeSHM_DoorWrkReqRFH_enum "" UBYTE POD_FaultHandle_CM_uint8 0 0 0 255 ECU_ADDRESS 0xb0055b1c /* @ECU_Address@monr_VeSHM_DoorWrkReqRFH_enum@ */ /end MEASUREMENT
/begin MEASUREMENT monr_VeSMM_MotorCtrlModeLFH_enum "" UBYTE POD_FaultHandle_CM_uint8 0 0 0 255 ECU_ADDRESS 0xb0055b2c /* @ECU_Address@monr_VeSMM_MotorCtrlModeLFH_enum@ */ /end MEASUREMENT
/begin MEASUREMENT monr_VeSMM_MotorCtrlModeRFH_enum "" UBYTE POD_FaultHandle_CM_uint8 0 0 0 255 ECU_ADDRESS 0xb0055b2d /* @ECU_Address@monr_VeSMM_MotorCtrlModeRFH_enum@ */ /end MEASUREMENT
/begin MEASUREMENT monr_VeSMM_MotorCtrlStateLFH_enum "" UBYTE POD_FaultHandle_CM_uint8 0 0 0 255 ECU_ADDRESS 0xb0055b2e /* @ECU_Address@monr_VeSMM_MotorCtrlStateLFH_enum@ */ /end MEASUREMENT
/begin MEASUREMENT monr_VeSMM_MotorCtrlStateRFH_enum "" UBYTE POD_FaultHandle_CM_uint8 0 0 0 255 ECU_ADDRESS 0xb0055b2f /* @ECU_Address@monr_VeSMM_MotorCtrlStateRFH_enum@ */ /end MEASUREMENT
/begin MEASUREMENT monr_VeMCM_CmdStateLFH_NULL "" UBYTE POD_FaultHandle_CM_uint8 0 0 0 255 ECU_ADDRESS 0xb0055b15 /* @ECU_Address@monr_VeMCM_CmdStateLFH_NULL@ */ /end MEASUREMENT
/begin MEASUREMENT monr_VbFH_AnptiplayR_flg "" UBYTE POD_FaultHandle_CM_boolean 0 0 0 1 ECU_ADDRESS 0xb0055a9b /* @ECU_Address@monr_VbFH_AnptiplayR_flg@ */ /end MEASUREMENT
/begin MEASUREMENT monr_VbFMS_MCUOHLvl2ErrL_FMS_flg "" UBYTE POD_FaultHandle_CM_boolean 0 0 0 1 ECU_ADDRESS 0xb0055ac2 /* @ECU_Address@monr_VbFMS_MCUOHLvl2ErrL_FMS_flg@ */ /end MEASUREMENT
/begin MEASUREMENT monr_VbFMS_CAN1BusOffErrL_FMS_flg "" UBYTE POD_FaultHandle_CM_boolean 0 0 0 1 ECU_ADDRESS 0xb0055ab4 /* @ECU_Address@monr_VbFMS_CAN1BusOffErrL_FMS_flg@ */ /end MEASUREMENT
/begin MEASUREMENT monr_VbFMS_CemFr09TiOutL_FMS_flg "" UBYTE POD_FaultHandle_CM_boolean 0 0 0 1 ECU_ADDRESS 0xb0055aba /* @ECU_Address@monr_VbFMS_CemFr09TiOutL_FMS_flg@ */ /end MEASUREMENT
/begin MEASUREMENT monr_VbFMS_MaiMotOCErrL_flg "" UBYTE POD_FaultHandle_CM_boolean 0 0 0 1 ECU_ADDRESS 0xb0055ac4 /* @ECU_Address@monr_VbFMS_MaiMotOCErrL_flg@ */ /end MEASUREMENT
/begin MEASUREMENT monr_VbFMS_MaiMotVDSULErrL_flg "" UBYTE POD_FaultHandle_CM_boolean 0 0 0 1 ECU_ADDRESS 0xb0055ad2 /* @ECU_Address@monr_VbFMS_MaiMotVDSULErrL_flg@ */ /end MEASUREMENT
/begin MEASUREMENT monr_VbFMS_RAMErrL_flg "" UBYTE POD_FaultHandle_CM_boolean 0 0 0 1 ECU_ADDRESS 0xb0055ada /* @ECU_Address@monr_VbFMS_RAMErrL_flg@ */ /end MEASUREMENT
/begin MEASUREMENT monr_VbFMS_RdrTimeOutRawL_flg "" UBYTE POD_FaultHandle_CM_boolean 0 0 0 1 ECU_ADDRESS 0xb0055ade /* @ECU_Address@monr_VbFMS_RdrTimeOutRawL_flg@ */ /end MEASUREMENT
/begin MEASUREMENT monr_VbFH_MotOvrheatProtL_flg "" UBYTE POD_FaultHandle_CM_boolean 0 0 0 1 ECU_ADDRESS 0xb0055aa8 /* @ECU_Address@monr_VbFH_MotOvrheatProtL_flg@ */ /end MEASUREMENT
/begin MEASUREMENT monr_VbHHM_HallSigFltLFH_flg "" UBYTE POD_FaultHandle_CM_boolean 0 0 0 1 ECU_ADDRESS 0xb0055aec /* @ECU_Address@monr_VbHHM_HallSigFltLFH_flg@ */ /end MEASUREMENT
/begin MEASUREMENT monr_VbFH_FrbdMaiMotWrkL_flg "" UBYTE POD_FaultHandle_CM_boolean 0 0 0 1 ECU_ADDRESS 0xb0055aa0 /* @ECU_Address@monr_VbFH_FrbdMaiMotWrkL_flg@ */ /end MEASUREMENT
/begin MEASUREMENT monr_VbFH_HallSigErrL_flg "" UBYTE POD_FaultHandle_CM_boolean 0 0 0 1 ECU_ADDRESS 0xb0055aa6 /* @ECU_Address@monr_VbFH_HallSigErrL_flg@ */ /end MEASUREMENT
/begin MEASUREMENT monr_VbFMS_MCUOHLvl2ErrR_FMS_flg "" UBYTE POD_FaultHandle_CM_boolean 0 0 0 1 ECU_ADDRESS 0xb0055ac3 /* @ECU_Address@monr_VbFMS_MCUOHLvl2ErrR_FMS_flg@ */ /end MEASUREMENT
/begin MEASUREMENT monr_VbFMS_CAN1BusOffErrR_FMS_flg "" UBYTE POD_FaultHandle_CM_boolean 0 0 0 1 ECU_ADDRESS 0xb0055ab5 /* @ECU_Address@monr_VbFMS_CAN1BusOffErrR_FMS_flg@ */ /end MEASUREMENT
/begin MEASUREMENT monr_VbFMS_CemFr09TiOutR_FMS_flg "" UBYTE POD_FaultHandle_CM_boolean 0 0 0 1 ECU_ADDRESS 0xb0055abb /* @ECU_Address@monr_VbFMS_CemFr09TiOutR_FMS_flg@ */ /end MEASUREMENT
/begin MEASUREMENT monr_VbFMS_MaiMotOCErrR_flg "" UBYTE POD_FaultHandle_CM_boolean 0 0 0 1 ECU_ADDRESS 0xb0055ac5 /* @ECU_Address@monr_VbFMS_MaiMotOCErrR_flg@ */ /end MEASUREMENT
/begin MEASUREMENT monr_VbFMS_MaiMotVDSULErrR_flg "" UBYTE POD_FaultHandle_CM_boolean 0 0 0 1 ECU_ADDRESS 0xb0055ad3 /* @ECU_Address@monr_VbFMS_MaiMotVDSULErrR_flg@ */ /end MEASUREMENT
/begin MEASUREMENT monr_VbFMS_RAMErrR_flg "" UBYTE POD_FaultHandle_CM_boolean 0 0 0 1 ECU_ADDRESS 0xb0055adb /* @ECU_Address@monr_VbFMS_RAMErrR_flg@ */ /end MEASUREMENT
/begin MEASUREMENT monr_VbFMS_RdrTimeOutRaw_flg "" UBYTE POD_FaultHandle_CM_boolean 0 0 0 1 ECU_ADDRESS 0xb0055adf /* @ECU_Address@monr_VbFMS_RdrTimeOutRaw_flg@ */ /end MEASUREMENT
/begin MEASUREMENT monr_VbFH_MotOvrheatProtR_flg "" UBYTE POD_FaultHandle_CM_boolean 0 0 0 1 ECU_ADDRESS 0xb0055aa9 /* @ECU_Address@monr_VbFH_MotOvrheatProtR_flg@ */ /end MEASUREMENT
/begin MEASUREMENT monr_VbHHM_HallSigFltRFH_flg "" UBYTE POD_FaultHandle_CM_boolean 0 0 0 1 ECU_ADDRESS 0xb0055aed /* @ECU_Address@monr_VbHHM_HallSigFltRFH_flg@ */ /end MEASUREMENT
/begin MEASUREMENT monr_VbFH_FrbdMaiMotWrkR_flg "" UBYTE POD_FaultHandle_CM_boolean 0 0 0 1 ECU_ADDRESS 0xb0055aa1 /* @ECU_Address@monr_VbFH_FrbdMaiMotWrkR_flg@ */ /end MEASUREMENT
/begin MEASUREMENT monr_VbFH_HallSigErrR_flg "" UBYTE POD_FaultHandle_CM_boolean 0 0 0 1 ECU_ADDRESS 0xb0055aa7 /* @ECU_Address@monr_VbFH_HallSigErrR_flg@ */ /end MEASUREMENT
/begin MEASUREMENT monr_VbFMS_HallBSCGErrR_flg "" UBYTE POD_FaultHandle_CM_boolean 0 0 0 1 ECU_ADDRESS 0xb0055ac1 /* @ECU_Address@monr_VbFMS_HallBSCGErrR_flg@ */ /end MEASUREMENT
/begin MEASUREMENT monr_VbFMS_MaiMotSCBErrR_flg "" UBYTE POD_FaultHandle_CM_boolean 0 0 0 1 ECU_ADDRESS 0xb0055ac9 /* @ECU_Address@monr_VbFMS_MaiMotSCBErrR_flg@ */ /end MEASUREMENT
/begin MEASUREMENT monr_VbFMS_MaiMotSCGErrR_flg "" UBYTE POD_FaultHandle_CM_boolean 0 0 0 1 ECU_ADDRESS 0xb0055acd /* @ECU_Address@monr_VbFMS_MaiMotSCGErrR_flg@ */ /end MEASUREMENT
/begin MEASUREMENT monr_VbFMS_CemFr05TiOutR_FMS_flg "" UBYTE POD_FaultHandle_CM_boolean 0 0 0 1 ECU_ADDRESS 0xb0055ab9 /* @ECU_Address@monr_VbFMS_CemFr05TiOutR_FMS_flg@ */ /end MEASUREMENT
/begin MEASUREMENT monr_VbFMS_CAN0BusOffErrR_FMS_flg "" UBYTE POD_FaultHandle_CM_boolean 0 0 0 1 ECU_ADDRESS 0xb0055ab3 /* @ECU_Address@monr_VbFMS_CAN0BusOffErrR_FMS_flg@ */ /end MEASUREMENT
/begin MEASUREMENT monr_VbFMS_SPIComErrR_FMS_flg "" UBYTE POD_FaultHandle_CM_boolean 0 0 0 1 ECU_ADDRESS 0xb0055ae3 /* @ECU_Address@monr_VbFMS_SPIComErrR_FMS_flg@ */ /end MEASUREMENT
/begin MEASUREMENT monr_VbFMS_HallBSCGErrL_flg "" UBYTE POD_FaultHandle_CM_boolean 0 0 0 1 ECU_ADDRESS 0xb0055ac0 /* @ECU_Address@monr_VbFMS_HallBSCGErrL_flg@ */ /end MEASUREMENT
/begin MEASUREMENT monr_VbFMS_MaiMotSCBErrL_flg "" UBYTE POD_FaultHandle_CM_boolean 0 0 0 1 ECU_ADDRESS 0xb0055ac8 /* @ECU_Address@monr_VbFMS_MaiMotSCBErrL_flg@ */ /end MEASUREMENT
/begin MEASUREMENT monr_VbFMS_MaiMotSCGErrL_flg "" UBYTE POD_FaultHandle_CM_boolean 0 0 0 1 ECU_ADDRESS 0xb0055acc /* @ECU_Address@monr_VbFMS_MaiMotSCGErrL_flg@ */ /end MEASUREMENT
/begin MEASUREMENT monr_VbFMS_CemFr05TiOutL_FMS_flg "" UBYTE POD_FaultHandle_CM_boolean 0 0 0 1 ECU_ADDRESS 0xb0055ab8 /* @ECU_Address@monr_VbFMS_CemFr05TiOutL_FMS_flg@ */ /end MEASUREMENT
/begin MEASUREMENT monr_VbFMS_CAN0BusOffErrL_FMS_flg "" UBYTE POD_FaultHandle_CM_boolean 0 0 0 1 ECU_ADDRESS 0xb0055ab2 /* @ECU_Address@monr_VbFMS_CAN0BusOffErrL_FMS_flg@ */ /end MEASUREMENT
/begin MEASUREMENT monr_VbFMS_SPIComErrL_FMS_flg "" UBYTE POD_FaultHandle_CM_boolean 0 0 0 1 ECU_ADDRESS 0xb0055ae2 /* @ECU_Address@monr_VbFMS_SPIComErrL_FMS_flg@ */ /end MEASUREMENT
/begin MEASUREMENT monr_VbFH_AnptiplayL_flg "" UBYTE POD_FaultHandle_CM_boolean 0 0 0 1 ECU_ADDRESS 0xb0055a9a /* @ECU_Address@monr_VbFH_AnptiplayL_flg@ */ /end MEASUREMENT
/begin MEASUREMENT monr_VbFH_FrntIncinAgFltL_flg "" UBYTE POD_FaultHandle_CM_boolean 0 0 0 1 ECU_ADDRESS 0xb0055aa2 /* @ECU_Address@monr_VbFH_FrntIncinAgFltL_flg@ */ /end MEASUREMENT
/begin MEASUREMENT monr_VbFH_SideIncinAgFltL_flg "" UBYTE POD_FaultHandle_CM_boolean 0 0 0 1 ECU_ADDRESS 0xb0055aac /* @ECU_Address@monr_VbFH_SideIncinAgFltL_flg@ */ /end MEASUREMENT
/begin MEASUREMENT monr_VbFH_GyroSigFltL_flg "" UBYTE POD_FaultHandle_CM_boolean 0 0 0 1 ECU_ADDRESS 0xb0055aa4 /* @ECU_Address@monr_VbFH_GyroSigFltL_flg@ */ /end MEASUREMENT
/begin MEASUREMENT monr_VbFH_RdrTioutL_flg "" UBYTE POD_FaultHandle_CM_boolean 0 0 0 1 ECU_ADDRESS 0xb0055aaa /* @ECU_Address@monr_VbFH_RdrTioutL_flg@ */ /end MEASUREMENT
/begin MEASUREMENT monr_VbFH_FrntIncinAgFltR_flg "" UBYTE POD_FaultHandle_CM_boolean 0 0 0 1 ECU_ADDRESS 0xb0055aa3 /* @ECU_Address@monr_VbFH_FrntIncinAgFltR_flg@ */ /end MEASUREMENT
/begin MEASUREMENT monr_VbFH_SideIncinAgFltR_flg "" UBYTE POD_FaultHandle_CM_boolean 0 0 0 1 ECU_ADDRESS 0xb0055aad /* @ECU_Address@monr_VbFH_SideIncinAgFltR_flg@ */ /end MEASUREMENT
/begin MEASUREMENT monr_VbFH_GyroSigFltR_flg "" UBYTE POD_FaultHandle_CM_boolean 0 0 0 1 ECU_ADDRESS 0xb0055aa5 /* @ECU_Address@monr_VbFH_GyroSigFltR_flg@ */ /end MEASUREMENT
/begin MEASUREMENT monr_VbFH_RdrTioutR_flg "" UBYTE POD_FaultHandle_CM_boolean 0 0 0 1 ECU_ADDRESS 0xb0055aab /* @ECU_Address@monr_VbFH_RdrTioutR_flg@ */ /end MEASUREMENT
/begin MEASUREMENT monr_VbFH_ECUWakeUpL_flg "" UBYTE POD_FaultHandle_CM_boolean 0 0 0 1 ECU_ADDRESS 0xb0055a9c /* @ECU_Address@monr_VbFH_ECUWakeUpL_flg@ */ /end MEASUREMENT
/begin MEASUREMENT monr_VbFH_ECUWakeUpR_flg "" UBYTE POD_FaultHandle_CM_boolean 0 0 0 1 ECU_ADDRESS 0xb0055a9d /* @ECU_Address@monr_VbFH_ECUWakeUpR_flg@ */ /end MEASUREMENT
/begin MEASUREMENT monr_VbFH_VBattNrml_flg "" UBYTE POD_FaultHandle_CM_boolean 0 0 0 1 ECU_ADDRESS 0xb0055ab1 /* @ECU_Address@monr_VbFH_VBattNrml_flg@ */ /end MEASUREMENT
/begin MEASUREMENT monr_VbAP_AntiPinchStsDspLFH_flg "" UBYTE POD_FaultHandle_CM_boolean 0 0 0 1 ECU_ADDRESS 0xb0055a98 /* @ECU_Address@monr_VbAP_AntiPinchStsDspLFH_flg@ */ /end MEASUREMENT
/begin MEASUREMENT monr_VbAP_AntiPinchStsDspRFH_flg "" UBYTE POD_FaultHandle_CM_boolean 0 0 0 1 ECU_ADDRESS 0xb0055a99 /* @ECU_Address@monr_VbAP_AntiPinchStsDspRFH_flg@ */ /end MEASUREMENT
/begin MEASUREMENT monr_VbSMM_BrkFrcRelsLFH_flg "" UBYTE POD_FaultHandle_CM_boolean 0 0 0 1 ECU_ADDRESS 0xb0055afa /* @ECU_Address@monr_VbSMM_BrkFrcRelsLFH_flg@ */ /end MEASUREMENT
/begin MEASUREMENT monr_VbSMM_BrkFrcRelsRFH_flg "" UBYTE POD_FaultHandle_CM_boolean 0 0 0 1 ECU_ADDRESS 0xb0055afb /* @ECU_Address@monr_VbSMM_BrkFrcRelsRFH_flg@ */ /end MEASUREMENT
/begin MEASUREMENT monr_VbSMM_BrkMotModCtrlLFH_flg "" UBYTE POD_FaultHandle_CM_boolean 0 0 0 1 ECU_ADDRESS 0xb0055afc /* @ECU_Address@monr_VbSMM_BrkMotModCtrlLFH_flg@ */ /end MEASUREMENT
/begin MEASUREMENT monr_VbSMM_BrkMotModCtrlRFH_flg "" UBYTE POD_FaultHandle_CM_boolean 0 0 0 1 ECU_ADDRESS 0xb0055afd /* @ECU_Address@monr_VbSMM_BrkMotModCtrlRFH_flg@ */ /end MEASUREMENT
/begin MEASUREMENT monr_VbSMM_RdrWrkReqLFH_flg "" UBYTE POD_FaultHandle_CM_boolean 0 0 0 1 ECU_ADDRESS 0xb0055b02 /* @ECU_Address@monr_VbSMM_RdrWrkReqLFH_flg@ */ /end MEASUREMENT
/begin MEASUREMENT monr_VbSMM_RdrWrkReqRFH_flg "" UBYTE POD_FaultHandle_CM_boolean 0 0 0 1 ECU_ADDRESS 0xb0055b03 /* @ECU_Address@monr_VbSMM_RdrWrkReqRFH_flg@ */ /end MEASUREMENT
/begin MEASUREMENT monr_VbSMM_ElecDoorClsReqLFH_flg "" UBYTE POD_FaultHandle_CM_boolean 0 0 0 1 ECU_ADDRESS 0xb0055afe /* @ECU_Address@monr_VbSMM_ElecDoorClsReqLFH_flg@ */ /end MEASUREMENT
/begin MEASUREMENT monr_VbSMM_ElecDoorClsReqRFH_flg "" UBYTE POD_FaultHandle_CM_boolean 0 0 0 1 ECU_ADDRESS 0xb0055aff /* @ECU_Address@monr_VbSMM_ElecDoorClsReqRFH_flg@ */ /end MEASUREMENT
/begin MEASUREMENT monr_VbSMM_ElecDoorOpenReqLFH_flg "" UBYTE POD_FaultHandle_CM_boolean 0 0 0 1 ECU_ADDRESS 0xb0055b00 /* @ECU_Address@monr_VbSMM_ElecDoorOpenReqLFH_flg@ */ /end MEASUREMENT
/begin MEASUREMENT monr_VbSMM_ElecDoorOpenReqRFH_flg "" UBYTE POD_FaultHandle_CM_boolean 0 0 0 1 ECU_ADDRESS 0xb0055b01 /* @ECU_Address@monr_VbSMM_ElecDoorOpenReqRFH_flg@ */ /end MEASUREMENT
/begin COMPU_METHOD POD_FaultHandle_CM_single "Q = V" RAT_FUNC "%8.6" "" COEFFS 0 1 0 0 0 1 /end COMPU_METHOD
/begin COMPU_METHOD POD_FaultHandle_CM_single_ms "Q = V" RAT_FUNC "%8.6" "ms" COEFFS 0 1 0 0 0 1 /end COMPU_METHOD
/begin COMPU_METHOD POD_FaultHandle_CM_uint16_s "Q = V" RAT_FUNC "%5.0" "s" COEFFS 0 1 0 0 0 1 /end COMPU_METHOD
/begin COMPU_METHOD POD_FaultHandle_CM_boolean "Q = V" RAT_FUNC "%1.0" "" COEFFS 0 1 0 0 0 1 /end COMPU_METHOD
/begin COMPU_METHOD POD_FaultHandle_CM_uint8 "Q = V" RAT_FUNC "%3.0" "" COEFFS 0 1 0 0 0 1 /end COMPU_METHOD
/begin COMPU_METHOD POD_FaultHandle_CM_uint16 "Q = V" RAT_FUNC "%5.0" "" COEFFS 0 1 0 0 0 1 /end COMPU_METHOD
/begin COMPU_METHOD POD_FaultHandle_CM_int16 "Q = V" RAT_FUNC "%5.0" "" COEFFS 0 1 0 0 0 1 /end COMPU_METHOD
/begin GROUP POD_FaultHandle "POD_FaultHandle" ROOT /begin SUB_GROUP Root_POD_FaultHandle /end SUB_GROUP /end GROUP
/begin GROUP Root_POD_FaultHandle "POD_FaultHandle/POD_FaultHandle" /begin SUB_GROUP S2_FaultHandle /end SUB_GROUP
 /begin REF_MEASUREMENT monr_VbAP_AntiPinchStsDspLFH_flg monr_VbAP_AntiPinchStsDspRFH_flg monr_VbHHM_HallSigFltLFH_flg monr_VbHHM_HallSigFltRFH_flg monr_VbSMM_BrkFrcRelsLFH_flg monr_VbSMM_BrkFrcRelsRFH_flg monr_VbSMM_BrkMotModCtrlLFH_flg monr_VbSMM_BrkMotModCtrlRFH_flg monr_VbSMM_ElecDoorClsReqLFH_flg monr_VbSMM_ElecDoorClsReqRFH_flg monr_VbSMM_ElecDoorOpenReqLFH_flg monr_VbSMM_ElecDoorOpenReqRFH_flg monr_VbSMM_RdrWrkReqLFH_flg monr_VbSMM_RdrWrkReqRFH_flg monr_VeHHM_DoorMovStsLFH_NULL monr_VeHHM_DoorMovStsRFH_NULL monr_VeHHM_UsrSetMaxPstnLFH_pct monr_VeHHM_UsrSetMaxPstnRFH_pct monr_VeMCM_CmdStateLFH_NULL monr_VeMCM_CmdStateRFH_NULL monr_VeSHM_DoorLckPstnLFH_enum monr_VeSHM_DoorLckPstnRFH_enum monr_VeSHM_DoorModStsFH_enum monr_VeSHM_DoorTypCfgFH_enum monr_VeSHM_DoorWrkReqLFH_enum monr_VeSHM_DoorWrkReqRFH_enum monr_VeSHM_FrntIncinAgQlyLFH_enum monr_VeSHM_FrntIncinAgQlyRFH_enum monr_VeSHM_SideIncinAgQlyLFH_enum monr_VeSHM_SideIncinAgQlyRFH_enum monr_VeSHM_VehSpdLgtQlyFH_enum monr_VeSHM_VehSptStsFH_enum monr_VeSHM_WakeUpTypLFH_NULL monr_VeSHM_WakeUpTypRFH_NULL monr_VeSMM_DOPFcnStateLFH_enum monr_VeSMM_DOPFcnStateRFH_enum monr_VeSMM_MotorCtrlModeLFH_enum monr_VeSMM_MotorCtrlModeRFH_enum monr_VeSMM_MotorCtrlStateLFH_enum monr_VeSMM_MotorCtrlStateRFH_enum monr_VfIMU_AgSpdLFH_degps monr_VfIMU_AgSpdRFH_degps monr_VfIMU_VehPitchLFH_deg monr_VfIMU_VehPitchRFH_deg monr_VfIMU_VehRollLFH_deg monr_VfIMU_VehRollRFH_deg monr_VfSHM_BatVoltageValueFH_MV monr_VfSHM_DoorRdrAgLFH_deg monr_VfSHM_DoorRdrAgRFH_deg monr_VfSHM_FrntIncinAgLFH_deg monr_VfSHM_FrntIncinAgRFH_deg monr_VfSHM_MainMotoCurrentLFH_MA monr_VfSHM_MainMotoCurrentRFH_MA monr_VfSHM_SideIncinAgLFH_deg monr_VfSHM_SideIncinAgRFH_deg monr_VfSHM_VehLVBattFH_V monr_VfSHM_VehSpdLgtFH_mps monr_VsHHM_HallCntrLFH_NULL monr_VsHHM_HallCntrRFH_NULL monr_VuHHM_HallPWMLFH_Hz monr_VuHHM_HallPWMRFH_Hz /end REF_MEASUREMENT
/end GROUP
/begin GROUP S2_FaultHandle "POD_FaultHandle/POD_FaultHandle/FaultHandle" /begin SUB_GROUP S3_AntiPlay S3_FMS S3_LVM /end SUB_GROUP /begin REF_MEASUREMENT monr_VbFH_VBattNrml_flg /end REF_MEASUREMENT /end GROUP
/begin GROUP S3_AntiPlay "POD_FaultHandle/POD_FaultHandle/FaultHandle/AntiPlay" /begin SUB_GROUP S4_AntiPlayL S4_AntiPlayR /end SUB_GROUP /end GROUP
/begin GROUP S3_FMS "POD_FaultHandle/POD_FaultHandle/FaultHandle/FMS" /begin SUB_GROUP S5_FMSL S5_FMSR /end SUB_GROUP /end GROUP
/begin GROUP S3_LVM "POD_FaultHandle/POD_FaultHandle/FaultHandle/LVM" /begin SUB_GROUP S6_LVML S6_LVMR /end SUB_GROUP /begin REF_MEASUREMENT monr_VeFH_DoorLckPstnL_enum /end REF_MEASUREMENT /end GROUP
/begin GROUP S4_AntiPlayL "POD_FaultHandle/POD_FaultHandle/FaultHandle/AntiPlay/AntiPlayL" /begin SUB_GROUP S7_AntiplayStatus /end SUB_GROUP /end GROUP
/begin GROUP S4_AntiPlayR "POD_FaultHandle/POD_FaultHandle/FaultHandle/AntiPlay/AntiPlayR" /begin SUB_GROUP S8_AntiplayStatus /end SUB_GROUP /end GROUP
/begin GROUP S5_FMSL "POD_FaultHandle/POD_FaultHandle/FaultHandle/FMS/FMSL" /begin SUB_GROUP S83_ArrayProces1 S83_Event S83_Event1 S83_FIM /end SUB_GROUP
 /begin REF_MEASUREMENT monr_VbFH_HallSigErrL_flg monr_VbFMS_CAN0BusOffErrL_FMS_flg monr_VbFMS_CAN1BusOffErrL_FMS_flg monr_VbFMS_CemFr05TiOutL_FMS_flg monr_VbFMS_CemFr09TiOutL_FMS_flg monr_VbFMS_MCUOHLvl2ErrL_FMS_flg monr_VbFMS_SPIComErrL_FMS_flg /end REF_MEASUREMENT
/end GROUP
/begin GROUP S5_FMSR "POD_FaultHandle/POD_FaultHandle/FaultHandle/FMS/FMSR" /begin SUB_GROUP S84_ArrayProces1 S84_Event S84_Event1 S84_FIM /end SUB_GROUP
 /begin REF_MEASUREMENT monr_VbFH_HallSigErrR_flg monr_VbFMS_CAN0BusOffErrR_FMS_flg monr_VbFMS_CAN1BusOffErrR_FMS_flg monr_VbFMS_CemFr05TiOutR_FMS_flg monr_VbFMS_CemFr09TiOutR_FMS_flg monr_VbFMS_MCUOHLvl2ErrR_FMS_flg monr_VbFMS_SPIComErrR_FMS_flg /end REF_MEASUREMENT
/end GROUP
/begin GROUP S6_LVML "POD_FaultHandle/POD_FaultHandle/FaultHandle/LVM/LVML" /begin SUB_GROUP S165_State /end SUB_GROUP /end GROUP
/begin GROUP S6_LVMR "POD_FaultHandle/POD_FaultHandle/FaultHandle/LVM/LVMR" /begin SUB_GROUP S166_LockState S166_State /end SUB_GROUP /end GROUP
/begin GROUP S7_AntiplayStatus "POD_FaultHandle/POD_FaultHandle/FaultHandle/AntiPlay/AntiPlayL/AntiplayStatus" /begin SUB_GROUP S9_ADPPara S9_AntiPlayState /end SUB_GROUP
 /begin REF_MEASUREMENT monr_ADP_Value_FastPointerL monr_ADP_Value_HistoricalTimerL monr_ADP_Value_SlowPointerL monr_ADP_Value_TimeStampL monr_ADP_Value_TimerL /end REF_MEASUREMENT
/end GROUP
/begin GROUP S8_AntiplayStatus "POD_FaultHandle/POD_FaultHandle/FaultHandle/AntiPlay/AntiPlayR/AntiplayStatus" /begin SUB_GROUP S47_ADPPara S47_AntiPlayState /end SUB_GROUP
 /begin REF_MEASUREMENT monr_ADP_Value_FastPointerR monr_ADP_Value_HistoricalTimerR monr_ADP_Value_SlowPointerR monr_ADP_Value_TimeStampR monr_ADP_Value_TimerR /end REF_MEASUREMENT
/end GROUP
/begin GROUP S83_ArrayProces1 "POD_FaultHandle/POD_FaultHandle/FaultHandle/FMS/FMSL/ArrayProces1" /begin SUB_GROUP S87_Byte1 S87_Byte2 S87_Byte4 /end SUB_GROUP /end GROUP
/begin GROUP S83_Event "POD_FaultHandle/POD_FaultHandle/FaultHandle/FMS/FMSL/Event" /begin SUB_GROUP S88_CEM S88_System /end SUB_GROUP /end GROUP
/begin GROUP S83_Event1 "POD_FaultHandle/POD_FaultHandle/FaultHandle/FMS/FMSL/Event1" /begin SUB_GROUP S89_RdrTimeout /end SUB_GROUP /begin REF_MEASUREMENT monr_VbFH_MotOvrheatProtL_flg /end REF_MEASUREMENT /end GROUP
/begin GROUP S83_FIM "POD_FaultHandle/POD_FaultHandle/FaultHandle/FMS/FMSL/FIM" /begin REF_MEASUREMENT monr_VbFH_FrbdMaiMotWrkL_flg /end REF_MEASUREMENT /end GROUP
/begin GROUP S84_ArrayProces1 "POD_FaultHandle/POD_FaultHandle/FaultHandle/FMS/FMSR/ArrayProces1" /begin SUB_GROUP S127_Byte1 S127_Byte2 S127_Byte4 /end SUB_GROUP /end GROUP
/begin GROUP S84_Event "POD_FaultHandle/POD_FaultHandle/FaultHandle/FMS/FMSR/Event" /begin SUB_GROUP S128_CEM S128_System /end SUB_GROUP /end GROUP
/begin GROUP S84_Event1 "POD_FaultHandle/POD_FaultHandle/FaultHandle/FMS/FMSR/Event1" /begin SUB_GROUP S129_RdrTimeout /end SUB_GROUP /begin REF_MEASUREMENT monr_VbFH_MotOvrheatProtR_flg /end REF_MEASUREMENT /end GROUP
/begin GROUP S84_FIM "POD_FaultHandle/POD_FaultHandle/FaultHandle/FMS/FMSR/FIM" /begin REF_MEASUREMENT monr_VbFH_FrbdMaiMotWrkR_flg /end REF_MEASUREMENT /end GROUP
/begin GROUP S165_State "POD_FaultHandle/POD_FaultHandle/FaultHandle/LVM/LVML/State" /begin SUB_GROUP S169_DoorMove /end SUB_GROUP /begin REF_MEASUREMENT monr_VbFH_ECUWakeUpL_flg /end REF_MEASUREMENT /end GROUP
/begin GROUP S166_LockState "POD_FaultHandle/POD_FaultHandle/FaultHandle/LVM/LVMR/LockState" /begin REF_MEASUREMENT monr_VeFH_DoorLckPstnR_enum /end REF_MEASUREMENT /end GROUP
/begin GROUP S166_State "POD_FaultHandle/POD_FaultHandle/FaultHandle/LVM/LVMR/State" /begin SUB_GROUP S214_DoorMove /end SUB_GROUP /begin REF_MEASUREMENT monr_VbFH_ECUWakeUpR_flg /end REF_MEASUREMENT /end GROUP
/begin GROUP S9_ADPPara "POD_FaultHandle/POD_FaultHandle/FaultHandle/AntiPlay/AntiPlayL/AntiplayStatus/ADPPara"
 /begin REF_CHARACTERISTIC k_ADP_Ti_AntiPlaySequenceTimer k_ADP_Ti_TimeSpanActiveThreshold k_APD_Num_AntiPlayNumThreshold /end REF_CHARACTERISTIC
/end GROUP
/begin GROUP S9_AntiPlayState "POD_FaultHandle/POD_FaultHandle/FaultHandle/AntiPlay/AntiPlayL/AntiplayStatus/AntiPlayState"
 /begin SUB_GROUP S13_AntiPlayActiveCounter S13_Signal_Override S13_Time_Holding_Boolean /end SUB_GROUP
 /begin REF_CHARACTERISTIC k_APD_Boolean_AntiPlayEnable /end REF_CHARACTERISTIC
/end GROUP
/begin GROUP S47_ADPPara "POD_FaultHandle/POD_FaultHandle/FaultHandle/AntiPlay/AntiPlayR/AntiplayStatus/ADPPara"
 /begin REF_CHARACTERISTIC k_ADP_Ti_AntiPlaySequenceTimer k_ADP_Ti_TimeSpanActiveThreshold k_APD_Num_AntiPlayNumThreshold /end REF_CHARACTERISTIC
/end GROUP
/begin GROUP S47_AntiPlayState "POD_FaultHandle/POD_FaultHandle/FaultHandle/AntiPlay/AntiPlayR/AntiplayStatus/AntiPlayState" /begin SUB_GROUP S51_AntiPlayActiveCounter S51_Time_Holding_Boolean /end SUB_GROUP /begin REF_CHARACTERISTIC k_APD_Boolean_AntiPlayEnable /end REF_CHARACTERISTIC /end GROUP
/begin GROUP S87_Byte1 "POD_FaultHandle/POD_FaultHandle/FaultHandle/FMS/FMSL/ArrayProces1/Byte1"
 /begin REF_MEASUREMENT monr_VbFMS_MaiMotOCErrL_flg monr_VbFMS_MaiMotSCBErrL_flg monr_VbFMS_MaiMotSCGErrL_flg monr_VbFMS_MaiMotVDSULErrL_flg /end REF_MEASUREMENT
/end GROUP
/begin GROUP S87_Byte2 "POD_FaultHandle/POD_FaultHandle/FaultHandle/FMS/FMSL/ArrayProces1/Byte2" /begin REF_MEASUREMENT monr_VbFMS_HallBSCGErrL_flg monr_VbFMS_RAMErrL_flg /end REF_MEASUREMENT /end GROUP
/begin GROUP S87_Byte4 "POD_FaultHandle/POD_FaultHandle/FaultHandle/FMS/FMSL/ArrayProces1/Byte4" /begin REF_MEASUREMENT monr_VeFMS_MaiMotErrL_NULL /end REF_MEASUREMENT /end GROUP
/begin GROUP S88_CEM "POD_FaultHandle/POD_FaultHandle/FaultHandle/FMS/FMSL/Event/CEM"
 /begin REF_MEASUREMENT monr_VbFH_FrntIncinAgFltL_flg monr_VbFH_SideIncinAgFltL_flg /end REF_MEASUREMENT
/end GROUP
/begin GROUP S88_System "POD_FaultHandle/POD_FaultHandle/FaultHandle/FMS/FMSL/Event/System" /begin REF_MEASUREMENT monr_VbFH_GyroSigFltL_flg /end REF_MEASUREMENT /end GROUP
/begin GROUP S89_RdrTimeout "POD_FaultHandle/POD_FaultHandle/FaultHandle/FMS/FMSL/Event1/RdrTimeout" /begin REF_MEASUREMENT monr_VbFH_RdrTioutL_flg monr_VbFMS_RdrTimeOutRawL_flg /end REF_MEASUREMENT /end GROUP
/begin GROUP S127_Byte1 "POD_FaultHandle/POD_FaultHandle/FaultHandle/FMS/FMSR/ArrayProces1/Byte1"
 /begin REF_MEASUREMENT monr_VbFMS_MaiMotOCErrR_flg monr_VbFMS_MaiMotSCBErrR_flg monr_VbFMS_MaiMotSCGErrR_flg monr_VbFMS_MaiMotVDSULErrR_flg /end REF_MEASUREMENT
/end GROUP
/begin GROUP S127_Byte2 "POD_FaultHandle/POD_FaultHandle/FaultHandle/FMS/FMSR/ArrayProces1/Byte2" /begin REF_MEASUREMENT monr_VbFMS_HallBSCGErrR_flg monr_VbFMS_RAMErrR_flg /end REF_MEASUREMENT /end GROUP
/begin GROUP S127_Byte4 "POD_FaultHandle/POD_FaultHandle/FaultHandle/FMS/FMSR/ArrayProces1/Byte4" /begin REF_MEASUREMENT monr_VeFMS_MaiMotErrR_NULL /end REF_MEASUREMENT /end GROUP
/begin GROUP S128_CEM "POD_FaultHandle/POD_FaultHandle/FaultHandle/FMS/FMSR/Event/CEM"
 /begin REF_MEASUREMENT monr_VbFH_FrntIncinAgFltR_flg monr_VbFH_SideIncinAgFltR_flg /end REF_MEASUREMENT
/end GROUP
/begin GROUP S128_System "POD_FaultHandle/POD_FaultHandle/FaultHandle/FMS/FMSR/Event/System" /begin REF_MEASUREMENT monr_VbFH_GyroSigFltR_flg /end REF_MEASUREMENT /end GROUP
/begin GROUP S129_RdrTimeout "POD_FaultHandle/POD_FaultHandle/FaultHandle/FMS/FMSR/Event1/RdrTimeout" /begin REF_MEASUREMENT monr_VbFH_RdrTioutR_flg monr_VbFMS_RdrTimeOutRaw_flg /end REF_MEASUREMENT /end GROUP
/begin GROUP S169_DoorMove "POD_FaultHandle/POD_FaultHandle/FaultHandle/LVM/LVML/State/DoorMove" /begin REF_CHARACTERISTIC KuLVM_DoorHallChgDebTi_s /end REF_CHARACTERISTIC /end GROUP
/begin GROUP S214_DoorMove "POD_FaultHandle/POD_FaultHandle/FaultHandle/LVM/LVMR/State/DoorMove" /begin REF_CHARACTERISTIC KuLVM_DoorHallChgDebTi_s /end REF_CHARACTERISTIC /end GROUP
/begin GROUP S13_AntiPlayActiveCounter "POD_FaultHandle/POD_FaultHandle/FaultHandle/AntiPlay/AntiPlayL/AntiplayStatus/AntiPlayState/AntiPlayActiveCounter" /begin REF_MEASUREMENT monr_ADP_Value_AntiPlayActiveCounterL /end REF_MEASUREMENT /end GROUP
/begin GROUP S13_Signal_Override "POD_FaultHandle/POD_FaultHandle/FaultHandle/AntiPlay/AntiPlayL/AntiplayStatus/AntiPlayState/Signal_Override" /begin SUB_GROUP S27_Switch /end SUB_GROUP /begin REF_CHARACTERISTIC k_ADP_Boolean_AntiPlayValue k_ADP_Boolean_AntiPlayflg /end REF_CHARACTERISTIC /end GROUP
/begin GROUP S13_Time_Holding_Boolean "POD_FaultHandle/POD_FaultHandle/FaultHandle/AntiPlay/AntiPlayL/AntiplayStatus/AntiPlayState/Time Holding Boolean" /begin SUB_GROUP S28_Timer_Debounce /end SUB_GROUP /end GROUP
/begin GROUP S51_AntiPlayActiveCounter "POD_FaultHandle/POD_FaultHandle/FaultHandle/AntiPlay/AntiPlayR/AntiplayStatus/AntiPlayState/AntiPlayActiveCounter" /begin REF_MEASUREMENT monr_ADP_Value_AntiPlayActiveCounterR /end REF_MEASUREMENT /end GROUP
/begin GROUP S51_Time_Holding_Boolean "POD_FaultHandle/POD_FaultHandle/FaultHandle/AntiPlay/AntiPlayR/AntiplayStatus/AntiPlayState/Time Holding Boolean" /begin SUB_GROUP S65_Signal_Holding_Boolean S65_Timer_Debounce /end SUB_GROUP /end GROUP
/begin GROUP S27_Switch "POD_FaultHandle/POD_FaultHandle/FaultHandle/AntiPlay/AntiPlayL/AntiplayStatus/AntiPlayState/Signal_Override/Switch" /begin REF_MEASUREMENT monr_VbFH_AnptiplayL_flg /end REF_MEASUREMENT /end GROUP
/begin GROUP S28_Timer_Debounce "POD_FaultHandle/POD_FaultHandle/FaultHandle/AntiPlay/AntiPlayL/AntiplayStatus/AntiPlayState/Time Holding Boolean/Timer Debounce"
 /begin REF_CHARACTERISTIC k_ADP_Ti_AntiPlaySequenceTimer k_ADP_Ti_TimeActiveProtectionThreshold /end REF_CHARACTERISTIC
/end GROUP
/begin GROUP S65_Signal_Holding_Boolean "POD_FaultHandle/POD_FaultHandle/FaultHandle/AntiPlay/AntiPlayR/AntiplayStatus/AntiPlayState/Time Holding Boolean/Signal Holding Boolean" /begin REF_MEASUREMENT monr_VbFH_AnptiplayR_flg /end REF_MEASUREMENT /end GROUP
/begin GROUP S65_Timer_Debounce "POD_FaultHandle/POD_FaultHandle/FaultHandle/AntiPlay/AntiPlayR/AntiplayStatus/AntiPlayState/Time Holding Boolean/Timer Debounce"
 /begin REF_CHARACTERISTIC k_ADP_Ti_AntiPlaySequenceTimer k_ADP_Ti_TimeActiveProtectionThreshold /end REF_CHARACTERISTIC
/end GROUP
/begin CHARACTERISTIC CalEn_VeSHM_MotorCtrlModeL "" VALUE 0xb000609a /* @ECU_Address@CalEn_VeSHM_MotorCtrlModeL@ */ Scalar_UBYTE 0 POD_FITOut_CM_uint8 0 255 /end CHARACTERISTIC
/begin CHARACTERISTIC CalEn_VeSHM_MotorCtrlModeR "" VALUE 0xb000609e /* @ECU_Address@CalEn_VeSHM_MotorCtrlModeR@ */ Scalar_UBYTE 0 POD_FITOut_CM_uint8 0 255 /end CHARACTERISTIC
/begin CHARACTERISTIC CalEn_VuSHM_MotorCtrlDutyL1 "" VALUE 0xb000609c /* @ECU_Address@CalEn_VuSHM_MotorCtrlDutyL1@ */ Scalar_UBYTE 0 POD_FITOut_CM_uint8 0 255 /end CHARACTERISTIC
/begin CHARACTERISTIC CalEn_VuSHM_MotorCtrlDutyL2 "" VALUE 0xb00060a2 /* @ECU_Address@CalEn_VuSHM_MotorCtrlDutyL2@ */ Scalar_UBYTE 0 POD_FITOut_CM_uint8 0 255 /end CHARACTERISTIC
/begin CHARACTERISTIC CalEn_VuSHM_MotorCtrlDutyR1 "" VALUE 0xb00060a0 /* @ECU_Address@CalEn_VuSHM_MotorCtrlDutyR1@ */ Scalar_UBYTE 0 POD_FITOut_CM_uint8 0 255 /end CHARACTERISTIC
/begin CHARACTERISTIC CalEn_VuSHM_MotorCtrlDutyR2 "" VALUE 0xb00060a4 /* @ECU_Address@CalEn_VuSHM_MotorCtrlDutyR2@ */ Scalar_UBYTE 0 POD_FITOut_CM_uint8 0 255 /end CHARACTERISTIC
/begin CHARACTERISTIC CalVal_VeSHM_MotorCtrlModeL "" VALUE 0xb000609b /* @ECU_Address@CalVal_VeSHM_MotorCtrlModeL@ */ Scalar_UBYTE 0 POD_FITOut_CM_uint8 0 255 /end CHARACTERISTIC
/begin CHARACTERISTIC CalVal_VeSHM_MotorCtrlModeR "" VALUE 0xb000609f /* @ECU_Address@CalVal_VeSHM_MotorCtrlModeR@ */ Scalar_UBYTE 0 POD_FITOut_CM_uint8 0 255 /end CHARACTERISTIC
/begin CHARACTERISTIC CalVal_VuSHM_MotorCtrlDutyL1 "" VALUE 0xb000609d /* @ECU_Address@CalVal_VuSHM_MotorCtrlDutyL1@ */ Scalar_UBYTE 0 POD_FITOut_CM_uint8 0 255 /end CHARACTERISTIC
/begin CHARACTERISTIC CalVal_VuSHM_MotorCtrlDutyL2 "" VALUE 0xb00060a3 /* @ECU_Address@CalVal_VuSHM_MotorCtrlDutyL2@ */ Scalar_UBYTE 0 POD_FITOut_CM_uint8 0 255 /end CHARACTERISTIC
/begin CHARACTERISTIC CalVal_VuSHM_MotorCtrlDutyR1 "" VALUE 0xb00060a1 /* @ECU_Address@CalVal_VuSHM_MotorCtrlDutyR1@ */ Scalar_UBYTE 0 POD_FITOut_CM_uint8 0 255 /end CHARACTERISTIC
/begin CHARACTERISTIC CalVal_VuSHM_MotorCtrlDutyR2 "" VALUE 0xb00060a5 /* @ECU_Address@CalVal_VuSHM_MotorCtrlDutyR2@ */ Scalar_UBYTE 0 POD_FITOut_CM_uint8 0 255 /end CHARACTERISTIC
/begin MEASUREMENT Monr_FITOut_VeSHM_MotorCtrlModeL "" UBYTE POD_FITOut_CM_UINT8 0 0 0 255 ECU_ADDRESS 0xb00561bd /* @ECU_Address@Monr_FITOut_VeSHM_MotorCtrlModeL@ */ /end MEASUREMENT
/begin MEASUREMENT Monr_FITOut_VuSHM_MotorCtrlDutyL1 "" UBYTE POD_FITOut_CM_UINT8 0 0 0 255 ECU_ADDRESS 0xb00561bc /* @ECU_Address@Monr_FITOut_VuSHM_MotorCtrlDutyL1@ */ /end MEASUREMENT
/begin MEASUREMENT Monr_FITOut_VeSHM_MotorCtrlModeR "" UBYTE POD_FITOut_CM_UINT8 0 0 0 255 ECU_ADDRESS 0xb00561bb /* @ECU_Address@Monr_FITOut_VeSHM_MotorCtrlModeR@ */ /end MEASUREMENT
/begin MEASUREMENT Monr_FITOut_VuSHM_MotorCtrlDutyR1 "" UBYTE POD_FITOut_CM_UINT8 0 0 0 255 ECU_ADDRESS 0xb00561ba /* @ECU_Address@Monr_FITOut_VuSHM_MotorCtrlDutyR1@ */ /end MEASUREMENT
/begin MEASUREMENT Monr_FITOut_VuSHM_MotorCtrlDutyL2 "" UBYTE POD_FITOut_CM_UINT8 0 0 0 255 ECU_ADDRESS 0xb00561b9 /* @ECU_Address@Monr_FITOut_VuSHM_MotorCtrlDutyL2@ */ /end MEASUREMENT
/begin MEASUREMENT Monr_FITOut_VuSHM_MotorCtrlDutyR2 "" UBYTE POD_FITOut_CM_UINT8 0 0 0 255 ECU_ADDRESS 0xb00561b8 /* @ECU_Address@Monr_FITOut_VuSHM_MotorCtrlDutyR2@ */ /end MEASUREMENT
/begin COMPU_METHOD POD_FITOut_CM_uint8 "Q = V" RAT_FUNC "%3.0" "" COEFFS 0 1 0 0 0 1 /end COMPU_METHOD
/begin COMPU_METHOD POD_FITOut_CM_UINT8 "Q = V" RAT_FUNC "%3.0" "" COEFFS 0 1 0 0 0 1 /end COMPU_METHOD
/begin GROUP POD_FITOut "POD_FITOut" ROOT /begin SUB_GROUP Root_RDM_FITOut_Main_sys /end SUB_GROUP /end GROUP
/begin GROUP Root_RDM_FITOut_Main_sys "POD_FITOut/RDM_FITOut_Main_sys" /begin SUB_GROUP S2_Subsystem /end SUB_GROUP /end GROUP
/begin GROUP S2_Subsystem "POD_FITOut/RDM_FITOut_Main_sys/Subsystem"
 /begin REF_CHARACTERISTIC CalEn_VeSHM_MotorCtrlModeL CalEn_VeSHM_MotorCtrlModeR CalEn_VuSHM_MotorCtrlDutyL1 CalEn_VuSHM_MotorCtrlDutyL2 CalEn_VuSHM_MotorCtrlDutyR1 CalEn_VuSHM_MotorCtrlDutyR2 CalVal_VeSHM_MotorCtrlModeL CalVal_VeSHM_MotorCtrlModeR CalVal_VuSHM_MotorCtrlDutyL1 CalVal_VuSHM_MotorCtrlDutyL2 CalVal_VuSHM_MotorCtrlDutyR1 CalVal_VuSHM_MotorCtrlDutyR2 /end REF_CHARACTERISTIC
 /begin REF_MEASUREMENT Monr_FITOut_VeSHM_MotorCtrlModeL Monr_FITOut_VeSHM_MotorCtrlModeR Monr_FITOut_VuSHM_MotorCtrlDutyL1 Monr_FITOut_VuSHM_MotorCtrlDutyL2 Monr_FITOut_VuSHM_MotorCtrlDutyR1 Monr_FITOut_VuSHM_MotorCtrlDutyR2 /end REF_MEASUREMENT
/end GROUP
/begin CHARACTERISTIC KfINP_HallDirBckwrdCdn_s "霍尔方向Backward确认时间" VALUE 0xb00060b6 /* @ECU_Address@KfINP_HallDirBckwrdCdn_s@ */ Scalar_FLOAT32_IEEE 0 POD_HallHandleModule_TZCU_CM_single_s -3.4E+38 3.4E+38 /end CHARACTERISTIC
/begin CHARACTERISTIC KfINP_HallDirFrwrdCdn_s "霍尔方向Forward确认时间" VALUE 0xb0007088 /* @ECU_Address@KfINP_HallDirFrwrdCdn_s@ */ Scalar_FLOAT32_IEEE 0 POD_HallHandleModule_TZCU_CM_single_s -3.4E+38 3.4E+38 /end CHARACTERISTIC
/begin CHARACTERISTIC KfINP_HallDirStopCdn_s "霍尔方向stop确认时间" VALUE 0xb000708c /* @ECU_Address@KfINP_HallDirStopCdn_s@ */ Scalar_FLOAT32_IEEE 0 POD_HallHandleModule_TZCU_CM_single_s -3.4E+38 3.4E+38 /end CHARACTERISTIC
/begin CHARACTERISTIC k_HHM_Deg_MaxOpenPosition "" VAL_BLK 0xb000646c /* @ECU_Address@k_HHM_Deg_MaxOpenPosition@ */ Scalar_FLOAT32_IEEE 0 POD_HallHandleModule_TZCU_CM_single -3.4E+38 3.4E+38 NUMBER 2 /end CHARACTERISTIC
/begin CHARACTERISTIC k_HHM_Deg_MinOpenAngSwt "" VALUE 0xb00063b0 /* @ECU_Address@k_HHM_Deg_MinOpenAngSwt@ */ Scalar_FLOAT32_IEEE 0 POD_HallHandleModule_TZCU_CM_single -3.4E+38 3.4E+38 /end CHARACTERISTIC
/begin CHARACTERISTIC k_HHM_Value_HallASenorErrCurrentPrt "" VALUE 0xb000642c /* @ECU_Address@k_HHM_Value_HallASenorErrCurrentPrt@ */ Scalar_FLOAT32_IEEE 0 POD_HallHandleModule_TZCU_CM_single -3.4E+38 3.4E+38 /end CHARACTERISTIC
/begin CHARACTERISTIC k_HHM_Value_HallErrSlope "" VALUE 0xb000643c /* @ECU_Address@k_HHM_Value_HallErrSlope@ */ Scalar_FLOAT32_IEEE 0 POD_HallHandleModule_TZCU_CM_single -3.4E+38 3.4E+38 /end CHARACTERISTIC
/begin CHARACTERISTIC k_HHM_Value_HallPWMErrCurrentPrt "" VALUE 0xb0006444 /* @ECU_Address@k_HHM_Value_HallPWMErrCurrentPrt@ */ Scalar_FLOAT32_IEEE 0 POD_HallHandleModule_TZCU_CM_single -3.4E+38 3.4E+38 /end CHARACTERISTIC
/begin CHARACTERISTIC k_HHM_Value_Pluse2Deg "" VALUE 0xb0006460 /* @ECU_Address@k_HHM_Value_Pluse2Deg@ */ Scalar_FLOAT32_IEEE 0 POD_HallHandleModule_TZCU_CM_single -3.4E+38 3.4E+38 /end CHARACTERISTIC
/begin CHARACTERISTIC k_HHM_Value_cfgHallPole "" VALUE 0xb0006424 /* @ECU_Address@k_HHM_Value_cfgHallPole@ */ Scalar_FLOAT32_IEEE 0 POD_HallHandleModule_TZCU_CM_single -3.4E+38 3.4E+38 /end CHARACTERISTIC
/begin CHARACTERISTIC k_HHM_Pluse_FilterMinHallPosition "" VALUE 0xb00063b4 /* @ECU_Address@k_HHM_Pluse_FilterMinHallPosition@ */ Scalar_SWORD 0 POD_HallHandleModule_TZCU_CM_int16 -32768 32767 /end CHARACTERISTIC
/begin CHARACTERISTIC k_HHM_Value_HallASenorIMUAngSpdPrt "" VALUE 0xb0006430 /* @ECU_Address@k_HHM_Value_HallASenorIMUAngSpdPrt@ */ Scalar_SWORD 0 POD_HallHandleModule_TZCU_CM_int16 -32768 32767 /end CHARACTERISTIC
/begin CHARACTERISTIC k_HHM_Value_HallDirErrMinAbsSpeed "" VALUE 0xb0006432 /* @ECU_Address@k_HHM_Value_HallDirErrMinAbsSpeed@ */ Scalar_SWORD 0 POD_HallHandleModule_TZCU_CM_int16 -32768 32767 /end CHARACTERISTIC
/begin CHARACTERISTIC k_HHM_Value_HallDirErrMinClsdSpeed "" VALUE 0xb0006434 /* @ECU_Address@k_HHM_Value_HallDirErrMinClsdSpeed@ */ Scalar_SWORD 0 POD_HallHandleModule_TZCU_CM_int16 -32768 32767 /end CHARACTERISTIC
/begin CHARACTERISTIC k_HHM_Value_HallDirErrMinOpenSpeed "" VALUE 0xb0006436 /* @ECU_Address@k_HHM_Value_HallDirErrMinOpenSpeed@ */ Scalar_SWORD 0 POD_HallHandleModule_TZCU_CM_int16 -32768 32767 /end CHARACTERISTIC
/begin CHARACTERISTIC k_HHM_Value_HallErrMinSpeed "" VALUE 0xb0006438 /* @ECU_Address@k_HHM_Value_HallErrMinSpeed@ */ Scalar_SWORD 0 POD_HallHandleModule_TZCU_CM_int16 -32768 32767 /end CHARACTERISTIC
/begin CHARACTERISTIC k_HHM_Value_HallErrSpeedOffset "" VALUE 0xb0006440 /* @ECU_Address@k_HHM_Value_HallErrSpeedOffset@ */ Scalar_SWORD 0 POD_HallHandleModule_TZCU_CM_int16 -32768 32767 /end CHARACTERISTIC
/begin CHARACTERISTIC k_HHM_Value_HallPWMIMUAngSpdPrt "" VALUE 0xb0006448 /* @ECU_Address@k_HHM_Value_HallPWMIMUAngSpdPrt@ */ Scalar_SWORD 0 POD_HallHandleModule_TZCU_CM_int16 -32768 32767 /end CHARACTERISTIC
/begin CHARACTERISTIC k_HHM_Value_HallAMovFreqMaxPrt "" VALUE 0xb0006428 /* @ECU_Address@k_HHM_Value_HallAMovFreqMaxPrt@ */ Scalar_UWORD 0 POD_HallHandleModule_TZCU_CM_uint16 0 65535 /end CHARACTERISTIC
/begin CHARACTERISTIC k_HHM_Value_HallPwmMinValue "" VALUE 0xb000644a /* @ECU_Address@k_HHM_Value_HallPwmMinValue@ */ Scalar_UWORD 0 POD_HallHandleModule_TZCU_CM_uint16 0 65535 /end CHARACTERISTIC
/begin MEASUREMENT monr_VfIMU_AgSpdRHHM_degps "" FLOAT32_IEEE POD_HallHandleModule_TZCU_CM_single 0 0 -3.4E+38 3.4E+38 ECU_ADDRESS 0xb0055c1c /* @ECU_Address@monr_VfIMU_AgSpdRHHM_degps@ */ /end MEASUREMENT
/begin MEASUREMENT monr_VfIMU_AgSpdLHHM_degps "" FLOAT32_IEEE POD_HallHandleModule_TZCU_CM_single 0 0 -3.4E+38 3.4E+38 ECU_ADDRESS 0xb0055c18 /* @ECU_Address@monr_VfIMU_AgSpdLHHM_degps@ */ /end MEASUREMENT
/begin MEASUREMENT monr_VfHHM_MaxOpenPositionL_deg "" FLOAT32_IEEE POD_HallHandleModule_TZCU_CM_single 0 0 -3.4E+38 3.4E+38 ECU_ADDRESS 0xb0055c10 /* @ECU_Address@monr_VfHHM_MaxOpenPositionL_deg@ */ /end MEASUREMENT
/begin MEASUREMENT monr_VfHHM_DoorPstnL_pct "" FLOAT32_IEEE POD_HallHandleModule_TZCU_CM_single 0 0 -3.4E+38 3.4E+38 ECU_ADDRESS 0xb0055bf8 /* @ECU_Address@monr_VfHHM_DoorPstnL_pct@ */ /end MEASUREMENT
/begin MEASUREMENT monr_VfHHM_AswHallPositionL_deg "" FLOAT32_IEEE POD_HallHandleModule_TZCU_CM_single 0 0 -3.4E+38 3.4E+38 ECU_ADDRESS 0xb0055bf0 /* @ECU_Address@monr_VfHHM_AswHallPositionL_deg@ */ /end MEASUREMENT
/begin MEASUREMENT monr_VfSHM_FrntIncinAgLHHM_deg "" FLOAT32_IEEE POD_HallHandleModule_TZCU_CM_single 0 0 -3.4E+38 3.4E+38 ECU_ADDRESS 0xb0055c20 /* @ECU_Address@monr_VfSHM_FrntIncinAgLHHM_deg@ */ /end MEASUREMENT
/begin MEASUREMENT monr_VfSHM_SideIncinAgLHHM_deg "" FLOAT32_IEEE POD_HallHandleModule_TZCU_CM_single 0 0 -3.4E+38 3.4E+38 ECU_ADDRESS 0xb0055c30 /* @ECU_Address@monr_VfSHM_SideIncinAgLHHM_deg@ */ /end MEASUREMENT
/begin MEASUREMENT monr_VfSHM_MainMotoCurrentLHHM_MA "" FLOAT32_IEEE POD_HallHandleModule_TZCU_CM_single 0 0 -3.4E+38 3.4E+38 ECU_ADDRESS 0xb0055c28 /* @ECU_Address@monr_VfSHM_MainMotoCurrentLHHM_MA@ */ /end MEASUREMENT
/begin MEASUREMENT monr_VfHHM_MaxOpenPositionR_deg "" FLOAT32_IEEE POD_HallHandleModule_TZCU_CM_single 0 0 -3.4E+38 3.4E+38 ECU_ADDRESS 0xb0055c14 /* @ECU_Address@monr_VfHHM_MaxOpenPositionR_deg@ */ /end MEASUREMENT
/begin MEASUREMENT monr_VfHHM_DoorPstnR_pct "" FLOAT32_IEEE POD_HallHandleModule_TZCU_CM_single 0 0 -3.4E+38 3.4E+38 ECU_ADDRESS 0xb0055bfc /* @ECU_Address@monr_VfHHM_DoorPstnR_pct@ */ /end MEASUREMENT
/begin MEASUREMENT monr_VfHHM_AswHallPositionR_deg "" FLOAT32_IEEE POD_HallHandleModule_TZCU_CM_single 0 0 -3.4E+38 3.4E+38 ECU_ADDRESS 0xb0055bf4 /* @ECU_Address@monr_VfHHM_AswHallPositionR_deg@ */ /end MEASUREMENT
/begin MEASUREMENT monr_VfSHM_FrntIncinAgRHHM_deg "" FLOAT32_IEEE POD_HallHandleModule_TZCU_CM_single 0 0 -3.4E+38 3.4E+38 ECU_ADDRESS 0xb0055c24 /* @ECU_Address@monr_VfSHM_FrntIncinAgRHHM_deg@ */ /end MEASUREMENT
/begin MEASUREMENT monr_VfSHM_SideIncinAgRHHM_deg "" FLOAT32_IEEE POD_HallHandleModule_TZCU_CM_single 0 0 -3.4E+38 3.4E+38 ECU_ADDRESS 0xb0055c34 /* @ECU_Address@monr_VfSHM_SideIncinAgRHHM_deg@ */ /end MEASUREMENT
/begin MEASUREMENT monr_VfSHM_MainMotoCurrentRHHM_MA "" FLOAT32_IEEE POD_HallHandleModule_TZCU_CM_single 0 0 -3.4E+38 3.4E+38 ECU_ADDRESS 0xb0055c2c /* @ECU_Address@monr_VfSHM_MainMotoCurrentRHHM_MA@ */ /end MEASUREMENT
/begin MEASUREMENT monr_EncoderGetCounter_XR "" UWORD POD_HallHandleModule_TZCU_CM_uint16 0 0 0 65535 ECU_ADDRESS 0xb00561ce /* @ECU_Address@monr_EncoderGetCounter_XR@ */ /end MEASUREMENT
/begin MEASUREMENT monr_VuHallPWMHz_XR "" UWORD POD_HallHandleModule_TZCU_CM_uint16 0 0 0 65535 ECU_ADDRESS 0xb00561d8 /* @ECU_Address@monr_VuHallPWMHz_XR@ */ /end MEASUREMENT
/begin MEASUREMENT monr_EncoderGetCounter_XL "" UWORD POD_HallHandleModule_TZCU_CM_uint16 0 0 0 65535 ECU_ADDRESS 0xb00561cc /* @ECU_Address@monr_EncoderGetCounter_XL@ */ /end MEASUREMENT
/begin MEASUREMENT monr_VuHallPWMHz_XL "" UWORD POD_HallHandleModule_TZCU_CM_uint16 0 0 0 65535 ECU_ADDRESS 0xb00561d6 /* @ECU_Address@monr_VuHallPWMHz_XL@ */ /end MEASUREMENT
/begin MEASUREMENT monr_VsSHM_NVMHallCntrRHHM_NULL "" SWORD POD_HallHandleModule_TZCU_CM_int16 0 0 -32768 32767 ECU_ADDRESS 0xb0055c5e /* @ECU_Address@monr_VsSHM_NVMHallCntrRHHM_NULL@ */ /end MEASUREMENT
/begin MEASUREMENT monr_VsSHM_NVMHallCntrLHHM_NULL "" SWORD POD_HallHandleModule_TZCU_CM_int16 0 0 -32768 32767 ECU_ADDRESS 0xb0055c5c /* @ECU_Address@monr_VsSHM_NVMHallCntrLHHM_NULL@ */ /end MEASUREMENT
/begin MEASUREMENT monr_VsHHM_AswHallPositionL_NULL "" SWORD POD_HallHandleModule_TZCU_CM_int16 0 0 -32768 32767 ECU_ADDRESS 0xb0055c40 /* @ECU_Address@monr_VsHHM_AswHallPositionL_NULL@ */ /end MEASUREMENT
/begin MEASUREMENT monr_VsHHM_HallCntrL_NULL "" SWORD POD_HallHandleModule_TZCU_CM_int16 0 0 -32768 32767 ECU_ADDRESS 0xb0055c4c /* @ECU_Address@monr_VsHHM_HallCntrL_NULL@ */ /end MEASUREMENT
/begin MEASUREMENT monr_VsHHM_HallPWMSpeedErrLHHM_rpm "" SWORD POD_HallHandleModule_TZCU_CM_int16 0 0 -32768 32767 ECU_ADDRESS 0xb0055c50 /* @ECU_Address@monr_VsHHM_HallPWMSpeedErrLHHM_rpm@ */ /end MEASUREMENT
/begin MEASUREMENT monr_VsHHM_AswHallPositionR_NULL "" SWORD POD_HallHandleModule_TZCU_CM_int16 0 0 -32768 32767 ECU_ADDRESS 0xb0055c42 /* @ECU_Address@monr_VsHHM_AswHallPositionR_NULL@ */ /end MEASUREMENT
/begin MEASUREMENT monr_VsHHM_HallCntrR_NULL "" SWORD POD_HallHandleModule_TZCU_CM_int16 0 0 -32768 32767 ECU_ADDRESS 0xb0055c4e /* @ECU_Address@monr_VsHHM_HallCntrR_NULL@ */ /end MEASUREMENT
/begin MEASUREMENT monr_VeSMM_DOPFcnStateLHHM_enum "" UBYTE POD_HallHandleModule_TZCU_CM_uint8 0 0 0 255 ECU_ADDRESS 0xb0055be1 /* @ECU_Address@monr_VeSMM_DOPFcnStateLHHM_enum@ */ /end MEASUREMENT
/begin MEASUREMENT monr_VeSMM_MotorCtrlModeLHHM_enum "" UBYTE POD_HallHandleModule_TZCU_CM_uint8 0 0 0 255 ECU_ADDRESS 0xb0055be5 /* @ECU_Address@monr_VeSMM_MotorCtrlModeLHHM_enum@ */ /end MEASUREMENT
/begin MEASUREMENT monr_VeSHM_NVMDoorOprtStsRHHM_enum "" UBYTE POD_HallHandleModule_TZCU_CM_uint8 0 0 0 255 ECU_ADDRESS 0xb0055bde /* @ECU_Address@monr_VeSHM_NVMDoorOprtStsRHHM_enum@ */ /end MEASUREMENT
/begin MEASUREMENT monr_VeSMM_OpenDoorCmdRHHM_enum "" UBYTE POD_HallHandleModule_TZCU_CM_uint8 0 0 0 255 ECU_ADDRESS 0xb0055bea /* @ECU_Address@monr_VeSMM_OpenDoorCmdRHHM_enum@ */ /end MEASUREMENT
/begin MEASUREMENT monr_VeSMM_DOPFcnStateRHHM_enum "" UBYTE POD_HallHandleModule_TZCU_CM_uint8 0 0 0 255 ECU_ADDRESS 0xb0055be2 /* @ECU_Address@monr_VeSMM_DOPFcnStateRHHM_enum@ */ /end MEASUREMENT
/begin MEASUREMENT monr_VeSMM_MotorCtrlModeRHHM_enum "" UBYTE POD_HallHandleModule_TZCU_CM_uint8 0 0 0 255 ECU_ADDRESS 0xb0055be6 /* @ECU_Address@monr_VeSMM_MotorCtrlModeRHHM_enum@ */ /end MEASUREMENT
/begin MEASUREMENT monr_VeSMM_MotorCtrlStateRHHM_enum "" UBYTE POD_HallHandleModule_TZCU_CM_uint8 0 0 0 255 ECU_ADDRESS 0xb0055be8 /* @ECU_Address@monr_VeSMM_MotorCtrlStateRHHM_enum@ */ /end MEASUREMENT
/begin MEASUREMENT monr_VeSMM_StopEventRHHM_enum "" UBYTE POD_HallHandleModule_TZCU_CM_uint8 0 0 0 255 ECU_ADDRESS 0xb0055bec /* @ECU_Address@monr_VeSMM_StopEventRHHM_enum@ */ /end MEASUREMENT
/begin MEASUREMENT monr_VeSHM_DoorWrkReqRHHM_enum "" UBYTE POD_HallHandleModule_TZCU_CM_uint8 0 0 0 255 ECU_ADDRESS 0xb0055bdc /* @ECU_Address@monr_VeSHM_DoorWrkReqRHHM_enum@ */ /end MEASUREMENT
/begin MEASUREMENT monr_VeSHM_DoorWrkReqLHHM_enum "" UBYTE POD_HallHandleModule_TZCU_CM_uint8 0 0 0 255 ECU_ADDRESS 0xb0055bdb /* @ECU_Address@monr_VeSHM_DoorWrkReqLHHM_enum@ */ /end MEASUREMENT
/begin MEASUREMENT monr_VeFH_DoorLckPstnRHHM_enum "" UBYTE POD_HallHandleModule_TZCU_CM_uint8 0 0 0 255 ECU_ADDRESS 0xb0055bd3 /* @ECU_Address@monr_VeFH_DoorLckPstnRHHM_enum@ */ /end MEASUREMENT
/begin MEASUREMENT monr_EncoderGetDirection_XR "" UBYTE POD_HallHandleModule_TZCU_CM_uint8 0 0 0 255 ECU_ADDRESS 0xb00561d1 /* @ECU_Address@monr_EncoderGetDirection_XR@ */ /end MEASUREMENT
/begin MEASUREMENT monr_VeHHM_DoorMovStsR_NULL "" UBYTE POD_HallHandleModule_TZCU_CM_uint8 0 0 0 255 ECU_ADDRESS 0xb0055bd5 /* @ECU_Address@monr_VeHHM_DoorMovStsR_NULL@ */ /end MEASUREMENT
/begin MEASUREMENT monr_VeHHM_SectorIndexR_enum "" UBYTE POD_HallHandleModule_TZCU_CM_uint8 0 0 0 255 ECU_ADDRESS 0xb0055bd7 /* @ECU_Address@monr_VeHHM_SectorIndexR_enum@ */ /end MEASUREMENT
/begin MEASUREMENT monr_VeSMM_MotorCtrlStateLHHM_enum "" UBYTE POD_HallHandleModule_TZCU_CM_uint8 0 0 0 255 ECU_ADDRESS 0xb0055be7 /* @ECU_Address@monr_VeSMM_MotorCtrlStateLHHM_enum@ */ /end MEASUREMENT
/begin MEASUREMENT monr_VeFH_DoorLckPstnLHHM_enum "" UBYTE POD_HallHandleModule_TZCU_CM_uint8 0 0 0 255 ECU_ADDRESS 0xb0055bd2 /* @ECU_Address@monr_VeFH_DoorLckPstnLHHM_enum@ */ /end MEASUREMENT
/begin MEASUREMENT monr_EncoderGetDirection_XL "" UBYTE POD_HallHandleModule_TZCU_CM_uint8 0 0 0 255 ECU_ADDRESS 0xb00561d0 /* @ECU_Address@monr_EncoderGetDirection_XL@ */ /end MEASUREMENT
/begin MEASUREMENT monr_VeSMM_OpenDoorCmdLHHM_enum "" UBYTE POD_HallHandleModule_TZCU_CM_uint8 0 0 0 255 ECU_ADDRESS 0xb0055be9 /* @ECU_Address@monr_VeSMM_OpenDoorCmdLHHM_enum@ */ /end MEASUREMENT
/begin MEASUREMENT monr_VeSHM_NVMDoorOprtStsLHHM_enum "" UBYTE POD_HallHandleModule_TZCU_CM_uint8 0 0 0 255 ECU_ADDRESS 0xb0055bdd /* @ECU_Address@monr_VeSHM_NVMDoorOprtStsLHHM_enum@ */ /end MEASUREMENT
/begin MEASUREMENT monr_VeHHM_DoorMovStsL_NULL "" UBYTE POD_HallHandleModule_TZCU_CM_uint8 0 0 0 255 ECU_ADDRESS 0xb0055bd4 /* @ECU_Address@monr_VeHHM_DoorMovStsL_NULL@ */ /end MEASUREMENT
/begin MEASUREMENT monr_VeHHM_SectorIndexL_enum "" UBYTE POD_HallHandleModule_TZCU_CM_uint8 0 0 0 255 ECU_ADDRESS 0xb0055bd6 /* @ECU_Address@monr_VeHHM_SectorIndexL_enum@ */ /end MEASUREMENT
/begin MEASUREMENT monr_VeSMM_StopEventLHHM_enum "" UBYTE POD_HallHandleModule_TZCU_CM_uint8 0 0 0 255 ECU_ADDRESS 0xb0055beb /* @ECU_Address@monr_VeSMM_StopEventLHHM_enum@ */ /end MEASUREMENT
/begin MEASUREMENT monr_VeSHM_UsrSetMaxPstnHHM_pct "" UBYTE POD_HallHandleModule_TZCU_CM_uint8 0 0 0 255 ECU_ADDRESS 0xb0055be0 /* @ECU_Address@monr_VeSHM_UsrSetMaxPstnHHM_pct@ */ /end MEASUREMENT
/begin MEASUREMENT monr_VeSHM_PwrModDoorSetPstnHHM_pct "" UBYTE POD_HallHandleModule_TZCU_CM_uint8 0 0 0 255 ECU_ADDRESS 0xb0055bdf /* @ECU_Address@monr_VeSHM_PwrModDoorSetPstnHHM_pct@ */ /end MEASUREMENT
/begin MEASUREMENT monr_VeHHM_UsrSetMaxPstnL_pct "" UBYTE POD_HallHandleModule_TZCU_CM_uint8 0 0 0 255 ECU_ADDRESS 0xb0055bd8 /* @ECU_Address@monr_VeHHM_UsrSetMaxPstnL_pct@ */ /end MEASUREMENT
/begin MEASUREMENT monr_VeHHM_UsrSetMaxPstnR_pct "" UBYTE POD_HallHandleModule_TZCU_CM_uint8 0 0 0 255 ECU_ADDRESS 0xb0055bd9 /* @ECU_Address@monr_VeHHM_UsrSetMaxPstnR_pct@ */ /end MEASUREMENT
/begin MEASUREMENT monr_VeSMM_HoverModCtrlLHHM_enum "" UBYTE POD_HallHandleModule_TZCU_CM_uint8 0 0 0 255 ECU_ADDRESS 0xb0055be3 /* @ECU_Address@monr_VeSMM_HoverModCtrlLHHM_enum@ */ /end MEASUREMENT
/begin MEASUREMENT monr_VeSMM_HoverModCtrlRHHM_enum "" UBYTE POD_HallHandleModule_TZCU_CM_uint8 0 0 0 255 ECU_ADDRESS 0xb0055be4 /* @ECU_Address@monr_VeSMM_HoverModCtrlRHHM_enum@ */ /end MEASUREMENT
/begin MEASUREMENT monr_VbFH_HallSigErrRHHM_flg "" UBYTE POD_HallHandleModule_TZCU_CM_boolean 0 0 0 1 ECU_ADDRESS 0xb0055b9b /* @ECU_Address@monr_VbFH_HallSigErrRHHM_flg@ */ /end MEASUREMENT
/begin MEASUREMENT monr_VbFH_ECUWakeUpRHHM_flg "" UBYTE POD_HallHandleModule_TZCU_CM_boolean 0 0 0 1 ECU_ADDRESS 0xb0055b95 /* @ECU_Address@monr_VbFH_ECUWakeUpRHHM_flg@ */ /end MEASUREMENT
/begin MEASUREMENT monr_VbHHM_BooleanHoldRHHM_flg "" UBYTE POD_HallHandleModule_TZCU_CM_boolean 0 0 0 1 ECU_ADDRESS 0xb0055ba1 /* @ECU_Address@monr_VbHHM_BooleanHoldRHHM_flg@ */ /end MEASUREMENT
/begin MEASUREMENT monr_VbHHM_PreOpenRHHM_flg "" UBYTE POD_HallHandleModule_TZCU_CM_boolean 0 0 0 1 ECU_ADDRESS 0xb0055bd1 /* @ECU_Address@monr_VbHHM_PreOpenRHHM_flg@ */ /end MEASUREMENT
/begin MEASUREMENT monr_VbHHM_BooleanUpRHHM_flg "" UBYTE POD_HallHandleModule_TZCU_CM_boolean 0 0 0 1 ECU_ADDRESS 0xb0055ba7 /* @ECU_Address@monr_VbHHM_BooleanUpRHHM_flg@ */ /end MEASUREMENT
/begin MEASUREMENT monr_VbHHM_PreClsdRHHM_flg "" UBYTE POD_HallHandleModule_TZCU_CM_boolean 0 0 0 1 ECU_ADDRESS 0xb0055bcf /* @ECU_Address@monr_VbHHM_PreClsdRHHM_flg@ */ /end MEASUREMENT
/begin MEASUREMENT monr_VbHHM_BooleanDownRHHM_flg "" UBYTE POD_HallHandleModule_TZCU_CM_boolean 0 0 0 1 ECU_ADDRESS 0xb0055b9f /* @ECU_Address@monr_VbHHM_BooleanDownRHHM_flg@ */ /end MEASUREMENT
/begin MEASUREMENT monr_VbFH_HallSigErrLHHM_flg "" UBYTE POD_HallHandleModule_TZCU_CM_boolean 0 0 0 1 ECU_ADDRESS 0xb0055b9a /* @ECU_Address@monr_VbFH_HallSigErrLHHM_flg@ */ /end MEASUREMENT
/begin MEASUREMENT monr_VbFH_ECUWakeUpLHHM_flg "" UBYTE POD_HallHandleModule_TZCU_CM_boolean 0 0 0 1 ECU_ADDRESS 0xb0055b94 /* @ECU_Address@monr_VbFH_ECUWakeUpLHHM_flg@ */ /end MEASUREMENT
/begin MEASUREMENT monr_VbHHM_BooleanHoldLHHM_flg "" UBYTE POD_HallHandleModule_TZCU_CM_boolean 0 0 0 1 ECU_ADDRESS 0xb0055ba0 /* @ECU_Address@monr_VbHHM_BooleanHoldLHHM_flg@ */ /end MEASUREMENT
/begin MEASUREMENT monr_VbHHM_PreOpenLHHM_flg "" UBYTE POD_HallHandleModule_TZCU_CM_boolean 0 0 0 1 ECU_ADDRESS 0xb0055bd0 /* @ECU_Address@monr_VbHHM_PreOpenLHHM_flg@ */ /end MEASUREMENT
/begin MEASUREMENT monr_VbHHM_BooleanUpLHHM_flg "" UBYTE POD_HallHandleModule_TZCU_CM_boolean 0 0 0 1 ECU_ADDRESS 0xb0055ba6 /* @ECU_Address@monr_VbHHM_BooleanUpLHHM_flg@ */ /end MEASUREMENT
/begin MEASUREMENT monr_VbHHM_PreClsdLHHM_flg "" UBYTE POD_HallHandleModule_TZCU_CM_boolean 0 0 0 1 ECU_ADDRESS 0xb0055bce /* @ECU_Address@monr_VbHHM_PreClsdLHHM_flg@ */ /end MEASUREMENT
/begin MEASUREMENT monr_VbHHM_BooleanDownLHHM_flg "" UBYTE POD_HallHandleModule_TZCU_CM_boolean 0 0 0 1 ECU_ADDRESS 0xb0055b9e /* @ECU_Address@monr_VbHHM_BooleanDownLHHM_flg@ */ /end MEASUREMENT
/begin MEASUREMENT monr_VbHHM_DoorOpenL_flg "" UBYTE POD_HallHandleModule_TZCU_CM_boolean 0 0 0 1 ECU_ADDRESS 0xb0055bac /* @ECU_Address@monr_VbHHM_DoorOpenL_flg@ */ /end MEASUREMENT
/begin MEASUREMENT monr_VbHHM_HallErrEnableLHHM_flg "" UBYTE POD_HallHandleModule_TZCU_CM_boolean 0 0 0 1 ECU_ADDRESS 0xb0055bb8 /* @ECU_Address@monr_VbHHM_HallErrEnableLHHM_flg@ */ /end MEASUREMENT
/begin MEASUREMENT monr_VbHHM_HALLAErrEnableLHHM_flg "" UBYTE POD_HallHandleModule_TZCU_CM_boolean 0 0 0 1 ECU_ADDRESS 0xb0055bb4 /* @ECU_Address@monr_VbHHM_HALLAErrEnableLHHM_flg@ */ /end MEASUREMENT
/begin MEASUREMENT monr_VbHHM_HALLAFaultLHHM_flg "" UBYTE POD_HallHandleModule_TZCU_CM_boolean 0 0 0 1 ECU_ADDRESS 0xb0055bb6 /* @ECU_Address@monr_VbHHM_HALLAFaultLHHM_flg@ */ /end MEASUREMENT
/begin MEASUREMENT monr_VbHHM_OnlyHallPWMErrLHHM_flg "" UBYTE POD_HallHandleModule_TZCU_CM_boolean 0 0 0 1 ECU_ADDRESS 0xb0055bca /* @ECU_Address@monr_VbHHM_OnlyHallPWMErrLHHM_flg@ */ /end MEASUREMENT
/begin MEASUREMENT monr_VbHHM_OpenTheDoorHallErrLHHM_flg "" UBYTE POD_HallHandleModule_TZCU_CM_boolean 0 0 0 1 ECU_ADDRESS 0xb0055bcc /* @ECU_Address@monr_VbHHM_OpenTheDoorHallErrLHHM_flg@ */ /end MEASUREMENT
/begin MEASUREMENT monr_VbHHM_CloseTheDoorHallErrLHHM_flg "" UBYTE POD_HallHandleModule_TZCU_CM_boolean 0 0 0 1 ECU_ADDRESS 0xb0055ba8 /* @ECU_Address@monr_VbHHM_CloseTheDoorHallErrLHHM_flg@ */ /end MEASUREMENT
/begin MEASUREMENT monr_VbHHM_DoorOpenR_flg "" UBYTE POD_HallHandleModule_TZCU_CM_boolean 0 0 0 1 ECU_ADDRESS 0xb0055bae /* @ECU_Address@monr_VbHHM_DoorOpenR_flg@ */ /end MEASUREMENT
/begin MEASUREMENT monr_VbHHM_HallErrEnableRHHM_flg "" UBYTE POD_HallHandleModule_TZCU_CM_boolean 0 0 0 1 ECU_ADDRESS 0xb0055bb9 /* @ECU_Address@monr_VbHHM_HallErrEnableRHHM_flg@ */ /end MEASUREMENT
/begin MEASUREMENT monr_VbHHM_HALLAErrEnableRHHM_flg "" UBYTE POD_HallHandleModule_TZCU_CM_boolean 0 0 0 1 ECU_ADDRESS 0xb0055bb5 /* @ECU_Address@monr_VbHHM_HALLAErrEnableRHHM_flg@ */ /end MEASUREMENT
/begin MEASUREMENT monr_VbHHM_HALLAFaultRHHM_flg "" UBYTE POD_HallHandleModule_TZCU_CM_boolean 0 0 0 1 ECU_ADDRESS 0xb0055bb7 /* @ECU_Address@monr_VbHHM_HALLAFaultRHHM_flg@ */ /end MEASUREMENT
/begin MEASUREMENT monr_VbHHM_OnlyHallPWMErrRHHM_flg "" UBYTE POD_HallHandleModule_TZCU_CM_boolean 0 0 0 1 ECU_ADDRESS 0xb0055bcb /* @ECU_Address@monr_VbHHM_OnlyHallPWMErrRHHM_flg@ */ /end MEASUREMENT
/begin MEASUREMENT monr_VbHHM_OpenTheDoorHallErrRHHM_flg "" UBYTE POD_HallHandleModule_TZCU_CM_boolean 0 0 0 1 ECU_ADDRESS 0xb0055bcd /* @ECU_Address@monr_VbHHM_OpenTheDoorHallErrRHHM_flg@ */ /end MEASUREMENT
/begin MEASUREMENT monr_VbHHM_CloseTheDoorHallErrRHHM_flg "" UBYTE POD_HallHandleModule_TZCU_CM_boolean 0 0 0 1 ECU_ADDRESS 0xb0055ba9 /* @ECU_Address@monr_VbHHM_CloseTheDoorHallErrRHHM_flg@ */ /end MEASUREMENT
/begin MEASUREMENT monr_VbFH_FrbdMaiMotWrkLHHM_flg "" UBYTE POD_HallHandleModule_TZCU_CM_boolean 0 0 0 1 ECU_ADDRESS 0xb0055b96 /* @ECU_Address@monr_VbFH_FrbdMaiMotWrkLHHM_flg@ */ /end MEASUREMENT
/begin MEASUREMENT monr_VbFH_FrbdMaiMotWrkRHHM_flg "" UBYTE POD_HallHandleModule_TZCU_CM_boolean 0 0 0 1 ECU_ADDRESS 0xb0055b97 /* @ECU_Address@monr_VbFH_FrbdMaiMotWrkRHHM_flg@ */ /end MEASUREMENT
/begin COMPU_METHOD POD_HallHandleModule_TZCU_CM_single_s "Q = V" RAT_FUNC "%8.6" "s" COEFFS 0 1 0 0 0 1 /end COMPU_METHOD
/begin COMPU_METHOD POD_HallHandleModule_TZCU_CM_single "Q = V" RAT_FUNC "%8.6" "" COEFFS 0 1 0 0 0 1 /end COMPU_METHOD
/begin COMPU_METHOD POD_HallHandleModule_TZCU_CM_int16 "Q = V" RAT_FUNC "%5.0" "" COEFFS 0 1 0 0 0 1 /end COMPU_METHOD
/begin COMPU_METHOD POD_HallHandleModule_TZCU_CM_uint16 "Q = V" RAT_FUNC "%5.0" "" COEFFS 0 1 0 0 0 1 /end COMPU_METHOD
/begin COMPU_METHOD POD_HallHandleModule_TZCU_CM_uint8 "Q = V" RAT_FUNC "%3.0" "" COEFFS 0 1 0 0 0 1 /end COMPU_METHOD
/begin COMPU_METHOD POD_HallHandleModule_TZCU_CM_boolean "Q = V" RAT_FUNC "%1.0" "" COEFFS 0 1 0 0 0 1 /end COMPU_METHOD
/begin GROUP POD_HallHandleModule_TZCU "POD_HallHandleModule_TZCU" ROOT /begin SUB_GROUP Root_POD_HallHandleModule /end SUB_GROUP /end GROUP
/begin GROUP Root_POD_HallHandleModule "POD_HallHandleModule_TZCU/POD_HallHandleModule" /begin SUB_GROUP S2_HallHandleModule /end SUB_GROUP
 /begin REF_MEASUREMENT monr_VbFH_ECUWakeUpLHHM_flg monr_VbFH_ECUWakeUpRHHM_flg monr_VbFH_FrbdMaiMotWrkLHHM_flg monr_VbFH_FrbdMaiMotWrkRHHM_flg monr_VbFH_HallSigErrLHHM_flg monr_VbFH_HallSigErrRHHM_flg monr_VeFH_DoorLckPstnLHHM_enum monr_VeFH_DoorLckPstnRHHM_enum monr_VeSHM_DoorWrkReqLHHM_enum monr_VeSHM_DoorWrkReqRHHM_enum monr_VeSHM_NVMDoorOprtStsLHHM_enum monr_VeSHM_NVMDoorOprtStsRHHM_enum monr_VeSHM_PwrModDoorSetPstnHHM_pct monr_VeSHM_UsrSetMaxPstnHHM_pct monr_VeSMM_DOPFcnStateLHHM_enum monr_VeSMM_DOPFcnStateRHHM_enum monr_VeSMM_HoverModCtrlLHHM_enum monr_VeSMM_HoverModCtrlRHHM_enum monr_VeSMM_MotorCtrlModeLHHM_enum monr_VeSMM_MotorCtrlModeRHHM_enum monr_VeSMM_MotorCtrlStateLHHM_enum monr_VeSMM_MotorCtrlStateRHHM_enum monr_VeSMM_OpenDoorCmdLHHM_enum monr_VeSMM_OpenDoorCmdRHHM_enum monr_VeSMM_StopEventLHHM_enum monr_VeSMM_StopEventRHHM_enum monr_VfIMU_AgSpdLHHM_degps monr_VfIMU_AgSpdRHHM_degps monr_VfSHM_FrntIncinAgLHHM_deg monr_VfSHM_FrntIncinAgRHHM_deg monr_VfSHM_MainMotoCurrentLHHM_MA monr_VfSHM_MainMotoCurrentRHHM_MA monr_VfSHM_SideIncinAgLHHM_deg monr_VfSHM_SideIncinAgRHHM_deg monr_VsSHM_NVMHallCntrLHHM_NULL monr_VsSHM_NVMHallCntrRHHM_NULL /end REF_MEASUREMENT
/end GROUP
/begin GROUP S2_HallHandleModule "POD_HallHandleModule_TZCU/POD_HallHandleModule/HallHandleModule"
 /begin SUB_GROUP S3_HallDirection1 S3_HallDirection2 S3_HallHandleModuleL S3_HallHandleModuleR /end SUB_GROUP
 /begin REF_MEASUREMENT monr_EncoderGetCounter_XL monr_EncoderGetCounter_XR monr_EncoderGetDirection_XL monr_EncoderGetDirection_XR monr_VeHHM_SectorIndexL_enum monr_VeHHM_SectorIndexR_enum monr_VuHallPWMHz_XL monr_VuHallPWMHz_XR /end REF_MEASUREMENT
/end GROUP
/begin GROUP S3_HallDirection1 "POD_HallHandleModule_TZCU/POD_HallHandleModule/HallHandleModule/HallDirection1"
 /begin REF_CHARACTERISTIC KfINP_HallDirBckwrdCdn_s KfINP_HallDirFrwrdCdn_s KfINP_HallDirStopCdn_s /end REF_CHARACTERISTIC
/end GROUP
/begin GROUP S3_HallDirection2 "POD_HallHandleModule_TZCU/POD_HallHandleModule/HallHandleModule/HallDirection2"
 /begin REF_CHARACTERISTIC KfINP_HallDirBckwrdCdn_s KfINP_HallDirFrwrdCdn_s KfINP_HallDirStopCdn_s /end REF_CHARACTERISTIC
/end GROUP
/begin GROUP S3_HallHandleModuleL "POD_HallHandleModule_TZCU/POD_HallHandleModule/HallHandleModule/HallHandleModuleL"
 /begin SUB_GROUP S7_AngleConversion S7_DoorMovSts S7_HallCntrHandle S7_HallErrorProcess /end SUB_GROUP
/end GROUP
/begin GROUP S3_HallHandleModuleR "POD_HallHandleModule_TZCU/POD_HallHandleModule/HallHandleModule/HallHandleModuleR"
 /begin SUB_GROUP S8_AngleConversion S8_DoorMovSts S8_HallCntrHandle S8_HallErrorProcess /end SUB_GROUP
/end GROUP
/begin GROUP S7_AngleConversion "POD_HallHandleModule_TZCU/POD_HallHandleModule/HallHandleModule/HallHandleModuleL/AngleConversion"
 /begin SUB_GROUP S51_DoorHallPosition S51_DoorOpenTargetPosition S51_PercPosn2AndPosn2 S51_TopDegforDoorOpen /end SUB_GROUP
/end GROUP
/begin GROUP S7_DoorMovSts "POD_HallHandleModule_TZCU/POD_HallHandleModule/HallHandleModule/HallHandleModuleL/DoorMovSts"
 /begin SUB_GROUP S53_DoorMovSts_Chart S53_ElecMov S53_Hold S53_IMUseMinAge S53_ManualMov S53_POD_GetSector S53_PreOpenOrClsd /end SUB_GROUP
/end GROUP
/begin GROUP S7_HallCntrHandle "POD_HallHandleModule_TZCU/POD_HallHandleModule/HallHandleModule/HallHandleModuleL/HallCntrHandle" /begin SUB_GROUP S54_HallPosition S54_HallSpeed /end SUB_GROUP /end GROUP
/begin GROUP S7_HallErrorProcess "POD_HallHandleModule_TZCU/POD_HallHandleModule/HallHandleModule/HallHandleModuleL/HallErrorProcess"
 /begin SUB_GROUP S55_HALL_AFault S55_HALL_BFault S55_HallJudgeCondition S55_SenorErr S55_SenorErr_Reset /end SUB_GROUP
/end GROUP
/begin GROUP S8_AngleConversion "POD_HallHandleModule_TZCU/POD_HallHandleModule/HallHandleModule/HallHandleModuleR/AngleConversion"
 /begin SUB_GROUP S250_DoorHallPosition S250_DoorOpenTargetPosition S250_PercPosn2AndPosn2 S250_TopDegforDoorOpen /end SUB_GROUP
/end GROUP
/begin GROUP S8_DoorMovSts "POD_HallHandleModule_TZCU/POD_HallHandleModule/HallHandleModule/HallHandleModuleR/DoorMovSts"
 /begin SUB_GROUP S252_DoorMovSts_Chart S252_ElecMov S252_Hold S252_IMUseMinAge S252_ManualMov S252_POD_GetSector S252_PreOpenOrClsd /end SUB_GROUP
/end GROUP
/begin GROUP S8_HallCntrHandle "POD_HallHandleModule_TZCU/POD_HallHandleModule/HallHandleModule/HallHandleModuleR/HallCntrHandle" /begin SUB_GROUP S253_HallPosition S253_HallSpeed /end SUB_GROUP /end GROUP
/begin GROUP S8_HallErrorProcess "POD_HallHandleModule_TZCU/POD_HallHandleModule/HallHandleModule/HallHandleModuleR/HallErrorProcess"
 /begin SUB_GROUP S254_HALL_AFault S254_HALL_BFault S254_HallJudgeCondition S254_SenorErr S254_SenorErr_Reset /end SUB_GROUP
/end GROUP
/begin GROUP S51_DoorHallPosition "POD_HallHandleModule_TZCU/POD_HallHandleModule/HallHandleModule/HallHandleModuleL/AngleConversion/DoorHallPosition"
 /begin REF_MEASUREMENT monr_VbHHM_DoorOpenL_flg monr_VsHHM_AswHallPositionL_NULL monr_VsHHM_HallCntrL_NULL /end REF_MEASUREMENT
/end GROUP
/begin GROUP S51_DoorOpenTargetPosition "POD_HallHandleModule_TZCU/POD_HallHandleModule/HallHandleModule/HallHandleModuleL/AngleConversion/DoorOpenTargetPosition" /begin SUB_GROUP S58_Rising_Debounce /end SUB_GROUP /begin REF_CHARACTERISTIC k_HHM_Deg_MinOpenAngSwt /end REF_CHARACTERISTIC /begin REF_MEASUREMENT monr_VeHHM_UsrSetMaxPstnL_pct /end REF_MEASUREMENT /end GROUP
/begin GROUP S51_PercPosn2AndPosn2 "POD_HallHandleModule_TZCU/POD_HallHandleModule/HallHandleModule/HallHandleModuleL/AngleConversion/PercPosn2AndPosn2" /begin REF_CHARACTERISTIC k_HHM_Value_Pluse2Deg /end REF_CHARACTERISTIC /begin REF_MEASUREMENT monr_VfHHM_AswHallPositionL_deg monr_VfHHM_DoorPstnL_pct /end REF_MEASUREMENT /end GROUP
/begin GROUP S51_TopDegforDoorOpen "POD_HallHandleModule_TZCU/POD_HallHandleModule/HallHandleModule/HallHandleModuleL/AngleConversion/TopDegforDoorOpen" /begin REF_CHARACTERISTIC k_HHM_Deg_MaxOpenPosition /end REF_CHARACTERISTIC /begin REF_MEASUREMENT monr_VfHHM_MaxOpenPositionL_deg /end REF_MEASUREMENT /end GROUP
/begin GROUP S53_DoorMovSts_Chart "POD_HallHandleModule_TZCU/POD_HallHandleModule/HallHandleModule/HallHandleModuleL/DoorMovSts/DoorMovSts_Chart" /begin REF_MEASUREMENT monr_VeHHM_DoorMovStsL_NULL /end REF_MEASUREMENT /end GROUP
/begin GROUP S53_ElecMov "POD_HallHandleModule_TZCU/POD_HallHandleModule/HallHandleModule/HallHandleModuleL/DoorMovSts/ElecMov"
 /begin REF_MEASUREMENT monr_VbHHM_BooleanDownLHHM_flg monr_VbHHM_BooleanUpLHHM_flg /end REF_MEASUREMENT
/end GROUP
/begin GROUP S53_Hold "POD_HallHandleModule_TZCU/POD_HallHandleModule/HallHandleModule/HallHandleModuleL/DoorMovSts/Hold"
 /begin SUB_GROUP S74_ClosingInLock S74_DooStop S74_DoorStateErrorJudge S74_ElecDoorStop S74_ManualDoorStop /end SUB_GROUP
 /begin REF_MEASUREMENT monr_VbHHM_BooleanHoldLHHM_flg /end REF_MEASUREMENT
/end GROUP
/begin GROUP S53_IMUseMinAge "POD_HallHandleModule_TZCU/POD_HallHandleModule/HallHandleModule/HallHandleModuleL/DoorMovSts/IMUseMinAge" /begin REF_CHARACTERISTIC k_HHM_Pluse_FilterMinHallPosition /end REF_CHARACTERISTIC /end GROUP
/begin GROUP S53_ManualMov "POD_HallHandleModule_TZCU/POD_HallHandleModule/HallHandleModule/HallHandleModuleL/DoorMovSts/ManualMov" /begin SUB_GROUP S76_ManualJudge S76_PerManualMovDoor /end SUB_GROUP /end GROUP
/begin GROUP S53_POD_GetSector "POD_HallHandleModule_TZCU/POD_HallHandleModule/HallHandleModule/HallHandleModuleL/DoorMovSts/POD_GetSector" /begin SUB_GROUP S77_SectorTopClose S77_SectorTopOpen /end SUB_GROUP /end GROUP
/begin GROUP S53_PreOpenOrClsd "POD_HallHandleModule_TZCU/POD_HallHandleModule/HallHandleModule/HallHandleModuleL/DoorMovSts/PreOpenOrClsd" /begin REF_MEASUREMENT monr_VbHHM_PreClsdLHHM_flg monr_VbHHM_PreOpenLHHM_flg /end REF_MEASUREMENT /end GROUP
/begin GROUP S54_HallPosition "POD_HallHandleModule_TZCU/POD_HallHandleModule/HallHandleModule/HallHandleModuleL/HallCntrHandle/HallPosition" /begin SUB_GROUP S132_ASWHallInit S132_DrvHallNum S132_HallInitialization /end SUB_GROUP /end GROUP
/begin GROUP S54_HallSpeed "POD_HallHandleModule_TZCU/POD_HallHandleModule/HallHandleModule/HallHandleModuleL/HallCntrHandle/HallSpeed"
 /begin SUB_GROUP S133_DirectionJudge S133_HallFixedTiOffset S133_HallSpeedJudge /end SUB_GROUP
/end GROUP
/begin GROUP S55_HALL_AFault "POD_HallHandleModule_TZCU/POD_HallHandleModule/HallHandleModule/HallHandleModuleL/HallErrorProcess/HALL_AFault"
 /begin SUB_GROUP S176_Rising_Debounce S176_Rising_Debounce1 S176_Rising_Debounce2 S176_Rising_Debounce3 /end SUB_GROUP
 /begin REF_CHARACTERISTIC k_HHM_Value_HallAMovFreqMaxPrt k_HHM_Value_HallASenorErrCurrentPrt k_HHM_Value_HallASenorIMUAngSpdPrt /end REF_CHARACTERISTIC
 /begin REF_MEASUREMENT monr_VbHHM_HALLAErrEnableLHHM_flg monr_VbHHM_HALLAFaultLHHM_flg /end REF_MEASUREMENT
/end GROUP
/begin GROUP S55_HALL_BFault "POD_HallHandleModule_TZCU/POD_HallHandleModule/HallHandleModule/HallHandleModuleL/HallErrorProcess/HALL_BFault"
 /begin SUB_GROUP S177_Falling_Debounce S177_Falling_Debounce1 S177_Rising_Debounce S177_Rising_Debounce1 S177_Rising_Debounce2 S177_Rising_Debounce3 S177_Rising_Debounce4 S177_Rising_Debounce5 S177_Rising_Debounce6 S177_Rising_Debounce7 /end SUB_GROUP
 /begin REF_CHARACTERISTIC k_HHM_Value_HallDirErrMinAbsSpeed k_HHM_Value_HallDirErrMinClsdSpeed k_HHM_Value_HallDirErrMinOpenSpeed k_HHM_Value_HallPWMErrCurrentPrt k_HHM_Value_HallPWMIMUAngSpdPrt k_HHM_Value_HallPwmMinValue /end REF_CHARACTERISTIC
 /begin REF_MEASUREMENT monr_VbHHM_CloseTheDoorHallErrLHHM_flg monr_VbHHM_OnlyHallPWMErrLHHM_flg monr_VbHHM_OpenTheDoorHallErrLHHM_flg /end REF_MEASUREMENT
/end GROUP
/begin GROUP S55_HallJudgeCondition "POD_HallHandleModule_TZCU/POD_HallHandleModule/HallHandleModule/HallHandleModuleL/HallErrorProcess/HallJudgeCondition" /begin SUB_GROUP S178_Rising_Debounce S178_Rising_Debounce1 /end SUB_GROUP
 /begin REF_CHARACTERISTIC k_HHM_Value_HallErrMinSpeed k_HHM_Value_HallErrSlope k_HHM_Value_HallErrSpeedOffset k_HHM_Value_cfgHallPole /end REF_CHARACTERISTIC
 /begin REF_MEASUREMENT monr_VbHHM_HallErrEnableLHHM_flg monr_VsHHM_HallPWMSpeedErrLHHM_rpm /end REF_MEASUREMENT
/end GROUP
/begin GROUP S55_SenorErr "POD_HallHandleModule_TZCU/POD_HallHandleModule/HallHandleModule/HallHandleModuleL/HallErrorProcess/SenorErr" /begin SUB_GROUP S179_RS /end SUB_GROUP /end GROUP
/begin GROUP S55_SenorErr_Reset "POD_HallHandleModule_TZCU/POD_HallHandleModule/HallHandleModule/HallHandleModuleL/HallErrorProcess/SenorErr_Reset" /begin SUB_GROUP S180_MovReset S180_Rising_Debounce2 S180_cnt /end SUB_GROUP /end GROUP
/begin GROUP S250_DoorHallPosition "POD_HallHandleModule_TZCU/POD_HallHandleModule/HallHandleModule/HallHandleModuleR/AngleConversion/DoorHallPosition"
 /begin REF_MEASUREMENT monr_VbHHM_DoorOpenR_flg monr_VsHHM_AswHallPositionR_NULL monr_VsHHM_HallCntrR_NULL /end REF_MEASUREMENT
/end GROUP
/begin GROUP S250_DoorOpenTargetPosition "POD_HallHandleModule_TZCU/POD_HallHandleModule/HallHandleModule/HallHandleModuleR/AngleConversion/DoorOpenTargetPosition" /begin SUB_GROUP S257_Rising_Debounce /end SUB_GROUP /begin REF_CHARACTERISTIC k_HHM_Deg_MinOpenAngSwt /end REF_CHARACTERISTIC /begin REF_MEASUREMENT monr_VeHHM_UsrSetMaxPstnR_pct /end REF_MEASUREMENT /end GROUP
/begin GROUP S250_PercPosn2AndPosn2 "POD_HallHandleModule_TZCU/POD_HallHandleModule/HallHandleModule/HallHandleModuleR/AngleConversion/PercPosn2AndPosn2" /begin REF_CHARACTERISTIC k_HHM_Value_Pluse2Deg /end REF_CHARACTERISTIC /begin REF_MEASUREMENT monr_VfHHM_AswHallPositionR_deg monr_VfHHM_DoorPstnR_pct /end REF_MEASUREMENT /end GROUP
/begin GROUP S250_TopDegforDoorOpen "POD_HallHandleModule_TZCU/POD_HallHandleModule/HallHandleModule/HallHandleModuleR/AngleConversion/TopDegforDoorOpen" /begin REF_CHARACTERISTIC k_HHM_Deg_MaxOpenPosition /end REF_CHARACTERISTIC /begin REF_MEASUREMENT monr_VfHHM_MaxOpenPositionR_deg /end REF_MEASUREMENT /end GROUP
/begin GROUP S252_DoorMovSts_Chart "POD_HallHandleModule_TZCU/POD_HallHandleModule/HallHandleModule/HallHandleModuleR/DoorMovSts/DoorMovSts_Chart" /begin REF_MEASUREMENT monr_VeHHM_DoorMovStsR_NULL /end REF_MEASUREMENT /end GROUP
/begin GROUP S252_ElecMov "POD_HallHandleModule_TZCU/POD_HallHandleModule/HallHandleModule/HallHandleModuleR/DoorMovSts/ElecMov"
 /begin REF_MEASUREMENT monr_VbHHM_BooleanDownRHHM_flg monr_VbHHM_BooleanUpRHHM_flg /end REF_MEASUREMENT
/end GROUP
/begin GROUP S252_Hold "POD_HallHandleModule_TZCU/POD_HallHandleModule/HallHandleModule/HallHandleModuleR/DoorMovSts/Hold"
 /begin SUB_GROUP S273_ClosingInLock S273_DooStop S273_DoorStateErrorJudge S273_ElecDoorStop S273_ManualDoorStop /end SUB_GROUP
 /begin REF_MEASUREMENT monr_VbHHM_BooleanHoldRHHM_flg /end REF_MEASUREMENT
/end GROUP
/begin GROUP S252_IMUseMinAge "POD_HallHandleModule_TZCU/POD_HallHandleModule/HallHandleModule/HallHandleModuleR/DoorMovSts/IMUseMinAge" /begin REF_CHARACTERISTIC k_HHM_Pluse_FilterMinHallPosition /end REF_CHARACTERISTIC /end GROUP
/begin GROUP S252_ManualMov "POD_HallHandleModule_TZCU/POD_HallHandleModule/HallHandleModule/HallHandleModuleR/DoorMovSts/ManualMov" /begin SUB_GROUP S275_ManualJudge S275_PerManualMovDoor /end SUB_GROUP /end GROUP
/begin GROUP S252_POD_GetSector "POD_HallHandleModule_TZCU/POD_HallHandleModule/HallHandleModule/HallHandleModuleR/DoorMovSts/POD_GetSector" /begin SUB_GROUP S276_SectorTopClose S276_SectorTopOpen /end SUB_GROUP /end GROUP
/begin GROUP S252_PreOpenOrClsd "POD_HallHandleModule_TZCU/POD_HallHandleModule/HallHandleModule/HallHandleModuleR/DoorMovSts/PreOpenOrClsd" /begin REF_MEASUREMENT monr_VbHHM_PreClsdRHHM_flg monr_VbHHM_PreOpenRHHM_flg /end REF_MEASUREMENT /end GROUP
/begin GROUP S253_HallPosition "POD_HallHandleModule_TZCU/POD_HallHandleModule/HallHandleModule/HallHandleModuleR/HallCntrHandle/HallPosition" /begin SUB_GROUP S331_ASWHallInit S331_DrvHallNum S331_HallInitialization /end SUB_GROUP /end GROUP
/begin GROUP S253_HallSpeed "POD_HallHandleModule_TZCU/POD_HallHandleModule/HallHandleModule/HallHandleModuleR/HallCntrHandle/HallSpeed"
 /begin SUB_GROUP S332_DirectionJudge S332_HallFixedTiOffset S332_HallSpeedJudge /end SUB_GROUP
/end GROUP
/begin GROUP S254_HALL_AFault "POD_HallHandleModule_TZCU/POD_HallHandleModule/HallHandleModule/HallHandleModuleR/HallErrorProcess/HALL_AFault"
 /begin SUB_GROUP S375_Rising_Debounce S375_Rising_Debounce1 S375_Rising_Debounce2 S375_Rising_Debounce3 /end SUB_GROUP
 /begin REF_CHARACTERISTIC k_HHM_Value_HallAMovFreqMaxPrt k_HHM_Value_HallASenorErrCurrentPrt k_HHM_Value_HallASenorIMUAngSpdPrt /end REF_CHARACTERISTIC
 /begin REF_MEASUREMENT monr_VbHHM_HALLAErrEnableRHHM_flg monr_VbHHM_HALLAFaultRHHM_flg /end REF_MEASUREMENT
/end GROUP
/begin GROUP S254_HALL_BFault "POD_HallHandleModule_TZCU/POD_HallHandleModule/HallHandleModule/HallHandleModuleR/HallErrorProcess/HALL_BFault"
 /begin SUB_GROUP S376_Falling_Debounce S376_Falling_Debounce1 S376_Rising_Debounce S376_Rising_Debounce1 S376_Rising_Debounce2 S376_Rising_Debounce3 S376_Rising_Debounce4 S376_Rising_Debounce5 S376_Rising_Debounce6 S376_Rising_Debounce7 /end SUB_GROUP
 /begin REF_CHARACTERISTIC k_HHM_Value_HallDirErrMinAbsSpeed k_HHM_Value_HallDirErrMinClsdSpeed k_HHM_Value_HallDirErrMinOpenSpeed k_HHM_Value_HallPWMErrCurrentPrt k_HHM_Value_HallPWMIMUAngSpdPrt k_HHM_Value_HallPwmMinValue /end REF_CHARACTERISTIC
 /begin REF_MEASUREMENT monr_VbHHM_CloseTheDoorHallErrRHHM_flg monr_VbHHM_OnlyHallPWMErrRHHM_flg monr_VbHHM_OpenTheDoorHallErrRHHM_flg /end REF_MEASUREMENT
/end GROUP
/begin GROUP S254_HallJudgeCondition "POD_HallHandleModule_TZCU/POD_HallHandleModule/HallHandleModule/HallHandleModuleR/HallErrorProcess/HallJudgeCondition" /begin SUB_GROUP S377_Rising_Debounce S377_Rising_Debounce1 /end SUB_GROUP
 /begin REF_CHARACTERISTIC k_HHM_Value_HallErrMinSpeed k_HHM_Value_HallErrSlope k_HHM_Value_HallErrSpeedOffset k_HHM_Value_cfgHallPole /end REF_CHARACTERISTIC
 /begin REF_MEASUREMENT monr_VbHHM_HallErrEnableRHHM_flg /end REF_MEASUREMENT
/end GROUP
/begin GROUP S254_SenorErr "POD_HallHandleModule_TZCU/POD_HallHandleModule/HallHandleModule/HallHandleModuleR/HallErrorProcess/SenorErr" /begin SUB_GROUP S378_RS /end SUB_GROUP /end GROUP
/begin GROUP S254_SenorErr_Reset "POD_HallHandleModule_TZCU/POD_HallHandleModule/HallHandleModule/HallHandleModuleR/HallErrorProcess/SenorErr_Reset" /begin SUB_GROUP S379_MovReset S379_Rising_Debounce2 S379_cnt /end SUB_GROUP /end GROUP
/begin GROUP S133_HallSpeedJudge "POD_HallHandleModule_TZCU/POD_HallHandleModule/HallHandleModule/HallHandleModuleL/HallCntrHandle/HallSpeed/HallSpeedJudge" /begin REF_CHARACTERISTIC k_HHM_Value_cfgHallPole /end REF_CHARACTERISTIC /end GROUP
/begin GROUP S332_HallSpeedJudge "POD_HallHandleModule_TZCU/POD_HallHandleModule/HallHandleModule/HallHandleModuleR/HallCntrHandle/HallSpeed/HallSpeedJudge" /begin REF_CHARACTERISTIC k_HHM_Value_cfgHallPole /end REF_CHARACTERISTIC /end GROUP
/end MODULE
/end PROJECT
