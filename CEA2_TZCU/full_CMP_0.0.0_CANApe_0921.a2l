ASAP2_VERSION 1 70
/begin PROJECT ProjectName "CARIAD XCP On CAN"
/begin MODULE ZCU "this is a module for XCP A2l"
/begin MOD_COMMON "" ALIGNMENT_BYTE 1 ALIGNMENT_WORD 2 ALIGNMENT_LONG 4 ALIGNMENT_FLOAT32_IEEE 4 ALIGNMENT_FLOAT64_IEEE 8 ALIGNMENT_INT64 8 /end MOD_COMMON
/begin RECORD_LAYOUT SSV__FLOAT32_IEEE_S AXIS_PTS_X 1 FLOAT32_IEEE INDEX_INCR DIRECT /end RECORD_LAYOUT
/begin RECORD_LAYOUT SSV__FLOAT64_IEEE_S AXIS_PTS_X 1 FLOAT64_IEEE INDEX_INCR DIRECT /end RECORD_LAYOUT
/begin RECORD_LAYOUT __SBYTE_S FNC_VALUES 1 SBYTE COLUMN_DIR DIRECT /end RECORD_LAYOUT
/begin RECORD_LAYOUT __UWORD_S FNC_VALUES 1 UWORD COLUMN_DIR DIRECT /end RECORD_LAYOUT
/begin RECORD_LAYOUT __ULONG_S FNC_VALUES 1 ULONG COLUMN_DIR DIRECT /end RECORD_LAYOUT
/begin RECORD_LAYOUT __SLONG_S FNC_VALUES 1 SLONG COLUMN_DIR DIRECT /end RECORD_LAYOUT
/***************** ******Add the matlab A2L Generate Code From This*****************************/
/begin RECORD_LAYOUT Scalar_UBYTE FNC_VALUES 1 UBYTE COLUMN_DIR DIRECT /end RECORD_LAYOUT
/begin RECORD_LAYOUT Scalar_UWORD FNC_VALUES 1 UWORD COLUMN_DIR DIRECT /end RECORD_LAYOUT
/begin RECORD_LAYOUT Scalar_SWORD FNC_VALUES 1 SWORD COLUMN_DIR DIRECT /end RECORD_LAYOUT
/begin RECORD_LAYOUT Scalar_FLOAT32_IEEE FNC_VALUES 1 FLOAT32_IEEE COLUMN_DIR DIRECT /end RECORD_LAYOUT
/begin CHARACTERISTIC k_HHM_Ti_CloseDoorHallIncTi "" VALUE 0xb00063b8 /* @ECU_Address@k_HHM_Ti_CloseDoorHallIncTi@ */ Scalar_FLOAT32_IEEE 0 POD_HallHandleModule_TZCU_CM_single -3.4E+38 3.4E+38 /end CHARACTERISTIC
/begin CHARACTERISTIC k_HHM_Ti_CloseDoorHallPWMStaticTi "" VALUE 0xb00063bc /* @ECU_Address@k_HHM_Ti_CloseDoorHallPWMStaticTi@ */ Scalar_FLOAT32_IEEE 0 POD_HallHandleModule_TZCU_CM_single -3.4E+38 3.4E+38 /end CHARACTERISTIC
/begin CHARACTERISTIC k_HHM_Ti_ECUWakeUpJudgeMinTi "" VALUE 0xb00063c0 /* @ECU_Address@k_HHM_Ti_ECUWakeUpJudgeMinTi@ */ Scalar_FLOAT32_IEEE 0 POD_HallHandleModule_TZCU_CM_single -3.4E+38 3.4E+38 /end CHARACTERISTIC
/begin CHARACTERISTIC k_HHM_Ti_HallAErrorConTi "" VALUE 0xb00063c4 /* @ECU_Address@k_HHM_Ti_HallAErrorConTi@ */ Scalar_FLOAT32_IEEE 0 POD_HallHandleModule_TZCU_CM_single -3.4E+38 3.4E+38 /end CHARACTERISTIC
/begin CHARACTERISTIC k_HHM_Ti_HallDirAErrorTi "" VALUE 0xb00063c8 /* @ECU_Address@k_HHM_Ti_HallDirAErrorTi@ */ Scalar_FLOAT32_IEEE 0 POD_HallHandleModule_TZCU_CM_single -3.4E+38 3.4E+38 /end CHARACTERISTIC
/begin CHARACTERISTIC k_HHM_Ti_HallNumAStaticTi "" VALUE 0xb00063cc /* @ECU_Address@k_HHM_Ti_HallNumAStaticTi@ */ Scalar_FLOAT32_IEEE 0 POD_HallHandleModule_TZCU_CM_single -3.4E+38 3.4E+38 /end CHARACTERISTIC
/begin CHARACTERISTIC k_HHM_Ti_HallPWMErrTi "" VALUE 0xb00063dc /* @ECU_Address@k_HHM_Ti_HallPWMErrTi@ */ Scalar_FLOAT32_IEEE 0 POD_HallHandleModule_TZCU_CM_single -3.4E+38 3.4E+38 /end CHARACTERISTIC
/begin CHARACTERISTIC k_HHM_Ti_HallPWMErrorAbsPosSpdJudgeTi "" VALUE 0xb00063d0 /* @ECU_Address@k_HHM_Ti_HallPWMErrorAbsPosSpdJudgeTi@ */ Scalar_FLOAT32_IEEE 0 POD_HallHandleModule_TZCU_CM_single -3.4E+38 3.4E+38 /end CHARACTERISTIC
/begin CHARACTERISTIC k_HHM_Ti_HallPWMErrorConTi "" VALUE 0xb00063d4 /* @ECU_Address@k_HHM_Ti_HallPWMErrorConTi@ */ Scalar_FLOAT32_IEEE 0 POD_HallHandleModule_TZCU_CM_single -3.4E+38 3.4E+38 /end CHARACTERISTIC
/begin CHARACTERISTIC k_HHM_Ti_HallPWMErrorJudgeTi "" VALUE 0xb00063d8 /* @ECU_Address@k_HHM_Ti_HallPWMErrorJudgeTi@ */ Scalar_FLOAT32_IEEE 0 POD_HallHandleModule_TZCU_CM_single -3.4E+38 3.4E+38 /end CHARACTERISTIC
/begin CHARACTERISTIC k_HHM_Ti_HallReveMaxTi "" VALUE 0xb00063e0 /* @ECU_Address@k_HHM_Ti_HallReveMaxTi@ */ Scalar_FLOAT32_IEEE 0 POD_HallHandleModule_TZCU_CM_single -3.4E+38 3.4E+38 /end CHARACTERISTIC
/begin CHARACTERISTIC k_HHM_Ti_OpenDoorHallDecTi "" VALUE 0xb00063e4 /* @ECU_Address@k_HHM_Ti_OpenDoorHallDecTi@ */ Scalar_FLOAT32_IEEE 0 POD_HallHandleModule_TZCU_CM_single -3.4E+38 3.4E+38 /end CHARACTERISTIC
/begin CHARACTERISTIC k_HHM_Ti_OpenDoorHallPWMStaticTi "" VALUE 0xb00063e8 /* @ECU_Address@k_HHM_Ti_OpenDoorHallPWMStaticTi@ */ Scalar_FLOAT32_IEEE 0 POD_HallHandleModule_TZCU_CM_single -3.4E+38 3.4E+38 /end CHARACTERISTIC
/begin CHARACTERISTIC k_HHM_Ti_SequenceTime "" VALUE 0xb00063ec /* @ECU_Address@k_HHM_Ti_SequenceTime@ */ Scalar_FLOAT32_IEEE 0 POD_HallHandleModule_TZCU_CM_single -3.4E+38 3.4E+38 /end CHARACTERISTIC
/begin CHARACTERISTIC k_HHM_Ti_TimeClosingInLockHoldMovSts "" VALUE 0xb00063f0 /* @ECU_Address@k_HHM_Ti_TimeClosingInLockHoldMovSts@ */ Scalar_FLOAT32_IEEE 0 POD_HallHandleModule_TZCU_CM_single -3.4E+38 3.4E+38 /end CHARACTERISTIC
/begin CHARACTERISTIC k_HHM_Ti_TimeHalfClsdDelay "" VALUE 0xb00063f4 /* @ECU_Address@k_HHM_Ti_TimeHalfClsdDelay@ */ Scalar_FLOAT32_IEEE 0 POD_HallHandleModule_TZCU_CM_single -3.4E+38 3.4E+38 /end CHARACTERISTIC
/begin CHARACTERISTIC k_HHM_Ti_TimeHallInitDelay "" VALUE 0xb00063f8 /* @ECU_Address@k_HHM_Ti_TimeHallInitDelay@ */ Scalar_FLOAT32_IEEE 0 POD_HallHandleModule_TZCU_CM_single -3.4E+38 3.4E+38 /end CHARACTERISTIC
/begin CHARACTERISTIC k_HHM_Ti_TimeHallSpdNoMov "" VALUE 0xb00063fc /* @ECU_Address@k_HHM_Ti_TimeHallSpdNoMov@ */ Scalar_FLOAT32_IEEE 0 POD_HallHandleModule_TZCU_CM_single -3.4E+38 3.4E+38 /end CHARACTERISTIC
/begin CHARACTERISTIC k_HHM_Ti_TimeHallStatic "" VALUE 0xb0006400 /* @ECU_Address@k_HHM_Ti_TimeHallStatic@ */ Scalar_FLOAT32_IEEE 0 POD_HallHandleModule_TZCU_CM_single -3.4E+38 3.4E+38 /end CHARACTERISTIC
/begin CHARACTERISTIC k_HHM_Ti_TimeHoldDoorErrorMovSts "" VALUE 0xb0006404 /* @ECU_Address@k_HHM_Ti_TimeHoldDoorErrorMovSts@ */ Scalar_FLOAT32_IEEE 0 POD_HallHandleModule_TZCU_CM_single -3.4E+38 3.4E+38 /end CHARACTERISTIC
/begin CHARACTERISTIC k_HHM_Ti_TimeHoldDoorStopMovSts "" VALUE 0xb0006408 /* @ECU_Address@k_HHM_Ti_TimeHoldDoorStopMovSts@ */ Scalar_FLOAT32_IEEE 0 POD_HallHandleModule_TZCU_CM_single -3.4E+38 3.4E+38 /end CHARACTERISTIC
/begin CHARACTERISTIC k_HHM_Ti_TimeHoldManualDoorStopMovSts "" VAL_BLK 0xb0006474 /* @ECU_Address@k_HHM_Ti_TimeHoldManualDoorStopMovSts@ */ Scalar_FLOAT32_IEEE 0 POD_HallHandleModule_TZCU_CM_single -3.4E+38 3.4E+38 NUMBER 2 /end CHARACTERISTIC
/begin CHARACTERISTIC k_HHM_Ti_TimeIMUDoorStopMovSts "" VALUE 0xb000640c /* @ECU_Address@k_HHM_Ti_TimeIMUDoorStopMovSts@ */ Scalar_FLOAT32_IEEE 0 POD_HallHandleModule_TZCU_CM_single -3.4E+38 3.4E+38 /end CHARACTERISTIC
/begin CHARACTERISTIC k_HHM_Ti_TimeInsdSetPstnDelay "" VALUE 0xb0006410 /* @ECU_Address@k_HHM_Ti_TimeInsdSetPstnDelay@ */ Scalar_FLOAT32_IEEE 0 POD_HallHandleModule_TZCU_CM_single -3.4E+38 3.4E+38 /end CHARACTERISTIC
/begin CHARACTERISTIC k_HHM_Ti_TimeManualDoorCloseMovSts "" VALUE 0xb0006414 /* @ECU_Address@k_HHM_Ti_TimeManualDoorCloseMovSts@ */ Scalar_FLOAT32_IEEE 0 POD_HallHandleModule_TZCU_CM_single -3.4E+38 3.4E+38 /end CHARACTERISTIC
/begin CHARACTERISTIC k_HHM_Ti_TimeManualDoorOpenMovSts "" VALUE 0xb0006418 /* @ECU_Address@k_HHM_Ti_TimeManualDoorOpenMovSts@ */ Scalar_FLOAT32_IEEE 0 POD_HallHandleModule_TZCU_CM_single -3.4E+38 3.4E+38 /end CHARACTERISTIC
/begin CHARACTERISTIC k_HHM_Ti_TimeWakeUp "" VALUE 0xb000641c /* @ECU_Address@k_HHM_Ti_TimeWakeUp@ */ Scalar_FLOAT32_IEEE 0 POD_HallHandleModule_TZCU_CM_single -3.4E+38 3.4E+38 /end CHARACTERISTIC
/begin CHARACTERISTIC k_HHM_Value_Minus2Sec "" VALUE 0xb0006458 /* @ECU_Address@k_HHM_Value_Minus2Sec@ */ Scalar_FLOAT32_IEEE 0 POD_HallHandleModule_TZCU_CM_single -3.4E+38 3.4E+38 /end CHARACTERISTIC
/begin CHARACTERISTIC k_HHM_Value_Sec2Milsec "" VALUE 0xb0006468 /* @ECU_Address@k_HHM_Value_Sec2Milsec@ */ Scalar_FLOAT32_IEEE 0 POD_HallHandleModule_TZCU_CM_single -3.4E+38 3.4E+38 /end CHARACTERISTIC
/begin CHARACTERISTIC k_HHM_Value_cfgHallHandlePeriod "" VALUE 0xb0006420 /* @ECU_Address@k_HHM_Value_cfgHallHandlePeriod@ */ Scalar_FLOAT32_IEEE 0 POD_HallHandleModule_TZCU_CM_single -3.4E+38 3.4E+38 /end CHARACTERISTIC
/begin CHARACTERISTIC k_HHM_Value_ManualCloseHallSpeed "" VALUE 0xb000644c /* @ECU_Address@k_HHM_Value_ManualCloseHallSpeed@ */ Scalar_SWORD 0 POD_HallHandleModule_TZCU_CM_int16 -32768 32767 /end CHARACTERISTIC
/begin CHARACTERISTIC k_HHM_Value_ManualCloseIMUAngSpdMinSpeed "" VALUE 0xb000644e /* @ECU_Address@k_HHM_Value_ManualCloseIMUAngSpdMinSpeed@ */ Scalar_SWORD 0 POD_HallHandleModule_TZCU_CM_int16 -32768 32767 /end CHARACTERISTIC
/begin CHARACTERISTIC k_HHM_Value_ManualHoldIMUAngSpdMinSpeed "" VALUE 0xb0006450 /* @ECU_Address@k_HHM_Value_ManualHoldIMUAngSpdMinSpeed@ */ Scalar_SWORD 0 POD_HallHandleModule_TZCU_CM_int16 -32768 32767 /end CHARACTERISTIC
/begin CHARACTERISTIC k_HHM_Value_ManualOpenHallSpeed "" VALUE 0xb0006452 /* @ECU_Address@k_HHM_Value_ManualOpenHallSpeed@ */ Scalar_SWORD 0 POD_HallHandleModule_TZCU_CM_int16 -32768 32767 /end CHARACTERISTIC
/begin CHARACTERISTIC k_HHM_Value_ManualOpenIMUAngSpdMinSpeed "" VALUE 0xb0006454 /* @ECU_Address@k_HHM_Value_ManualOpenIMUAngSpdMinSpeed@ */ Scalar_SWORD 0 POD_HallHandleModule_TZCU_CM_int16 -32768 32767 /end CHARACTERISTIC
/begin CHARACTERISTIC k_HHM_Value_Multiple "" VALUE 0xb000645c /* @ECU_Address@k_HHM_Value_Multiple@ */ Scalar_SWORD 0 POD_HallHandleModule_TZCU_CM_int16 -32768 32767 /end CHARACTERISTIC
/begin CHARACTERISTIC k_HHM_Value_PushLockMaxD "" VALUE 0xb0006464 /* @ECU_Address@k_HHM_Value_PushLockMaxD@ */ Scalar_SWORD 0 POD_HallHandleModule_TZCU_CM_int16 -32768 32767 /end CHARACTERISTIC
/begin CHARACTERISTIC k_HHM_Value_SectorForClose "" VAL_BLK 0xb000647c /* @ECU_Address@k_HHM_Value_SectorForClose@ */ Scalar_SWORD 0 POD_HallHandleModule_TZCU_CM_int16 -32768 32767 NUMBER 4 /end CHARACTERISTIC
/begin CHARACTERISTIC k_HHM_Value_SectorForOpen "" VAL_BLK 0xb0006484 /* @ECU_Address@k_HHM_Value_SectorForOpen@ */ Scalar_SWORD 0 POD_HallHandleModule_TZCU_CM_int16 -32768 32767 NUMBER 4 /end CHARACTERISTIC
/begin CHARACTERISTIC k_HHM_Value_PushLockMaxF "" VALUE 0xb0006466 /* @ECU_Address@k_HHM_Value_PushLockMaxF@ */ Scalar_UWORD 0 POD_HallHandleModule_TZCU_CM_uint16 0 65535 /end CHARACTERISTIC
/begin CHARACTERISTIC k_HHM_Value_HallPassCnt "" VALUE 0xb0006442 /* @ECU_Address@k_HHM_Value_HallPassCnt@ */ Scalar_UBYTE 0 POD_HallHandleModule_TZCU_CM_uint8 0 255 /end CHARACTERISTIC
/begin MEASUREMENT monr_VfHHM_HallFixedTiOffsetRHHM_NULL "" FLOAT32_IEEE POD_HallHandleModule_TZCU_CM_single 0 0 -3.4E+38 3.4E+38 ECU_ADDRESS 0xb0055c04 /* @ECU_Address@monr_VfHHM_HallFixedTiOffsetRHHM_NULL@ */ /end MEASUREMENT
/begin MEASUREMENT monr_VfHHM_HallSpeedDirectionRHHM_NULL "" FLOAT32_IEEE POD_HallHandleModule_TZCU_CM_single 0 0 -3.4E+38 3.4E+38 ECU_ADDRESS 0xb0055c0c /* @ECU_Address@monr_VfHHM_HallSpeedDirectionRHHM_NULL@ */ /end MEASUREMENT
/begin MEASUREMENT monr_VfHHM_HallFixedTiOffsetLHHM_NULL "" FLOAT32_IEEE POD_HallHandleModule_TZCU_CM_single 0 0 -3.4E+38 3.4E+38 ECU_ADDRESS 0xb0055c00 /* @ECU_Address@monr_VfHHM_HallFixedTiOffsetLHHM_NULL@ */ /end MEASUREMENT
/begin MEASUREMENT monr_VfHHM_HallSpeedDirectionLHHM_NULL "" FLOAT32_IEEE POD_HallHandleModule_TZCU_CM_single 0 0 -3.4E+38 3.4E+38 ECU_ADDRESS 0xb0055c08 /* @ECU_Address@monr_VfHHM_HallSpeedDirectionLHHM_NULL@ */ /end MEASUREMENT
/begin MEASUREMENT monr_VsHHM_AswHallSpeedR_rpm "" SWORD POD_HallHandleModule_TZCU_CM_int16 0 0 -32768 32767 ECU_ADDRESS 0xb0055c4a /* @ECU_Address@monr_VsHHM_AswHallSpeedR_rpm@ */ /end MEASUREMENT
/begin MEASUREMENT monr_VsHHM_OrigValueAntiPinchHallPositionRHHM_NULL "" SWORD POD_HallHandleModule_TZCU_CM_int16 0 0 -32768 32767 ECU_ADDRESS 0xb0055c56 /* @ECU_Address@monr_VsHHM_OrigValueAntiPinchHallPositionRHHM_NULL@ */ /end MEASUREMENT
/begin MEASUREMENT monr_VsHHM_AntiPinchHallPositionR_NULL "" SWORD POD_HallHandleModule_TZCU_CM_int16 0 0 -32768 32767 ECU_ADDRESS 0xb0055c3a /* @ECU_Address@monr_VsHHM_AntiPinchHallPositionR_NULL@ */ /end MEASUREMENT
/begin MEASUREMENT monr_VsHHM_AswHallSpeedL_rpm "" SWORD POD_HallHandleModule_TZCU_CM_int16 0 0 -32768 32767 ECU_ADDRESS 0xb0055c48 /* @ECU_Address@monr_VsHHM_AswHallSpeedL_rpm@ */ /end MEASUREMENT
/begin MEASUREMENT monr_VsHHM_OrigValueAntiPinchHallPositionLHHM_NULL "" SWORD POD_HallHandleModule_TZCU_CM_int16 0 0 -32768 32767 ECU_ADDRESS 0xb0055c54 /* @ECU_Address@monr_VsHHM_OrigValueAntiPinchHallPositionLHHM_NULL@ */ /end MEASUREMENT
/begin MEASUREMENT monr_VsHHM_AntiPinchHallPositionL_NULL "" SWORD POD_HallHandleModule_TZCU_CM_int16 0 0 -32768 32767 ECU_ADDRESS 0xb0055c38 /* @ECU_Address@monr_VsHHM_AntiPinchHallPositionL_NULL@ */ /end MEASUREMENT
/begin MEASUREMENT monr_VsHHM_OrigValueHallPositionLHHM_NULL "" SWORD POD_HallHandleModule_TZCU_CM_int16 0 0 -32768 32767 ECU_ADDRESS 0xb0055c58 /* @ECU_Address@monr_VsHHM_OrigValueHallPositionLHHM_NULL@ */ /end MEASUREMENT
/begin MEASUREMENT monr_VsHHM_AswHallAccL_g "" SWORD POD_HallHandleModule_TZCU_CM_int16 0 0 -32768 32767 ECU_ADDRESS 0xb0055c3c /* @ECU_Address@monr_VsHHM_AswHallAccL_g@ */ /end MEASUREMENT
/begin MEASUREMENT monr_VsHHM_AswHallPosSpeedLHHM_rpm "" SWORD POD_HallHandleModule_TZCU_CM_int16 0 0 -32768 32767 ECU_ADDRESS 0xb0055c44 /* @ECU_Address@monr_VsHHM_AswHallPosSpeedLHHM_rpm@ */ /end MEASUREMENT
/begin MEASUREMENT monr_VsHHM_OrigValueHallPositionRHHM_NULL "" SWORD POD_HallHandleModule_TZCU_CM_int16 0 0 -32768 32767 ECU_ADDRESS 0xb0055c5a /* @ECU_Address@monr_VsHHM_OrigValueHallPositionRHHM_NULL@ */ /end MEASUREMENT
/begin MEASUREMENT monr_VsHHM_AswHallAccR_g "" SWORD POD_HallHandleModule_TZCU_CM_int16 0 0 -32768 32767 ECU_ADDRESS 0xb0055c3e /* @ECU_Address@monr_VsHHM_AswHallAccR_g@ */ /end MEASUREMENT
/begin MEASUREMENT monr_VsHHM_AswHallPosSpeedRHHM_rpm "" SWORD POD_HallHandleModule_TZCU_CM_int16 0 0 -32768 32767 ECU_ADDRESS 0xb0055c46 /* @ECU_Address@monr_VsHHM_AswHallPosSpeedRHHM_rpm@ */ /end MEASUREMENT
/begin MEASUREMENT monr_VbHHM_Lck2DrStsErrRHHM_flg "" UBYTE POD_HallHandleModule_TZCU_CM_boolean 0 0 0 1 ECU_ADDRESS 0xb0055bc7 /* @ECU_Address@monr_VbHHM_Lck2DrStsErrRHHM_flg@ */ /end MEASUREMENT
/begin MEASUREMENT monr_VbHHM_HallErrRHHM_flg "" UBYTE POD_HallHandleModule_TZCU_CM_boolean 0 0 0 1 ECU_ADDRESS 0xb0055bbb /* @ECU_Address@monr_VbHHM_HallErrRHHM_flg@ */ /end MEASUREMENT
/begin MEASUREMENT monr_VbHHM_InitErrorRHHM_flg "" UBYTE POD_HallHandleModule_TZCU_CM_boolean 0 0 0 1 ECU_ADDRESS 0xb0055bc5 /* @ECU_Address@monr_VbHHM_InitErrorRHHM_flg@ */ /end MEASUREMENT
/begin MEASUREMENT monr_VbHHM_BooleanManualUpRHHM_flg "" UBYTE POD_HallHandleModule_TZCU_CM_boolean 0 0 0 1 ECU_ADDRESS 0xb0055ba5 /* @ECU_Address@monr_VbHHM_BooleanManualUpRHHM_flg@ */ /end MEASUREMENT
/begin MEASUREMENT monr_VbHHM_BooleanManualDownRHHM_flg "" UBYTE POD_HallHandleModule_TZCU_CM_boolean 0 0 0 1 ECU_ADDRESS 0xb0055ba3 /* @ECU_Address@monr_VbHHM_BooleanManualDownRHHM_flg@ */ /end MEASUREMENT
/begin MEASUREMENT monr_VbHHM_Lck2DrStsErrLHHM_flg "" UBYTE POD_HallHandleModule_TZCU_CM_boolean 0 0 0 1 ECU_ADDRESS 0xb0055bc6 /* @ECU_Address@monr_VbHHM_Lck2DrStsErrLHHM_flg@ */ /end MEASUREMENT
/begin MEASUREMENT monr_VbHHM_HallErrLHHM_flg "" UBYTE POD_HallHandleModule_TZCU_CM_boolean 0 0 0 1 ECU_ADDRESS 0xb0055bba /* @ECU_Address@monr_VbHHM_HallErrLHHM_flg@ */ /end MEASUREMENT
/begin MEASUREMENT monr_VbHHM_InitErrorLHHM_flg "" UBYTE POD_HallHandleModule_TZCU_CM_boolean 0 0 0 1 ECU_ADDRESS 0xb0055bc4 /* @ECU_Address@monr_VbHHM_InitErrorLHHM_flg@ */ /end MEASUREMENT
/begin MEASUREMENT monr_VbHHM_BooleanManualUpLHHM_flg "" UBYTE POD_HallHandleModule_TZCU_CM_boolean 0 0 0 1 ECU_ADDRESS 0xb0055ba4 /* @ECU_Address@monr_VbHHM_BooleanManualUpLHHM_flg@ */ /end MEASUREMENT
/begin MEASUREMENT monr_VbHHM_BooleanManualDownLHHM_flg "" UBYTE POD_HallHandleModule_TZCU_CM_boolean 0 0 0 1 ECU_ADDRESS 0xb0055ba2 /* @ECU_Address@monr_VbHHM_BooleanManualDownLHHM_flg@ */ /end MEASUREMENT
/begin MEASUREMENT monr_VbHHM_ASWBSWHallInitL_flg "" UBYTE POD_HallHandleModule_TZCU_CM_boolean 0 0 0 1 ECU_ADDRESS 0xb0055b9c /* @ECU_Address@monr_VbHHM_ASWBSWHallInitL_flg@ */ /end MEASUREMENT
/begin MEASUREMENT monr_VbHHM_HallErrSpeedLHHM_flg "" UBYTE POD_HallHandleModule_TZCU_CM_boolean 0 0 0 1 ECU_ADDRESS 0xb0055bbc /* @ECU_Address@monr_VbHHM_HallErrSpeedLHHM_flg@ */ /end MEASUREMENT
/begin MEASUREMENT monr_VbHHM_HallSigFltL_flg "" UBYTE POD_HallHandleModule_TZCU_CM_boolean 0 0 0 1 ECU_ADDRESS 0xb0055bc2 /* @ECU_Address@monr_VbHHM_HallSigFltL_flg@ */ /end MEASUREMENT
/begin MEASUREMENT monr_VbHHM_ASWBSWHallInitR_flg "" UBYTE POD_HallHandleModule_TZCU_CM_boolean 0 0 0 1 ECU_ADDRESS 0xb0055b9d /* @ECU_Address@monr_VbHHM_ASWBSWHallInitR_flg@ */ /end MEASUREMENT
/begin MEASUREMENT monr_VbHHM_HallErrSpeedRHHM_flg "" UBYTE POD_HallHandleModule_TZCU_CM_boolean 0 0 0 1 ECU_ADDRESS 0xb0055bbd /* @ECU_Address@monr_VbHHM_HallErrSpeedRHHM_flg@ */ /end MEASUREMENT
/begin MEASUREMENT monr_VbHHM_HallSigFltR_flg "" UBYTE POD_HallHandleModule_TZCU_CM_boolean 0 0 0 1 ECU_ADDRESS 0xb0055bc3 /* @ECU_Address@monr_VbHHM_HallSigFltR_flg@ */ /end MEASUREMENT
/begin MEASUREMENT monr_VbHHM_DoorPstnInitRHHM_flg "" UBYTE POD_HallHandleModule_TZCU_CM_boolean 0 0 0 1 ECU_ADDRESS 0xb0055bb1 /* @ECU_Address@monr_VbHHM_DoorPstnInitRHHM_flg@ */ /end MEASUREMENT
/begin MEASUREMENT monr_VbHHM_DoorRelPstnInitRHHM_flg "" UBYTE POD_HallHandleModule_TZCU_CM_boolean 0 0 0 1 ECU_ADDRESS 0xb0055bb3 /* @ECU_Address@monr_VbHHM_DoorRelPstnInitRHHM_flg@ */ /end MEASUREMENT
/begin MEASUREMENT monr_VbHHM_DoorAbsPstnInitRHHM_flg "" UBYTE POD_HallHandleModule_TZCU_CM_boolean 0 0 0 1 ECU_ADDRESS 0xb0055bab /* @ECU_Address@monr_VbHHM_DoorAbsPstnInitRHHM_flg@ */ /end MEASUREMENT
/begin MEASUREMENT monr_VbHHM_NVMHallEnableRHHM_flg "" UBYTE POD_HallHandleModule_TZCU_CM_boolean 0 0 0 1 ECU_ADDRESS 0xb0055bc9 /* @ECU_Address@monr_VbHHM_NVMHallEnableRHHM_flg@ */ /end MEASUREMENT
/begin MEASUREMENT monr_VbHHM_DoorOpenRHHM_flg "" UBYTE POD_HallHandleModule_TZCU_CM_boolean 0 0 0 1 ECU_ADDRESS 0xb0055baf /* @ECU_Address@monr_VbHHM_DoorOpenRHHM_flg@ */ /end MEASUREMENT
/begin MEASUREMENT monr_VbHHM_DoorPstnInitLHHM_flg "" UBYTE POD_HallHandleModule_TZCU_CM_boolean 0 0 0 1 ECU_ADDRESS 0xb0055bb0 /* @ECU_Address@monr_VbHHM_DoorPstnInitLHHM_flg@ */ /end MEASUREMENT
/begin MEASUREMENT monr_VbHHM_DoorRelPstnInitLHHM_flg "" UBYTE POD_HallHandleModule_TZCU_CM_boolean 0 0 0 1 ECU_ADDRESS 0xb0055bb2 /* @ECU_Address@monr_VbHHM_DoorRelPstnInitLHHM_flg@ */ /end MEASUREMENT
/begin MEASUREMENT monr_VbHHM_DoorAbsPstnInitLHHM_flg "" UBYTE POD_HallHandleModule_TZCU_CM_boolean 0 0 0 1 ECU_ADDRESS 0xb0055baa /* @ECU_Address@monr_VbHHM_DoorAbsPstnInitLHHM_flg@ */ /end MEASUREMENT
/begin MEASUREMENT monr_VbHHM_NVMHallEnableLHHM_flg "" UBYTE POD_HallHandleModule_TZCU_CM_boolean 0 0 0 1 ECU_ADDRESS 0xb0055bc8 /* @ECU_Address@monr_VbHHM_NVMHallEnableLHHM_flg@ */ /end MEASUREMENT
/begin MEASUREMENT monr_VbHHM_DoorOpenLHHM_flg "" UBYTE POD_HallHandleModule_TZCU_CM_boolean 0 0 0 1 ECU_ADDRESS 0xb0055bad /* @ECU_Address@monr_VbHHM_DoorOpenLHHM_flg@ */ /end MEASUREMENT
/begin COMPU_METHOD POD_HallHandleModule_TZCU_CM_single "Q = V" RAT_FUNC "%8.6" "" COEFFS 0 1 0 0 0 1 /end COMPU_METHOD
/begin COMPU_METHOD POD_HallHandleModule_TZCU_CM_int16 "Q = V" RAT_FUNC "%5.0" "" COEFFS 0 1 0 0 0 1 /end COMPU_METHOD
/begin COMPU_METHOD POD_HallHandleModule_TZCU_CM_uint16 "Q = V" RAT_FUNC "%5.0" "" COEFFS 0 1 0 0 0 1 /end COMPU_METHOD
/begin COMPU_METHOD POD_HallHandleModule_TZCU_CM_uint8 "Q = V" RAT_FUNC "%3.0" "" COEFFS 0 1 0 0 0 1 /end COMPU_METHOD
/begin COMPU_METHOD POD_HallHandleModule_TZCU_CM_boolean "Q = V" RAT_FUNC "%1.0" "" COEFFS 0 1 0 0 0 1 /end COMPU_METHOD
/begin GROUP S58_Rising_Debounce "POD_HallHandleModule_TZCU/POD_HallHandleModule/HallHandleModule/HallHandleModuleL/AngleConversion/DoorOpenTargetPosition/Rising Debounce" /begin REF_CHARACTERISTIC k_HHM_Ti_SequenceTime k_HHM_Ti_TimeInsdSetPstnDelay /end REF_CHARACTERISTIC /end GROUP
/begin GROUP S74_ClosingInLock "POD_HallHandleModule_TZCU/POD_HallHandleModule/HallHandleModule/HallHandleModuleL/DoorMovSts/Hold/ClosingInLock" /begin SUB_GROUP S80_Rising_Debounce /end SUB_GROUP /end GROUP
/begin GROUP S74_DooStop "POD_HallHandleModule_TZCU/POD_HallHandleModule/HallHandleModule/HallHandleModuleL/DoorMovSts/Hold/DooStop" /begin SUB_GROUP S81_Rising_Debounce S81_Rising_Debounce1 /end SUB_GROUP /begin REF_CHARACTERISTIC k_HHM_Value_ManualHoldIMUAngSpdMinSpeed /end REF_CHARACTERISTIC /end GROUP
/begin GROUP S74_DoorStateErrorJudge "POD_HallHandleModule_TZCU/POD_HallHandleModule/HallHandleModule/HallHandleModuleL/DoorMovSts/Hold/DoorStateErrorJudge" /begin SUB_GROUP S82_Rising_Debounce4 /end SUB_GROUP /end GROUP
/begin GROUP S74_ElecDoorStop "POD_HallHandleModule_TZCU/POD_HallHandleModule/HallHandleModule/HallHandleModuleL/DoorMovSts/Hold/ElecDoorStop" /begin SUB_GROUP S83_Rising_Debounce /end SUB_GROUP /end GROUP
/begin GROUP S74_ManualDoorStop "POD_HallHandleModule_TZCU/POD_HallHandleModule/HallHandleModule/HallHandleModuleL/DoorMovSts/Hold/ManualDoorStop"
 /begin REF_CHARACTERISTIC k_HHM_Ti_SequenceTime k_HHM_Ti_TimeHoldManualDoorStopMovSts /end REF_CHARACTERISTIC
/end GROUP
/begin GROUP S76_ManualJudge "POD_HallHandleModule_TZCU/POD_HallHandleModule/HallHandleModule/HallHandleModuleL/DoorMovSts/ManualMov/ManualJudge"
 /begin REF_MEASUREMENT monr_VbHHM_BooleanManualDownLHHM_flg monr_VbHHM_BooleanManualUpLHHM_flg /end REF_MEASUREMENT
/end GROUP
/begin GROUP S76_PerManualMovDoor "POD_HallHandleModule_TZCU/POD_HallHandleModule/HallHandleModule/HallHandleModuleL/DoorMovSts/ManualMov/PerManualMovDoor"
 /begin SUB_GROUP S108_Rising_Debounce S108_Rising_Debounce1 S108_Rising_Debounce2 S108_Rising_Debounce3 /end SUB_GROUP
 /begin REF_CHARACTERISTIC k_HHM_Value_ManualCloseHallSpeed k_HHM_Value_ManualCloseIMUAngSpdMinSpeed k_HHM_Value_ManualOpenHallSpeed k_HHM_Value_ManualOpenIMUAngSpdMinSpeed /end REF_CHARACTERISTIC
/end GROUP
/begin GROUP S77_SectorTopClose "POD_HallHandleModule_TZCU/POD_HallHandleModule/HallHandleModule/HallHandleModuleL/DoorMovSts/POD_GetSector/SectorTopClose" /begin REF_CHARACTERISTIC k_HHM_Value_SectorForClose /end REF_CHARACTERISTIC /end GROUP
/begin GROUP S77_SectorTopOpen "POD_HallHandleModule_TZCU/POD_HallHandleModule/HallHandleModule/HallHandleModuleL/DoorMovSts/POD_GetSector/SectorTopOpen" /begin REF_CHARACTERISTIC k_HHM_Value_SectorForOpen /end REF_CHARACTERISTIC /end GROUP
/begin GROUP S132_ASWHallInit "POD_HallHandleModule_TZCU/POD_HallHandleModule/HallHandleModule/HallHandleModuleL/HallCntrHandle/HallPosition/ASWHallInit" /begin SUB_GROUP S134_Rising_Debounce S134_Timer_Debounce /end SUB_GROUP /begin REF_MEASUREMENT monr_VbHHM_ASWBSWHallInitL_flg /end REF_MEASUREMENT /end GROUP
/begin GROUP S132_DrvHallNum "POD_HallHandleModule_TZCU/POD_HallHandleModule/HallHandleModule/HallHandleModuleL/HallCntrHandle/HallPosition/DrvHallNum" /begin REF_CHARACTERISTIC k_HHM_Value_Multiple /end REF_CHARACTERISTIC
 /begin REF_MEASUREMENT monr_VsHHM_AntiPinchHallPositionL_NULL monr_VsHHM_OrigValueAntiPinchHallPositionLHHM_NULL monr_VsHHM_OrigValueHallPositionLHHM_NULL /end REF_MEASUREMENT
/end GROUP
/begin GROUP S132_HallInitialization "POD_HallHandleModule_TZCU/POD_HallHandleModule/HallHandleModule/HallHandleModuleL/HallCntrHandle/HallPosition/HallInitialization" /begin SUB_GROUP S136_ErrInitVerify S136_LckState /end SUB_GROUP
 /begin REF_MEASUREMENT monr_VbHHM_DoorAbsPstnInitLHHM_flg monr_VbHHM_DoorOpenLHHM_flg monr_VbHHM_DoorPstnInitLHHM_flg monr_VbHHM_DoorRelPstnInitLHHM_flg monr_VbHHM_NVMHallEnableLHHM_flg /end REF_MEASUREMENT
/end GROUP
/begin GROUP S133_DirectionJudge "POD_HallHandleModule_TZCU/POD_HallHandleModule/HallHandleModule/HallHandleModuleL/HallCntrHandle/HallSpeed/DirectionJudge" /begin REF_MEASUREMENT monr_VfHHM_HallSpeedDirectionLHHM_NULL /end REF_MEASUREMENT /end GROUP
/begin GROUP S133_HallFixedTiOffset "POD_HallHandleModule_TZCU/POD_HallHandleModule/HallHandleModule/HallHandleModuleL/HallCntrHandle/HallSpeed/HallFixedTiOffset" /begin SUB_GROUP S167_Rising_Debounce1 /end SUB_GROUP /begin REF_MEASUREMENT monr_VfHHM_HallFixedTiOffsetLHHM_NULL /end REF_MEASUREMENT /end GROUP
/begin GROUP S133_HallSpeedJudge "POD_HallHandleModule_TZCU/POD_HallHandleModule/HallHandleModule/HallHandleModuleL/HallCntrHandle/HallSpeed/HallSpeedJudge"
 /begin REF_CHARACTERISTIC k_HHM_Ti_SequenceTime k_HHM_Value_Minus2Sec k_HHM_Value_Sec2Milsec k_HHM_Value_cfgHallHandlePeriod /end REF_CHARACTERISTIC
 /begin REF_MEASUREMENT monr_VsHHM_AswHallAccL_g monr_VsHHM_AswHallPosSpeedLHHM_rpm monr_VsHHM_AswHallSpeedL_rpm /end REF_MEASUREMENT
/end GROUP
/begin GROUP S176_Rising_Debounce "POD_HallHandleModule_TZCU/POD_HallHandleModule/HallHandleModule/HallHandleModuleL/HallErrorProcess/HALL_AFault/Rising Debounce" /begin REF_CHARACTERISTIC k_HHM_Ti_HallAErrorConTi k_HHM_Ti_SequenceTime /end REF_CHARACTERISTIC /end GROUP
/begin GROUP S176_Rising_Debounce1 "POD_HallHandleModule_TZCU/POD_HallHandleModule/HallHandleModule/HallHandleModuleL/HallErrorProcess/HALL_AFault/Rising Debounce1" /begin REF_CHARACTERISTIC k_HHM_Ti_HallAErrorConTi k_HHM_Ti_SequenceTime /end REF_CHARACTERISTIC /end GROUP
/begin GROUP S176_Rising_Debounce2 "POD_HallHandleModule_TZCU/POD_HallHandleModule/HallHandleModule/HallHandleModuleL/HallErrorProcess/HALL_AFault/Rising Debounce2" /begin REF_CHARACTERISTIC k_HHM_Ti_HallNumAStaticTi k_HHM_Ti_SequenceTime /end REF_CHARACTERISTIC /end GROUP
/begin GROUP S176_Rising_Debounce3 "POD_HallHandleModule_TZCU/POD_HallHandleModule/HallHandleModule/HallHandleModuleL/HallErrorProcess/HALL_AFault/Rising Debounce3" /begin REF_CHARACTERISTIC k_HHM_Ti_HallDirAErrorTi k_HHM_Ti_SequenceTime /end REF_CHARACTERISTIC /end GROUP
/begin GROUP S177_Falling_Debounce "POD_HallHandleModule_TZCU/POD_HallHandleModule/HallHandleModule/HallHandleModuleL/HallErrorProcess/HALL_BFault/Falling Debounce" /begin REF_CHARACTERISTIC k_HHM_Ti_HallReveMaxTi k_HHM_Ti_SequenceTime /end REF_CHARACTERISTIC /end GROUP
/begin GROUP S177_Falling_Debounce1 "POD_HallHandleModule_TZCU/POD_HallHandleModule/HallHandleModule/HallHandleModuleL/HallErrorProcess/HALL_BFault/Falling Debounce1" /begin REF_CHARACTERISTIC k_HHM_Ti_HallReveMaxTi k_HHM_Ti_SequenceTime /end REF_CHARACTERISTIC /end GROUP
/begin GROUP S177_Rising_Debounce "POD_HallHandleModule_TZCU/POD_HallHandleModule/HallHandleModule/HallHandleModuleL/HallErrorProcess/HALL_BFault/Rising Debounce" /begin REF_CHARACTERISTIC k_HHM_Ti_HallPWMErrorConTi k_HHM_Ti_SequenceTime /end REF_CHARACTERISTIC /end GROUP
/begin GROUP S177_Rising_Debounce1 "POD_HallHandleModule_TZCU/POD_HallHandleModule/HallHandleModule/HallHandleModuleL/HallErrorProcess/HALL_BFault/Rising Debounce1" /begin REF_CHARACTERISTIC k_HHM_Ti_OpenDoorHallPWMStaticTi k_HHM_Ti_SequenceTime /end REF_CHARACTERISTIC /end GROUP
/begin GROUP S177_Rising_Debounce2 "POD_HallHandleModule_TZCU/POD_HallHandleModule/HallHandleModule/HallHandleModuleL/HallErrorProcess/HALL_BFault/Rising Debounce2" /begin REF_CHARACTERISTIC k_HHM_Ti_OpenDoorHallDecTi k_HHM_Ti_SequenceTime /end REF_CHARACTERISTIC /end GROUP
/begin GROUP S177_Rising_Debounce3 "POD_HallHandleModule_TZCU/POD_HallHandleModule/HallHandleModule/HallHandleModuleL/HallErrorProcess/HALL_BFault/Rising Debounce3" /begin REF_CHARACTERISTIC k_HHM_Ti_CloseDoorHallIncTi k_HHM_Ti_SequenceTime /end REF_CHARACTERISTIC /end GROUP
/begin GROUP S177_Rising_Debounce4 "POD_HallHandleModule_TZCU/POD_HallHandleModule/HallHandleModule/HallHandleModuleL/HallErrorProcess/HALL_BFault/Rising Debounce4" /begin REF_CHARACTERISTIC k_HHM_Ti_CloseDoorHallPWMStaticTi k_HHM_Ti_SequenceTime /end REF_CHARACTERISTIC /end GROUP
/begin GROUP S177_Rising_Debounce5 "POD_HallHandleModule_TZCU/POD_HallHandleModule/HallHandleModule/HallHandleModuleL/HallErrorProcess/HALL_BFault/Rising Debounce5" /begin REF_CHARACTERISTIC k_HHM_Ti_HallPWMErrorConTi k_HHM_Ti_SequenceTime /end REF_CHARACTERISTIC /end GROUP
/begin GROUP S177_Rising_Debounce6 "POD_HallHandleModule_TZCU/POD_HallHandleModule/HallHandleModule/HallHandleModuleL/HallErrorProcess/HALL_BFault/Rising Debounce6" /begin REF_CHARACTERISTIC k_HHM_Ti_HallPWMErrorJudgeTi k_HHM_Ti_SequenceTime /end REF_CHARACTERISTIC /end GROUP
/begin GROUP S177_Rising_Debounce7 "POD_HallHandleModule_TZCU/POD_HallHandleModule/HallHandleModule/HallHandleModuleL/HallErrorProcess/HALL_BFault/Rising Debounce7"
 /begin REF_CHARACTERISTIC k_HHM_Ti_HallPWMErrorAbsPosSpdJudgeTi k_HHM_Ti_SequenceTime /end REF_CHARACTERISTIC
/end GROUP
/begin GROUP S178_Rising_Debounce "POD_HallHandleModule_TZCU/POD_HallHandleModule/HallHandleModule/HallHandleModuleL/HallErrorProcess/HallJudgeCondition/Rising Debounce" /begin REF_CHARACTERISTIC k_HHM_Ti_ECUWakeUpJudgeMinTi k_HHM_Ti_SequenceTime /end REF_CHARACTERISTIC /end GROUP
/begin GROUP S178_Rising_Debounce1 "POD_HallHandleModule_TZCU/POD_HallHandleModule/HallHandleModule/HallHandleModuleL/HallErrorProcess/HallJudgeCondition/Rising Debounce1" /begin REF_CHARACTERISTIC k_HHM_Ti_HallPWMErrTi k_HHM_Ti_SequenceTime /end REF_CHARACTERISTIC /begin REF_MEASUREMENT monr_VbHHM_HallErrSpeedLHHM_flg /end REF_MEASUREMENT /end GROUP
/begin GROUP S179_RS "POD_HallHandleModule_TZCU/POD_HallHandleModule/HallHandleModule/HallHandleModuleL/HallErrorProcess/SenorErr/RS" /begin SUB_GROUP S235_Switch1 /end SUB_GROUP /end GROUP
/begin GROUP S180_MovReset "POD_HallHandleModule_TZCU/POD_HallHandleModule/HallHandleModule/HallHandleModuleL/HallErrorProcess/SenorErr_Reset/MovReset" /begin SUB_GROUP S242_Rising_Debounce1 /end SUB_GROUP /end GROUP
/begin GROUP S180_Rising_Debounce2 "POD_HallHandleModule_TZCU/POD_HallHandleModule/HallHandleModule/HallHandleModuleL/HallErrorProcess/SenorErr_Reset/Rising Debounce2" /begin REF_CHARACTERISTIC k_HHM_Ti_SequenceTime k_HHM_Ti_TimeHallStatic /end REF_CHARACTERISTIC /end GROUP
/begin GROUP S180_cnt "POD_HallHandleModule_TZCU/POD_HallHandleModule/HallHandleModule/HallHandleModuleL/HallErrorProcess/SenorErr_Reset/cnt" /begin REF_CHARACTERISTIC k_HHM_Value_HallPassCnt /end REF_CHARACTERISTIC /end GROUP
/begin GROUP S257_Rising_Debounce "POD_HallHandleModule_TZCU/POD_HallHandleModule/HallHandleModule/HallHandleModuleR/AngleConversion/DoorOpenTargetPosition/Rising Debounce" /begin REF_CHARACTERISTIC k_HHM_Ti_SequenceTime k_HHM_Ti_TimeInsdSetPstnDelay /end REF_CHARACTERISTIC /end GROUP
/begin GROUP S273_ClosingInLock "POD_HallHandleModule_TZCU/POD_HallHandleModule/HallHandleModule/HallHandleModuleR/DoorMovSts/Hold/ClosingInLock" /begin SUB_GROUP S279_Rising_Debounce /end SUB_GROUP /end GROUP
/begin GROUP S273_DooStop "POD_HallHandleModule_TZCU/POD_HallHandleModule/HallHandleModule/HallHandleModuleR/DoorMovSts/Hold/DooStop" /begin SUB_GROUP S280_Rising_Debounce S280_Rising_Debounce1 /end SUB_GROUP /begin REF_CHARACTERISTIC k_HHM_Value_ManualHoldIMUAngSpdMinSpeed /end REF_CHARACTERISTIC /end GROUP
/begin GROUP S273_DoorStateErrorJudge "POD_HallHandleModule_TZCU/POD_HallHandleModule/HallHandleModule/HallHandleModuleR/DoorMovSts/Hold/DoorStateErrorJudge" /begin SUB_GROUP S281_Rising_Debounce4 /end SUB_GROUP /end GROUP
/begin GROUP S273_ElecDoorStop "POD_HallHandleModule_TZCU/POD_HallHandleModule/HallHandleModule/HallHandleModuleR/DoorMovSts/Hold/ElecDoorStop" /begin SUB_GROUP S282_Rising_Debounce /end SUB_GROUP /end GROUP
/begin GROUP S273_ManualDoorStop "POD_HallHandleModule_TZCU/POD_HallHandleModule/HallHandleModule/HallHandleModuleR/DoorMovSts/Hold/ManualDoorStop"
 /begin REF_CHARACTERISTIC k_HHM_Ti_SequenceTime k_HHM_Ti_TimeHoldManualDoorStopMovSts /end REF_CHARACTERISTIC
/end GROUP
/begin GROUP S275_ManualJudge "POD_HallHandleModule_TZCU/POD_HallHandleModule/HallHandleModule/HallHandleModuleR/DoorMovSts/ManualMov/ManualJudge"
 /begin REF_MEASUREMENT monr_VbHHM_BooleanManualDownRHHM_flg monr_VbHHM_BooleanManualUpRHHM_flg /end REF_MEASUREMENT
/end GROUP
/begin GROUP S275_PerManualMovDoor "POD_HallHandleModule_TZCU/POD_HallHandleModule/HallHandleModule/HallHandleModuleR/DoorMovSts/ManualMov/PerManualMovDoor"
 /begin SUB_GROUP S307_Rising_Debounce S307_Rising_Debounce1 S307_Rising_Debounce2 S307_Rising_Debounce3 /end SUB_GROUP
 /begin REF_CHARACTERISTIC k_HHM_Value_ManualCloseHallSpeed k_HHM_Value_ManualCloseIMUAngSpdMinSpeed k_HHM_Value_ManualOpenHallSpeed k_HHM_Value_ManualOpenIMUAngSpdMinSpeed /end REF_CHARACTERISTIC
/end GROUP
/begin GROUP S276_SectorTopClose "POD_HallHandleModule_TZCU/POD_HallHandleModule/HallHandleModule/HallHandleModuleR/DoorMovSts/POD_GetSector/SectorTopClose" /begin REF_CHARACTERISTIC k_HHM_Value_SectorForClose /end REF_CHARACTERISTIC /end GROUP
/begin GROUP S276_SectorTopOpen "POD_HallHandleModule_TZCU/POD_HallHandleModule/HallHandleModule/HallHandleModuleR/DoorMovSts/POD_GetSector/SectorTopOpen" /begin REF_CHARACTERISTIC k_HHM_Value_SectorForOpen /end REF_CHARACTERISTIC /end GROUP
/begin GROUP S331_ASWHallInit "POD_HallHandleModule_TZCU/POD_HallHandleModule/HallHandleModule/HallHandleModuleR/HallCntrHandle/HallPosition/ASWHallInit" /begin SUB_GROUP S333_Rising_Debounce S333_Timer_Debounce /end SUB_GROUP /begin REF_MEASUREMENT monr_VbHHM_ASWBSWHallInitR_flg /end REF_MEASUREMENT /end GROUP
/begin GROUP S331_DrvHallNum "POD_HallHandleModule_TZCU/POD_HallHandleModule/HallHandleModule/HallHandleModuleR/HallCntrHandle/HallPosition/DrvHallNum" /begin REF_CHARACTERISTIC k_HHM_Value_Multiple /end REF_CHARACTERISTIC
 /begin REF_MEASUREMENT monr_VsHHM_AntiPinchHallPositionR_NULL monr_VsHHM_OrigValueAntiPinchHallPositionRHHM_NULL monr_VsHHM_OrigValueHallPositionRHHM_NULL /end REF_MEASUREMENT
/end GROUP
/begin GROUP S331_HallInitialization "POD_HallHandleModule_TZCU/POD_HallHandleModule/HallHandleModule/HallHandleModuleR/HallCntrHandle/HallPosition/HallInitialization" /begin SUB_GROUP S335_ErrInitVerify S335_LckState /end SUB_GROUP
 /begin REF_MEASUREMENT monr_VbHHM_DoorAbsPstnInitRHHM_flg monr_VbHHM_DoorOpenRHHM_flg monr_VbHHM_DoorPstnInitRHHM_flg monr_VbHHM_DoorRelPstnInitRHHM_flg monr_VbHHM_NVMHallEnableRHHM_flg /end REF_MEASUREMENT
/end GROUP
/begin GROUP S332_DirectionJudge "POD_HallHandleModule_TZCU/POD_HallHandleModule/HallHandleModule/HallHandleModuleR/HallCntrHandle/HallSpeed/DirectionJudge" /begin REF_MEASUREMENT monr_VfHHM_HallSpeedDirectionRHHM_NULL /end REF_MEASUREMENT /end GROUP
/begin GROUP S332_HallFixedTiOffset "POD_HallHandleModule_TZCU/POD_HallHandleModule/HallHandleModule/HallHandleModuleR/HallCntrHandle/HallSpeed/HallFixedTiOffset" /begin SUB_GROUP S366_Rising_Debounce1 /end SUB_GROUP /begin REF_MEASUREMENT monr_VfHHM_HallFixedTiOffsetRHHM_NULL /end REF_MEASUREMENT /end GROUP
/begin GROUP S332_HallSpeedJudge "POD_HallHandleModule_TZCU/POD_HallHandleModule/HallHandleModule/HallHandleModuleR/HallCntrHandle/HallSpeed/HallSpeedJudge"
 /begin REF_CHARACTERISTIC k_HHM_Ti_SequenceTime k_HHM_Value_Minus2Sec k_HHM_Value_Sec2Milsec k_HHM_Value_cfgHallHandlePeriod /end REF_CHARACTERISTIC
 /begin REF_MEASUREMENT monr_VsHHM_AswHallAccR_g monr_VsHHM_AswHallPosSpeedRHHM_rpm monr_VsHHM_AswHallSpeedR_rpm /end REF_MEASUREMENT
/end GROUP
/begin GROUP S375_Rising_Debounce "POD_HallHandleModule_TZCU/POD_HallHandleModule/HallHandleModule/HallHandleModuleR/HallErrorProcess/HALL_AFault/Rising Debounce" /begin REF_CHARACTERISTIC k_HHM_Ti_HallAErrorConTi k_HHM_Ti_SequenceTime /end REF_CHARACTERISTIC /end GROUP
/begin GROUP S375_Rising_Debounce1 "POD_HallHandleModule_TZCU/POD_HallHandleModule/HallHandleModule/HallHandleModuleR/HallErrorProcess/HALL_AFault/Rising Debounce1" /begin REF_CHARACTERISTIC k_HHM_Ti_HallAErrorConTi k_HHM_Ti_SequenceTime /end REF_CHARACTERISTIC /end GROUP
/begin GROUP S375_Rising_Debounce2 "POD_HallHandleModule_TZCU/POD_HallHandleModule/HallHandleModule/HallHandleModuleR/HallErrorProcess/HALL_AFault/Rising Debounce2" /begin REF_CHARACTERISTIC k_HHM_Ti_HallNumAStaticTi k_HHM_Ti_SequenceTime /end REF_CHARACTERISTIC /end GROUP
/begin GROUP S375_Rising_Debounce3 "POD_HallHandleModule_TZCU/POD_HallHandleModule/HallHandleModule/HallHandleModuleR/HallErrorProcess/HALL_AFault/Rising Debounce3" /begin REF_CHARACTERISTIC k_HHM_Ti_HallDirAErrorTi k_HHM_Ti_SequenceTime /end REF_CHARACTERISTIC /end GROUP
/begin GROUP S376_Falling_Debounce "POD_HallHandleModule_TZCU/POD_HallHandleModule/HallHandleModule/HallHandleModuleR/HallErrorProcess/HALL_BFault/Falling Debounce" /begin REF_CHARACTERISTIC k_HHM_Ti_HallReveMaxTi k_HHM_Ti_SequenceTime /end REF_CHARACTERISTIC /end GROUP
/begin GROUP S376_Falling_Debounce1 "POD_HallHandleModule_TZCU/POD_HallHandleModule/HallHandleModule/HallHandleModuleR/HallErrorProcess/HALL_BFault/Falling Debounce1" /begin REF_CHARACTERISTIC k_HHM_Ti_HallReveMaxTi k_HHM_Ti_SequenceTime /end REF_CHARACTERISTIC /end GROUP
/begin GROUP S376_Rising_Debounce "POD_HallHandleModule_TZCU/POD_HallHandleModule/HallHandleModule/HallHandleModuleR/HallErrorProcess/HALL_BFault/Rising Debounce" /begin REF_CHARACTERISTIC k_HHM_Ti_HallPWMErrorConTi k_HHM_Ti_SequenceTime /end REF_CHARACTERISTIC /end GROUP
/begin GROUP S376_Rising_Debounce1 "POD_HallHandleModule_TZCU/POD_HallHandleModule/HallHandleModule/HallHandleModuleR/HallErrorProcess/HALL_BFault/Rising Debounce1" /begin REF_CHARACTERISTIC k_HHM_Ti_OpenDoorHallPWMStaticTi k_HHM_Ti_SequenceTime /end REF_CHARACTERISTIC /end GROUP
/begin GROUP S376_Rising_Debounce2 "POD_HallHandleModule_TZCU/POD_HallHandleModule/HallHandleModule/HallHandleModuleR/HallErrorProcess/HALL_BFault/Rising Debounce2" /begin REF_CHARACTERISTIC k_HHM_Ti_OpenDoorHallDecTi k_HHM_Ti_SequenceTime /end REF_CHARACTERISTIC /end GROUP
/begin GROUP S376_Rising_Debounce3 "POD_HallHandleModule_TZCU/POD_HallHandleModule/HallHandleModule/HallHandleModuleR/HallErrorProcess/HALL_BFault/Rising Debounce3" /begin REF_CHARACTERISTIC k_HHM_Ti_CloseDoorHallIncTi k_HHM_Ti_SequenceTime /end REF_CHARACTERISTIC /end GROUP
/begin GROUP S376_Rising_Debounce4 "POD_HallHandleModule_TZCU/POD_HallHandleModule/HallHandleModule/HallHandleModuleR/HallErrorProcess/HALL_BFault/Rising Debounce4" /begin REF_CHARACTERISTIC k_HHM_Ti_CloseDoorHallPWMStaticTi k_HHM_Ti_SequenceTime /end REF_CHARACTERISTIC /end GROUP
/begin GROUP S376_Rising_Debounce5 "POD_HallHandleModule_TZCU/POD_HallHandleModule/HallHandleModule/HallHandleModuleR/HallErrorProcess/HALL_BFault/Rising Debounce5" /begin REF_CHARACTERISTIC k_HHM_Ti_HallPWMErrorConTi k_HHM_Ti_SequenceTime /end REF_CHARACTERISTIC /end GROUP
/begin GROUP S376_Rising_Debounce6 "POD_HallHandleModule_TZCU/POD_HallHandleModule/HallHandleModule/HallHandleModuleR/HallErrorProcess/HALL_BFault/Rising Debounce6" /begin REF_CHARACTERISTIC k_HHM_Ti_HallPWMErrorJudgeTi k_HHM_Ti_SequenceTime /end REF_CHARACTERISTIC /end GROUP
/begin GROUP S376_Rising_Debounce7 "POD_HallHandleModule_TZCU/POD_HallHandleModule/HallHandleModule/HallHandleModuleR/HallErrorProcess/HALL_BFault/Rising Debounce7"
 /begin REF_CHARACTERISTIC k_HHM_Ti_HallPWMErrorAbsPosSpdJudgeTi k_HHM_Ti_SequenceTime /end REF_CHARACTERISTIC
/end GROUP
/begin GROUP S377_Rising_Debounce "POD_HallHandleModule_TZCU/POD_HallHandleModule/HallHandleModule/HallHandleModuleR/HallErrorProcess/HallJudgeCondition/Rising Debounce" /begin REF_CHARACTERISTIC k_HHM_Ti_ECUWakeUpJudgeMinTi k_HHM_Ti_SequenceTime /end REF_CHARACTERISTIC /end GROUP
/begin GROUP S377_Rising_Debounce1 "POD_HallHandleModule_TZCU/POD_HallHandleModule/HallHandleModule/HallHandleModuleR/HallErrorProcess/HallJudgeCondition/Rising Debounce1" /begin REF_CHARACTERISTIC k_HHM_Ti_HallPWMErrTi k_HHM_Ti_SequenceTime /end REF_CHARACTERISTIC /begin REF_MEASUREMENT monr_VbHHM_HallErrSpeedRHHM_flg /end REF_MEASUREMENT /end GROUP
/begin GROUP S378_RS "POD_HallHandleModule_TZCU/POD_HallHandleModule/HallHandleModule/HallHandleModuleR/HallErrorProcess/SenorErr/RS" /begin SUB_GROUP S434_Switch1 /end SUB_GROUP /end GROUP
/begin GROUP S379_MovReset "POD_HallHandleModule_TZCU/POD_HallHandleModule/HallHandleModule/HallHandleModuleR/HallErrorProcess/SenorErr_Reset/MovReset" /begin SUB_GROUP S441_Rising_Debounce1 /end SUB_GROUP /end GROUP
/begin GROUP S379_Rising_Debounce2 "POD_HallHandleModule_TZCU/POD_HallHandleModule/HallHandleModule/HallHandleModuleR/HallErrorProcess/SenorErr_Reset/Rising Debounce2" /begin REF_CHARACTERISTIC k_HHM_Ti_SequenceTime k_HHM_Ti_TimeHallStatic /end REF_CHARACTERISTIC /end GROUP
/begin GROUP S379_cnt "POD_HallHandleModule_TZCU/POD_HallHandleModule/HallHandleModule/HallHandleModuleR/HallErrorProcess/SenorErr_Reset/cnt" /begin REF_CHARACTERISTIC k_HHM_Value_HallPassCnt /end REF_CHARACTERISTIC /end GROUP
/begin GROUP S80_Rising_Debounce "POD_HallHandleModule_TZCU/POD_HallHandleModule/HallHandleModule/HallHandleModuleL/DoorMovSts/Hold/ClosingInLock/Rising Debounce" /begin REF_CHARACTERISTIC k_HHM_Ti_SequenceTime k_HHM_Ti_TimeClosingInLockHoldMovSts /end REF_CHARACTERISTIC /end GROUP
/begin GROUP S81_Rising_Debounce "POD_HallHandleModule_TZCU/POD_HallHandleModule/HallHandleModule/HallHandleModuleL/DoorMovSts/Hold/DooStop/Rising Debounce" /begin REF_CHARACTERISTIC k_HHM_Ti_SequenceTime k_HHM_Ti_TimeIMUDoorStopMovSts /end REF_CHARACTERISTIC /end GROUP
/begin GROUP S81_Rising_Debounce1 "POD_HallHandleModule_TZCU/POD_HallHandleModule/HallHandleModule/HallHandleModuleL/DoorMovSts/Hold/DooStop/Rising Debounce1" /begin REF_CHARACTERISTIC k_HHM_Ti_SequenceTime k_HHM_Ti_TimeHallSpdNoMov /end REF_CHARACTERISTIC /end GROUP
/begin GROUP S82_Rising_Debounce4 "POD_HallHandleModule_TZCU/POD_HallHandleModule/HallHandleModule/HallHandleModuleL/DoorMovSts/Hold/DoorStateErrorJudge/Rising Debounce4" /begin REF_CHARACTERISTIC k_HHM_Ti_SequenceTime k_HHM_Ti_TimeHoldDoorErrorMovSts /end REF_CHARACTERISTIC /end GROUP
/begin GROUP S83_Rising_Debounce "POD_HallHandleModule_TZCU/POD_HallHandleModule/HallHandleModule/HallHandleModuleL/DoorMovSts/Hold/ElecDoorStop/Rising Debounce" /begin REF_CHARACTERISTIC k_HHM_Ti_SequenceTime k_HHM_Ti_TimeHoldDoorStopMovSts /end REF_CHARACTERISTIC /end GROUP
/begin GROUP S108_Rising_Debounce "POD_HallHandleModule_TZCU/POD_HallHandleModule/HallHandleModule/HallHandleModuleL/DoorMovSts/ManualMov/PerManualMovDoor/Rising Debounce" /begin REF_CHARACTERISTIC k_HHM_Ti_SequenceTime k_HHM_Ti_TimeManualDoorCloseMovSts /end REF_CHARACTERISTIC /end GROUP
/begin GROUP S108_Rising_Debounce1 "POD_HallHandleModule_TZCU/POD_HallHandleModule/HallHandleModule/HallHandleModuleL/DoorMovSts/ManualMov/PerManualMovDoor/Rising Debounce1" /begin REF_CHARACTERISTIC k_HHM_Ti_SequenceTime k_HHM_Ti_TimeManualDoorOpenMovSts /end REF_CHARACTERISTIC /end GROUP
/begin GROUP S108_Rising_Debounce2 "POD_HallHandleModule_TZCU/POD_HallHandleModule/HallHandleModule/HallHandleModuleL/DoorMovSts/ManualMov/PerManualMovDoor/Rising Debounce2" /begin REF_CHARACTERISTIC k_HHM_Ti_SequenceTime k_HHM_Ti_TimeManualDoorOpenMovSts /end REF_CHARACTERISTIC /end GROUP
/begin GROUP S108_Rising_Debounce3 "POD_HallHandleModule_TZCU/POD_HallHandleModule/HallHandleModule/HallHandleModuleL/DoorMovSts/ManualMov/PerManualMovDoor/Rising Debounce3" /begin REF_CHARACTERISTIC k_HHM_Ti_SequenceTime k_HHM_Ti_TimeManualDoorCloseMovSts /end REF_CHARACTERISTIC /end GROUP
/begin GROUP S134_Rising_Debounce "POD_HallHandleModule_TZCU/POD_HallHandleModule/HallHandleModule/HallHandleModuleL/HallCntrHandle/HallPosition/ASWHallInit/Rising Debounce" /begin REF_CHARACTERISTIC k_HHM_Ti_SequenceTime k_HHM_Ti_TimeHallInitDelay /end REF_CHARACTERISTIC /end GROUP
/begin GROUP S134_Timer_Debounce "POD_HallHandleModule_TZCU/POD_HallHandleModule/HallHandleModule/HallHandleModuleL/HallCntrHandle/HallPosition/ASWHallInit/Timer Debounce" /begin REF_CHARACTERISTIC k_HHM_Ti_SequenceTime /end REF_CHARACTERISTIC /end GROUP
/begin GROUP S136_ErrInitVerify "POD_HallHandleModule_TZCU/POD_HallHandleModule/HallHandleModule/HallHandleModuleL/HallCntrHandle/HallPosition/HallInitialization/ErrInitVerify" /begin REF_MEASUREMENT monr_VbHHM_HallErrLHHM_flg monr_VbHHM_InitErrorLHHM_flg /end REF_MEASUREMENT /end GROUP
/begin GROUP S136_LckState "POD_HallHandleModule_TZCU/POD_HallHandleModule/HallHandleModule/HallHandleModuleL/HallCntrHandle/HallPosition/HallInitialization/LckState" /begin SUB_GROUP S152_RS S152_Rising_Debounce1 /end SUB_GROUP /begin REF_CHARACTERISTIC k_HHM_Value_PushLockMaxD k_HHM_Value_PushLockMaxF /end REF_CHARACTERISTIC /end GROUP
/begin GROUP S167_Rising_Debounce1 "POD_HallHandleModule_TZCU/POD_HallHandleModule/HallHandleModule/HallHandleModuleL/HallCntrHandle/HallSpeed/HallFixedTiOffset/Rising Debounce1" /begin REF_CHARACTERISTIC k_HHM_Ti_SequenceTime /end REF_CHARACTERISTIC /end GROUP
/begin GROUP S235_Switch1 "POD_HallHandleModule_TZCU/POD_HallHandleModule/HallHandleModule/HallHandleModuleL/HallErrorProcess/SenorErr/RS/Switch1" /begin REF_MEASUREMENT monr_VbHHM_HallSigFltL_flg /end REF_MEASUREMENT /end GROUP
/begin GROUP S242_Rising_Debounce1 "POD_HallHandleModule_TZCU/POD_HallHandleModule/HallHandleModule/HallHandleModuleL/HallErrorProcess/SenorErr_Reset/MovReset/Rising Debounce1" /begin REF_CHARACTERISTIC k_HHM_Ti_SequenceTime k_HHM_Ti_TimeWakeUp /end REF_CHARACTERISTIC /end GROUP
/begin GROUP S279_Rising_Debounce "POD_HallHandleModule_TZCU/POD_HallHandleModule/HallHandleModule/HallHandleModuleR/DoorMovSts/Hold/ClosingInLock/Rising Debounce" /begin REF_CHARACTERISTIC k_HHM_Ti_SequenceTime k_HHM_Ti_TimeClosingInLockHoldMovSts /end REF_CHARACTERISTIC /end GROUP
/begin GROUP S280_Rising_Debounce "POD_HallHandleModule_TZCU/POD_HallHandleModule/HallHandleModule/HallHandleModuleR/DoorMovSts/Hold/DooStop/Rising Debounce" /begin REF_CHARACTERISTIC k_HHM_Ti_SequenceTime k_HHM_Ti_TimeIMUDoorStopMovSts /end REF_CHARACTERISTIC /end GROUP
/begin GROUP S280_Rising_Debounce1 "POD_HallHandleModule_TZCU/POD_HallHandleModule/HallHandleModule/HallHandleModuleR/DoorMovSts/Hold/DooStop/Rising Debounce1" /begin REF_CHARACTERISTIC k_HHM_Ti_SequenceTime k_HHM_Ti_TimeHallSpdNoMov /end REF_CHARACTERISTIC /end GROUP
/begin GROUP S281_Rising_Debounce4 "POD_HallHandleModule_TZCU/POD_HallHandleModule/HallHandleModule/HallHandleModuleR/DoorMovSts/Hold/DoorStateErrorJudge/Rising Debounce4" /begin REF_CHARACTERISTIC k_HHM_Ti_SequenceTime k_HHM_Ti_TimeHoldDoorErrorMovSts /end REF_CHARACTERISTIC /end GROUP
/begin GROUP S282_Rising_Debounce "POD_HallHandleModule_TZCU/POD_HallHandleModule/HallHandleModule/HallHandleModuleR/DoorMovSts/Hold/ElecDoorStop/Rising Debounce" /begin REF_CHARACTERISTIC k_HHM_Ti_SequenceTime k_HHM_Ti_TimeHoldDoorStopMovSts /end REF_CHARACTERISTIC /end GROUP
/begin GROUP S307_Rising_Debounce "POD_HallHandleModule_TZCU/POD_HallHandleModule/HallHandleModule/HallHandleModuleR/DoorMovSts/ManualMov/PerManualMovDoor/Rising Debounce" /begin REF_CHARACTERISTIC k_HHM_Ti_SequenceTime k_HHM_Ti_TimeManualDoorCloseMovSts /end REF_CHARACTERISTIC /end GROUP
/begin GROUP S307_Rising_Debounce1 "POD_HallHandleModule_TZCU/POD_HallHandleModule/HallHandleModule/HallHandleModuleR/DoorMovSts/ManualMov/PerManualMovDoor/Rising Debounce1" /begin REF_CHARACTERISTIC k_HHM_Ti_SequenceTime k_HHM_Ti_TimeManualDoorOpenMovSts /end REF_CHARACTERISTIC /end GROUP
/begin GROUP S307_Rising_Debounce2 "POD_HallHandleModule_TZCU/POD_HallHandleModule/HallHandleModule/HallHandleModuleR/DoorMovSts/ManualMov/PerManualMovDoor/Rising Debounce2" /begin REF_CHARACTERISTIC k_HHM_Ti_SequenceTime k_HHM_Ti_TimeManualDoorOpenMovSts /end REF_CHARACTERISTIC /end GROUP
/begin GROUP S307_Rising_Debounce3 "POD_HallHandleModule_TZCU/POD_HallHandleModule/HallHandleModule/HallHandleModuleR/DoorMovSts/ManualMov/PerManualMovDoor/Rising Debounce3" /begin REF_CHARACTERISTIC k_HHM_Ti_SequenceTime k_HHM_Ti_TimeManualDoorCloseMovSts /end REF_CHARACTERISTIC /end GROUP
/begin GROUP S333_Rising_Debounce "POD_HallHandleModule_TZCU/POD_HallHandleModule/HallHandleModule/HallHandleModuleR/HallCntrHandle/HallPosition/ASWHallInit/Rising Debounce" /begin REF_CHARACTERISTIC k_HHM_Ti_SequenceTime k_HHM_Ti_TimeHallInitDelay /end REF_CHARACTERISTIC /end GROUP
/begin GROUP S333_Timer_Debounce "POD_HallHandleModule_TZCU/POD_HallHandleModule/HallHandleModule/HallHandleModuleR/HallCntrHandle/HallPosition/ASWHallInit/Timer Debounce" /begin REF_CHARACTERISTIC k_HHM_Ti_SequenceTime /end REF_CHARACTERISTIC /end GROUP
/begin GROUP S335_ErrInitVerify "POD_HallHandleModule_TZCU/POD_HallHandleModule/HallHandleModule/HallHandleModuleR/HallCntrHandle/HallPosition/HallInitialization/ErrInitVerify" /begin REF_MEASUREMENT monr_VbHHM_HallErrRHHM_flg monr_VbHHM_InitErrorRHHM_flg /end REF_MEASUREMENT /end GROUP
/begin GROUP S335_LckState "POD_HallHandleModule_TZCU/POD_HallHandleModule/HallHandleModule/HallHandleModuleR/HallCntrHandle/HallPosition/HallInitialization/LckState" /begin SUB_GROUP S351_RS S351_Rising_Debounce1 /end SUB_GROUP /begin REF_CHARACTERISTIC k_HHM_Value_PushLockMaxD k_HHM_Value_PushLockMaxF /end REF_CHARACTERISTIC /end GROUP
/begin GROUP S366_Rising_Debounce1 "POD_HallHandleModule_TZCU/POD_HallHandleModule/HallHandleModule/HallHandleModuleR/HallCntrHandle/HallSpeed/HallFixedTiOffset/Rising Debounce1" /begin REF_CHARACTERISTIC k_HHM_Ti_SequenceTime /end REF_CHARACTERISTIC /end GROUP
/begin GROUP S434_Switch1 "POD_HallHandleModule_TZCU/POD_HallHandleModule/HallHandleModule/HallHandleModuleR/HallErrorProcess/SenorErr/RS/Switch1" /begin REF_MEASUREMENT monr_VbHHM_HallSigFltR_flg /end REF_MEASUREMENT /end GROUP
/begin GROUP S441_Rising_Debounce1 "POD_HallHandleModule_TZCU/POD_HallHandleModule/HallHandleModule/HallHandleModuleR/HallErrorProcess/SenorErr_Reset/MovReset/Rising Debounce1" /begin REF_CHARACTERISTIC k_HHM_Ti_SequenceTime k_HHM_Ti_TimeWakeUp /end REF_CHARACTERISTIC /end GROUP
/begin GROUP S152_RS "POD_HallHandleModule_TZCU/POD_HallHandleModule/HallHandleModule/HallHandleModuleL/HallCntrHandle/HallPosition/HallInitialization/LckState/RS" /begin SUB_GROUP S155_Switch1 /end SUB_GROUP /end GROUP
/begin GROUP S152_Rising_Debounce1 "POD_HallHandleModule_TZCU/POD_HallHandleModule/HallHandleModule/HallHandleModuleL/HallCntrHandle/HallPosition/HallInitialization/LckState/Rising Debounce1" /begin REF_CHARACTERISTIC k_HHM_Ti_SequenceTime k_HHM_Ti_TimeHalfClsdDelay /end REF_CHARACTERISTIC /end GROUP
/begin GROUP S351_RS "POD_HallHandleModule_TZCU/POD_HallHandleModule/HallHandleModule/HallHandleModuleR/HallCntrHandle/HallPosition/HallInitialization/LckState/RS" /begin SUB_GROUP S354_Switch1 /end SUB_GROUP /end GROUP
/begin GROUP S351_Rising_Debounce1 "POD_HallHandleModule_TZCU/POD_HallHandleModule/HallHandleModule/HallHandleModuleR/HallCntrHandle/HallPosition/HallInitialization/LckState/Rising Debounce1" /begin REF_CHARACTERISTIC k_HHM_Ti_SequenceTime k_HHM_Ti_TimeHalfClsdDelay /end REF_CHARACTERISTIC /end GROUP
/begin GROUP S155_Switch1 "POD_HallHandleModule_TZCU/POD_HallHandleModule/HallHandleModule/HallHandleModuleL/HallCntrHandle/HallPosition/HallInitialization/LckState/RS/Switch1" /begin REF_MEASUREMENT monr_VbHHM_Lck2DrStsErrLHHM_flg /end REF_MEASUREMENT /end GROUP
/begin GROUP S354_Switch1 "POD_HallHandleModule_TZCU/POD_HallHandleModule/HallHandleModule/HallHandleModuleR/HallCntrHandle/HallPosition/HallInitialization/LckState/RS/Switch1" /begin REF_MEASUREMENT monr_VbHHM_Lck2DrStsErrRHHM_flg /end REF_MEASUREMENT /end GROUP
/begin MEASUREMENT monr_VfMCM_GravityTorqueLMBCL_Nm "" FLOAT32_IEEE POD_MBCL_CM_single 0 0 -3.4E+38 3.4E+38 ECU_ADDRESS 0xb0055ce8 /* @ECU_Address@monr_VfMCM_GravityTorqueLMBCL_Nm@ */ /end MEASUREMENT
/begin MEASUREMENT monr_VfMCM_SideIncinAgLMBCL_deg "" FLOAT32_IEEE POD_MBCL_CM_single 0 0 -3.4E+38 3.4E+38 ECU_ADDRESS 0xb0055cc8 /* @ECU_Address@monr_VfMCM_SideIncinAgLMBCL_deg@ */ /end MEASUREMENT
/begin MEASUREMENT monr_VfMCM_RoadInclnLMBCL_deg "" FLOAT32_IEEE POD_MBCL_CM_single 0 0 -3.4E+38 3.4E+38 ECU_ADDRESS 0xb0055cd0 /* @ECU_Address@monr_VfMCM_RoadInclnLMBCL_deg@ */ /end MEASUREMENT
/begin MEASUREMENT monr_VuMBC_MotorCtrlBreakDutyL_NULL "" UWORD POD_MBCL_CM_uint16 0 0 0 65535 ECU_ADDRESS 0xb00561c2 /* @ECU_Address@monr_VuMBC_MotorCtrlBreakDutyL_NULL@ */ /end MEASUREMENT
/begin MEASUREMENT monr_VuMBC_HoldDutyL_NULL "" UWORD POD_MBCL_CM_uint16 0 0 0 65535 ECU_ADDRESS 0xb00561c0 /* @ECU_Address@monr_VuMBC_HoldDutyL_NULL@ */ /end MEASUREMENT
/begin MEASUREMENT monr_VsHHM_AswHallPositionLMBCL_NULL "" SWORD POD_MBCL_CM_int16 0 0 -32768 32767 ECU_ADDRESS 0xb0055cde /* @ECU_Address@monr_VsHHM_AswHallPositionLMBCL_NULL@ */ /end MEASUREMENT
/begin MEASUREMENT monr_VsHHM_AswHallSpeedLMBCL_rpm "" SWORD POD_MBCL_CM_int16 0 0 -32768 32767 ECU_ADDRESS 0xb0055cdc /* @ECU_Address@monr_VsHHM_AswHallSpeedLMBCL_rpm@ */ /end MEASUREMENT
/begin MEASUREMENT monr_VeSMM_DOPFcnStateLMBCL_enum "" UBYTE POD_MBCL_CM_uint8 0 0 0 255 ECU_ADDRESS 0xb0055cc4 /* @ECU_Address@monr_VeSMM_DOPFcnStateLMBCL_enum@ */ /end MEASUREMENT
/begin MEASUREMENT monr_VeSMM_StopEventLMBCL_enum "" UBYTE POD_MBCL_CM_uint8 0 0 0 255 ECU_ADDRESS 0xb0055ce1 /* @ECU_Address@monr_VeSMM_StopEventLMBCL_enum@ */ /end MEASUREMENT
/begin MEASUREMENT monr_VeSMM_MotorCtrlModeLMBCL_enum "" UBYTE POD_MBCL_CM_uint8 0 0 0 255 ECU_ADDRESS 0xb0055ce0 /* @ECU_Address@monr_VeSMM_MotorCtrlModeLMBCL_enum@ */ /end MEASUREMENT
/begin MEASUREMENT monr_VeSMM_HoverModCtrlLMBCL_enum "" UBYTE POD_MBCL_CM_uint8 0 0 0 255 ECU_ADDRESS 0xb0055ced /* @ECU_Address@monr_VeSMM_HoverModCtrlLMBCL_enum@ */ /end MEASUREMENT
/begin MEASUREMENT monr_VeMBC_HoldMotorCtrlModeL_enum "" UBYTE POD_MBCL_CM_uint8 0 0 0 255 ECU_ADDRESS 0xb00561bf /* @ECU_Address@monr_VeMBC_HoldMotorCtrlModeL_enum@ */ /end MEASUREMENT
/begin MEASUREMENT monr_VbSMM_HoldModeLMBCL_flg "" UBYTE POD_MBCL_CM_boolean 0 0 0 1 ECU_ADDRESS 0xb0055cd6 /* @ECU_Address@monr_VbSMM_HoldModeLMBCL_flg@ */ /end MEASUREMENT
/begin MEASUREMENT monr_VbMCM_ManualAssistLMBCL_flag "" UBYTE POD_MBCL_CM_boolean 0 0 0 1 ECU_ADDRESS 0xb0055cec /* @ECU_Address@monr_VbMCM_ManualAssistLMBCL_flag@ */ /end MEASUREMENT
/begin MEASUREMENT monr_VbMCM_TipToRunLMBCL_flag "" UBYTE POD_MBCL_CM_boolean 0 0 0 1 ECU_ADDRESS 0xb0055ccc /* @ECU_Address@monr_VbMCM_TipToRunLMBCL_flag@ */ /end MEASUREMENT
/begin MEASUREMENT monr_VbMCM_MotorBrkgLMBCL_flg "" UBYTE POD_MBCL_CM_boolean 0 0 0 1 ECU_ADDRESS 0xb0055cdb /* @ECU_Address@monr_VbMCM_MotorBrkgLMBCL_flg@ */ /end MEASUREMENT
/begin MEASUREMENT monr_VbMBC_HoldIsCtrlL_flg "" UBYTE POD_MBCL_CM_boolean 0 0 0 1 ECU_ADDRESS 0xb00561be /* @ECU_Address@monr_VbMBC_HoldIsCtrlL_flg@ */ /end MEASUREMENT
/begin COMPU_METHOD POD_MBCL_CM_single "Q = V" RAT_FUNC "%8.6" "" COEFFS 0 1 0 0 0 1 /end COMPU_METHOD
/begin COMPU_METHOD POD_MBCL_CM_uint16 "Q = V" RAT_FUNC "%5.0" "" COEFFS 0 1 0 0 0 1 /end COMPU_METHOD
/begin COMPU_METHOD POD_MBCL_CM_int16 "Q = V" RAT_FUNC "%5.0" "" COEFFS 0 1 0 0 0 1 /end COMPU_METHOD
/begin COMPU_METHOD POD_MBCL_CM_uint8 "Q = V" RAT_FUNC "%3.0" "" COEFFS 0 1 0 0 0 1 /end COMPU_METHOD
/begin COMPU_METHOD POD_MBCL_CM_boolean "Q = V" RAT_FUNC "%1.0" "" COEFFS 0 1 0 0 0 1 /end COMPU_METHOD
/begin GROUP POD_MBCL "POD_MBCL" ROOT /begin SUB_GROUP Root_POD_MotorBrakeCtrlL_Step_sys /end SUB_GROUP /end GROUP
/begin GROUP Root_POD_MotorBrakeCtrlL_Step_sys "POD_MBCL/POD_MotorBrakeCtrlL_Step_sys" /begin SUB_GROUP S2_POD_MotorBrakeCtrlL /end SUB_GROUP
 /begin REF_MEASUREMENT monr_VbMCM_ManualAssistLMBCL_flag monr_VbMCM_MotorBrkgLMBCL_flg monr_VbMCM_TipToRunLMBCL_flag monr_VbSMM_HoldModeLMBCL_flg monr_VeSMM_DOPFcnStateLMBCL_enum monr_VeSMM_HoverModCtrlLMBCL_enum monr_VeSMM_MotorCtrlModeLMBCL_enum monr_VeSMM_StopEventLMBCL_enum monr_VfMCM_GravityTorqueLMBCL_Nm monr_VfMCM_RoadInclnLMBCL_deg monr_VfMCM_SideIncinAgLMBCL_deg monr_VsHHM_AswHallPositionLMBCL_NULL monr_VsHHM_AswHallSpeedLMBCL_rpm /end REF_MEASUREMENT
/end GROUP
/begin GROUP S2_POD_MotorBrakeCtrlL "POD_MBCL/POD_MotorBrakeCtrlL_Step_sys/POD_MotorBrakeCtrlL"
 /begin REF_MEASUREMENT monr_VbMBC_HoldIsCtrlL_flg monr_VeMBC_HoldMotorCtrlModeL_enum monr_VuMBC_HoldDutyL_NULL monr_VuMBC_MotorCtrlBreakDutyL_NULL /end REF_MEASUREMENT
/end GROUP
/begin MEASUREMENT monr_VfMCM_GravityTorqueRMBCR_Nm "" FLOAT32_IEEE POD_MBCR_CM_single 0 0 -3.4E+38 3.4E+38 ECU_ADDRESS 0xb0055cf0 /* @ECU_Address@monr_VfMCM_GravityTorqueRMBCR_Nm@ */ /end MEASUREMENT
/begin MEASUREMENT monr_VfMCM_SideIncinAgRMBCR_deg "" FLOAT32_IEEE POD_MBCR_CM_single 0 0 -3.4E+38 3.4E+38 ECU_ADDRESS 0xb0055d00 /* @ECU_Address@monr_VfMCM_SideIncinAgRMBCR_deg@ */ /end MEASUREMENT
/begin MEASUREMENT monr_VfMCM_RoadInclnRMBCR_deg "" FLOAT32_IEEE POD_MBCR_CM_single 0 0 -3.4E+38 3.4E+38 ECU_ADDRESS 0xb0055d04 /* @ECU_Address@monr_VfMCM_RoadInclnRMBCR_deg@ */ /end MEASUREMENT
/begin MEASUREMENT monr_VuMBC_MotorCtrlBreakDutyR_NULL "" UWORD POD_MBCR_CM_uint16 0 0 0 65535 ECU_ADDRESS 0xb00561ca /* @ECU_Address@monr_VuMBC_MotorCtrlBreakDutyR_NULL@ */ /end MEASUREMENT
/begin MEASUREMENT monr_VuMBC_HoldDutyR_NULL "" UWORD POD_MBCR_CM_uint16 0 0 0 65535 ECU_ADDRESS 0xb00561c8 /* @ECU_Address@monr_VuMBC_HoldDutyR_NULL@ */ /end MEASUREMENT
/begin MEASUREMENT monr_VsHHM_AswHallPositionRMBCR_NULL "" SWORD POD_MBCR_CM_int16 0 0 -32768 32767 ECU_ADDRESS 0xb0055d0e /* @ECU_Address@monr_VsHHM_AswHallPositionRMBCR_NULL@ */ /end MEASUREMENT
/begin MEASUREMENT monr_VsHHM_AswHallSpeedRMBCR_rpm "" SWORD POD_MBCR_CM_int16 0 0 -32768 32767 ECU_ADDRESS 0xb0055d10 /* @ECU_Address@monr_VsHHM_AswHallSpeedRMBCR_rpm@ */ /end MEASUREMENT
/begin MEASUREMENT monr_VsMCM_totalFeedBackDutyRMBCR_NULL "" SWORD POD_MBCR_CM_int16 0 0 -32768 32767 ECU_ADDRESS 0xb00561c6 /* @ECU_Address@monr_VsMCM_totalFeedBackDutyRMBCR_NULL@ */ /end MEASUREMENT
/begin MEASUREMENT monr_VeSMM_DOPFcnStateRMBCR_enum "" UBYTE POD_MBCR_CM_uint8 0 0 0 255 ECU_ADDRESS 0xb0055d0c /* @ECU_Address@monr_VeSMM_DOPFcnStateRMBCR_enum@ */ /end MEASUREMENT
/begin MEASUREMENT monr_VeSMM_StopEventRMBCR_enum "" UBYTE POD_MBCR_CM_uint8 0 0 0 255 ECU_ADDRESS 0xb0055d12 /* @ECU_Address@monr_VeSMM_StopEventRMBCR_enum@ */ /end MEASUREMENT
/begin MEASUREMENT monr_VeSMM_MotorCtrlModeRMBCR_enum "" UBYTE POD_MBCR_CM_uint8 0 0 0 255 ECU_ADDRESS 0xb0055d13 /* @ECU_Address@monr_VeSMM_MotorCtrlModeRMBCR_enum@ */ /end MEASUREMENT
/begin MEASUREMENT monr_VeSMM_HoverModCtrlRMBCR_enum "" UBYTE POD_MBCR_CM_uint8 0 0 0 255 ECU_ADDRESS 0xb0055cfc /* @ECU_Address@monr_VeSMM_HoverModCtrlRMBCR_enum@ */ /end MEASUREMENT
/begin MEASUREMENT monr_VeMBC_HoldMotorCtrlModeR_enum "" UBYTE POD_MBCR_CM_uint8 0 0 0 255 ECU_ADDRESS 0xb00561c5 /* @ECU_Address@monr_VeMBC_HoldMotorCtrlModeR_enum@ */ /end MEASUREMENT
/begin MEASUREMENT monr_VbSMM_HoldModeRMBCR_flg "" UBYTE POD_MBCR_CM_boolean 0 0 0 1 ECU_ADDRESS 0xb0055d0b /* @ECU_Address@monr_VbSMM_HoldModeRMBCR_flg@ */ /end MEASUREMENT
/begin MEASUREMENT monr_VbMCM_ManualAssistRMBCR_flag "" UBYTE POD_MBCR_CM_boolean 0 0 0 1 ECU_ADDRESS 0xb0055cfd /* @ECU_Address@monr_VbMCM_ManualAssistRMBCR_flag@ */ /end MEASUREMENT
/begin MEASUREMENT monr_VbMCM_TipToRunRMBCR_flag "" UBYTE POD_MBCR_CM_boolean 0 0 0 1 ECU_ADDRESS 0xb0055cf8 /* @ECU_Address@monr_VbMCM_TipToRunRMBCR_flag@ */ /end MEASUREMENT
/begin MEASUREMENT monr_VbMCM_MotorBrkgRMBCR_flg "" UBYTE POD_MBCR_CM_boolean 0 0 0 1 ECU_ADDRESS 0xb0055cf9 /* @ECU_Address@monr_VbMCM_MotorBrkgRMBCR_flg@ */ /end MEASUREMENT
/begin MEASUREMENT monr_VbMBC_HoldIsCtrlR_flg "" UBYTE POD_MBCR_CM_boolean 0 0 0 1 ECU_ADDRESS 0xb00561c4 /* @ECU_Address@monr_VbMBC_HoldIsCtrlR_flg@ */ /end MEASUREMENT
/begin COMPU_METHOD POD_MBCR_CM_single "Q = V" RAT_FUNC "%8.6" "" COEFFS 0 1 0 0 0 1 /end COMPU_METHOD
/begin COMPU_METHOD POD_MBCR_CM_uint16 "Q = V" RAT_FUNC "%5.0" "" COEFFS 0 1 0 0 0 1 /end COMPU_METHOD
/begin COMPU_METHOD POD_MBCR_CM_int16 "Q = V" RAT_FUNC "%5.0" "" COEFFS 0 1 0 0 0 1 /end COMPU_METHOD
/begin COMPU_METHOD POD_MBCR_CM_uint8 "Q = V" RAT_FUNC "%3.0" "" COEFFS 0 1 0 0 0 1 /end COMPU_METHOD
/begin COMPU_METHOD POD_MBCR_CM_boolean "Q = V" RAT_FUNC "%1.0" "" COEFFS 0 1 0 0 0 1 /end COMPU_METHOD
/begin GROUP POD_MBCR "POD_MBCR" ROOT /begin SUB_GROUP Root_POD_MotorBrakeCtrlR_Step_sys /end SUB_GROUP /end GROUP
/begin GROUP Root_POD_MotorBrakeCtrlR_Step_sys "POD_MBCR/POD_MotorBrakeCtrlR_Step_sys" /begin SUB_GROUP S2_POD_MotorBrakeCtrlR /end SUB_GROUP
 /begin REF_MEASUREMENT monr_VbMCM_ManualAssistRMBCR_flag monr_VbMCM_MotorBrkgRMBCR_flg monr_VbMCM_TipToRunRMBCR_flag monr_VbSMM_HoldModeRMBCR_flg monr_VeSMM_DOPFcnStateRMBCR_enum monr_VeSMM_HoverModCtrlRMBCR_enum monr_VeSMM_MotorCtrlModeRMBCR_enum monr_VeSMM_StopEventRMBCR_enum monr_VfMCM_GravityTorqueRMBCR_Nm monr_VfMCM_RoadInclnRMBCR_deg monr_VfMCM_SideIncinAgRMBCR_deg monr_VsHHM_AswHallPositionRMBCR_NULL monr_VsHHM_AswHallSpeedRMBCR_rpm monr_VsMCM_totalFeedBackDutyRMBCR_NULL /end REF_MEASUREMENT
/end GROUP
/begin GROUP S2_POD_MotorBrakeCtrlR "POD_MBCR/POD_MotorBrakeCtrlR_Step_sys/POD_MotorBrakeCtrlR"
 /begin REF_MEASUREMENT monr_VbMBC_HoldIsCtrlR_flg monr_VeMBC_HoldMotorCtrlModeR_enum monr_VuMBC_HoldDutyR_NULL monr_VuMBC_MotorCtrlBreakDutyR_NULL /end REF_MEASUREMENT
/end GROUP
/begin CHARACTERISTIC k_MCM_MotorCtrlDutyL_value "" VALUE 0xb00060b0 /* @ECU_Address@k_MCM_MotorCtrlDutyL_value@ */ Scalar_FLOAT32_IEEE 0 POD_MCML_CM_single -3.4E+38 3.4E+38 /end CHARACTERISTIC
/begin CHARACTERISTIC k_MCM_MotorCtrlDuty1L_value "" VALUE 0xb00060a8 /* @ECU_Address@k_MCM_MotorCtrlDuty1L_value@ */ Scalar_UWORD 0 POD_MCML_CM_uint16 0 65535 /end CHARACTERISTIC
/begin CHARACTERISTIC k_MCM_MotorCtrlDuty2L_value "" VALUE 0xb00060ac /* @ECU_Address@k_MCM_MotorCtrlDuty2L_value@ */ Scalar_UWORD 0 POD_MCML_CM_uint16 0 65535 /end CHARACTERISTIC
/begin CHARACTERISTIC k_MCM_MotorCtrlDuty1L_flg "" VALUE 0xb00060a6 /* @ECU_Address@k_MCM_MotorCtrlDuty1L_flg@ */ Scalar_BOOLEAN 0 POD_MCML_CM_boolean 0 1 /end CHARACTERISTIC
/begin CHARACTERISTIC k_MCM_MotorCtrlDuty2L_flg "" VALUE 0xb00060aa /* @ECU_Address@k_MCM_MotorCtrlDuty2L_flg@ */ Scalar_BOOLEAN 0 POD_MCML_CM_boolean 0 1 /end CHARACTERISTIC
/begin CHARACTERISTIC k_MCM_MotorCtrlDutyL_flg "" VALUE 0xb00060ae /* @ECU_Address@k_MCM_MotorCtrlDutyL_flg@ */ Scalar_BOOLEAN 0 POD_MCML_CM_boolean 0 1 /end CHARACTERISTIC
/begin CHARACTERISTIC k_MCM_MotorCtrlModeL_flg "" VALUE 0xb00060b4 /* @ECU_Address@k_MCM_MotorCtrlModeL_flg@ */ Scalar_BOOLEAN 0 POD_MCML_CM_boolean 0 1 /end CHARACTERISTIC
/begin CHARACTERISTIC k_MCM_MotorCtrlModeL_value "" VALUE 0xb00060b5 /* @ECU_Address@k_MCM_MotorCtrlModeL_value@ */ Scalar_UBYTE 0 POD_MCML_CM_uint8 0 255 /end CHARACTERISTIC
/begin MEASUREMENT monr_VfSHM_MainMotoCurrentLMCML_MA "" FLOAT32_IEEE POD_MCML_CM_single 0 0 -3.4E+38 3.4E+38 ECU_ADDRESS 0xb0055d34 /* @ECU_Address@monr_VfSHM_MainMotoCurrentLMCML_MA@ */ /end MEASUREMENT
/begin MEASUREMENT monr_VfSHM_BatVoltageValueMCML_MV "" FLOAT32_IEEE POD_MCML_CM_single 0 0 -3.4E+38 3.4E+38 ECU_ADDRESS 0xb0055d38 /* @ECU_Address@monr_VfSHM_BatVoltageValueMCML_MV@ */ /end MEASUREMENT
/begin MEASUREMENT monr_VfSMM_TopDegforDoorOpenLMCML_NULL "" FLOAT32_IEEE POD_MCML_CM_single 0 0 -3.4E+38 3.4E+38 ECU_ADDRESS 0xb0055d48 /* @ECU_Address@monr_VfSMM_TopDegforDoorOpenLMCML_NULL@ */ /end MEASUREMENT
/begin MEASUREMENT monr_VfHHM_AswHallPositionLMCML_deg "" FLOAT32_IEEE POD_MCML_CM_single 0 0 -3.4E+38 3.4E+38 ECU_ADDRESS 0xb0055d58 /* @ECU_Address@monr_VfHHM_AswHallPositionLMCML_deg@ */ /end MEASUREMENT
/begin MEASUREMENT monr_VfSHM_AmbTempMCML_C "" FLOAT32_IEEE POD_MCML_CM_single 0 0 -3.4E+38 3.4E+38 ECU_ADDRESS 0xb0055d68 /* @ECU_Address@monr_VfSHM_AmbTempMCML_C@ */ /end MEASUREMENT
/begin MEASUREMENT monr_VfSHM_FrntIncinAgLMCML_deg "" FLOAT32_IEEE POD_MCML_CM_single 0 0 -3.4E+38 3.4E+38 ECU_ADDRESS 0xb0055d7c /* @ECU_Address@monr_VfSHM_FrntIncinAgLMCML_deg@ */ /end MEASUREMENT
/begin MEASUREMENT monr_VfSHM_SideIncinAgLMCML_deg "" FLOAT32_IEEE POD_MCML_CM_single 0 0 -3.4E+38 3.4E+38 ECU_ADDRESS 0xb0055d80 /* @ECU_Address@monr_VfSHM_SideIncinAgLMCML_deg@ */ /end MEASUREMENT
/begin MEASUREMENT monr_VfMCM_ldlToAntipinchL_MA "" FLOAT32_IEEE POD_MCML_CM_single 0 0 -3.4E+38 3.4E+38 ECU_ADDRESS 0xb0055d8c /* @ECU_Address@monr_VfMCM_ldlToAntipinchL_MA@ */ /end MEASUREMENT
/begin MEASUREMENT monr_VfMCM_BrakingTorqueL_NULL "" FLOAT32_IEEE POD_MCML_CM_single 0 0 -3.4E+38 3.4E+38 ECU_ADDRESS 0xb0055d94 /* @ECU_Address@monr_VfMCM_BrakingTorqueL_NULL@ */ /end MEASUREMENT
/begin MEASUREMENT monr_VfMCM_TarSpdL_NULL "" FLOAT32_IEEE POD_MCML_CM_single 0 0 -3.4E+38 3.4E+38 ECU_ADDRESS 0xb0055d9c /* @ECU_Address@monr_VfMCM_TarSpdL_NULL@ */ /end MEASUREMENT
/begin MEASUREMENT monr_VfMCM_TarPosL_NULL "" FLOAT32_IEEE POD_MCML_CM_single 0 0 -3.4E+38 3.4E+38 ECU_ADDRESS 0xb0055da0 /* @ECU_Address@monr_VfMCM_TarPosL_NULL@ */ /end MEASUREMENT
/begin MEASUREMENT monr_VfMCM_GravityTorqueL_Nm "" FLOAT32_IEEE POD_MCML_CM_single 0 0 -3.4E+38 3.4E+38 ECU_ADDRESS 0xb0055d24 /* @ECU_Address@monr_VfMCM_GravityTorqueL_Nm@ */ /end MEASUREMENT
/begin MEASUREMENT monr_VfMCM_SideIncinAgL_deg "" FLOAT32_IEEE POD_MCML_CM_single 0 0 -3.4E+38 3.4E+38 ECU_ADDRESS 0xb0055d2c /* @ECU_Address@monr_VfMCM_SideIncinAgL_deg@ */ /end MEASUREMENT
/begin MEASUREMENT monr_VfMCM_RoadInclnL_deg "" FLOAT32_IEEE POD_MCML_CM_single 0 0 -3.4E+38 3.4E+38 ECU_ADDRESS 0xb0055d20 /* @ECU_Address@monr_VfMCM_RoadInclnL_deg@ */ /end MEASUREMENT
/begin MEASUREMENT monr_VfMCM_MotorCtrlDutyL_NULL "" FLOAT32_IEEE POD_MCML_CM_single 0 0 -3.4E+38 3.4E+38 ECU_ADDRESS 0xb0055d18 /* @ECU_Address@monr_VfMCM_MotorCtrlDutyL_NULL@ */ /end MEASUREMENT
/begin MEASUREMENT monr_VfSHM_VehSpdLgtMCML_mps "" FLOAT32_IEEE POD_MCML_CM_single 0 0 -3.4E+38 3.4E+38 ECU_ADDRESS 0xb0055d74 /* @ECU_Address@monr_VfSHM_VehSpdLgtMCML_mps@ */ /end MEASUREMENT
/begin MEASUREMENT monr_VuMCM_MotorCtrlDuty1L_NULL "" UWORD POD_MCML_CM_uint16 0 0 0 65535 ECU_ADDRESS 0xb0055d3c /* @ECU_Address@monr_VuMCM_MotorCtrlDuty1L_NULL@ */ /end MEASUREMENT
/begin MEASUREMENT monr_VuMCM_MotorCtrlDuty2L_NULL "" UWORD POD_MCML_CM_uint16 0 0 0 65535 ECU_ADDRESS 0xb0055d4e /* @ECU_Address@monr_VuMCM_MotorCtrlDuty2L_NULL@ */ /end MEASUREMENT
/begin MEASUREMENT monr_VsHHM_AswHallPositionLMCML_NULL "" SWORD POD_MCML_CM_int16 0 0 -32768 32767 ECU_ADDRESS 0xb0055d54 /* @ECU_Address@monr_VsHHM_AswHallPositionLMCML_NULL@ */ /end MEASUREMENT
/begin MEASUREMENT monr_VsHHM_AswHallSpeedLMCML_rpm "" SWORD POD_MCML_CM_int16 0 0 -32768 32767 ECU_ADDRESS 0xb0055d5e /* @ECU_Address@monr_VsHHM_AswHallSpeedLMCML_rpm@ */ /end MEASUREMENT
/begin MEASUREMENT monr_VsMCM_TarCurrentL_NULL "" SWORD POD_MCML_CM_int16 0 0 -32768 32767 ECU_ADDRESS 0xb0055d1c /* @ECU_Address@monr_VsMCM_TarCurrentL_NULL@ */ /end MEASUREMENT
/begin MEASUREMENT monr_VsHHM_AswHallAccLMCML_g "" SWORD POD_MCML_CM_int16 0 0 -32768 32767 ECU_ADDRESS 0xb0055d60 /* @ECU_Address@monr_VsHHM_AswHallAccLMCML_g@ */ /end MEASUREMENT
/begin MEASUREMENT monr_VeSMM_DOPFcnStateLMCML_enum "" UBYTE POD_MCML_CM_uint8 0 0 0 255 ECU_ADDRESS 0xb0055d40 /* @ECU_Address@monr_VeSMM_DOPFcnStateLMCML_enum@ */ /end MEASUREMENT
/begin MEASUREMENT monr_VeSMM_MotorCtrlModeLMCML_enum "" UBYTE POD_MCML_CM_uint8 0 0 0 255 ECU_ADDRESS 0xb0055d41 /* @ECU_Address@monr_VeSMM_MotorCtrlModeLMCML_enum@ */ /end MEASUREMENT
/begin MEASUREMENT monr_VeSMM_MotorCtrlStateLMCML_enum "" UBYTE POD_MCML_CM_uint8 0 0 0 255 ECU_ADDRESS 0xb0055d42 /* @ECU_Address@monr_VeSMM_MotorCtrlStateLMCML_enum@ */ /end MEASUREMENT
/begin MEASUREMENT monr_VeSMM_StopEventLMCML_enum "" UBYTE POD_MCML_CM_uint8 0 0 0 255 ECU_ADDRESS 0xb0055d43 /* @ECU_Address@monr_VeSMM_StopEventLMCML_enum@ */ /end MEASUREMENT
/begin MEASUREMENT monr_VeSMM_DoorLatPosnLMCML_enum "" UBYTE POD_MCML_CM_uint8 0 0 0 255 ECU_ADDRESS 0xb0055d44 /* @ECU_Address@monr_VeSMM_DoorLatPosnLMCML_enum@ */ /end MEASUREMENT
/begin MEASUREMENT monr_VeSMM_PushLockLMCML_NULL "" UBYTE POD_MCML_CM_uint8 0 0 0 255 ECU_ADDRESS 0xb0055d45 /* @ECU_Address@monr_VeSMM_PushLockLMCML_NULL@ */ /end MEASUREMENT
/begin MEASUREMENT monr_VeSHM_DoorTypCfgMCML_enum "" UBYTE POD_MCML_CM_uint8 0 0 0 255 ECU_ADDRESS 0xb0055d85 /* @ECU_Address@monr_VeSHM_DoorTypCfgMCML_enum@ */ /end MEASUREMENT
/begin MEASUREMENT monr_VeMCM_CmdStateL_NULL "" UBYTE POD_MCML_CM_uint8 0 0 0 255 ECU_ADDRESS 0xb0055d98 /* @ECU_Address@monr_VeMCM_CmdStateL_NULL@ */ /end MEASUREMENT
/begin MEASUREMENT monr_VeMCM_MotorCtrlModeL_enum "" UBYTE POD_MCML_CM_uint8 0 0 0 255 ECU_ADDRESS 0xb0055d14 /* @ECU_Address@monr_VeMCM_MotorCtrlModeL_enum@ */ /end MEASUREMENT
/begin MEASUREMENT monr_VeSMM_HoverModCtrlLMCML_enum "" UBYTE POD_MCML_CM_uint8 0 0 0 255 ECU_ADDRESS 0xb0055d4c /* @ECU_Address@monr_VeSMM_HoverModCtrlLMCML_enum@ */ /end MEASUREMENT
/begin MEASUREMENT monr_VeHHM_DoorMovStsLMCML_NULL "" UBYTE POD_MCML_CM_uint8 0 0 0 255 ECU_ADDRESS 0xb0055d51 /* @ECU_Address@monr_VeHHM_DoorMovStsLMCML_NULL@ */ /end MEASUREMENT
/begin MEASUREMENT monr_VeHHM_SectorIndexLMCML_enum "" UBYTE POD_MCML_CM_uint8 0 0 0 255 ECU_ADDRESS 0xb0055d52 /* @ECU_Address@monr_VeHHM_SectorIndexLMCML_enum@ */ /end MEASUREMENT
/begin MEASUREMENT monr_VeSHM_CbnPressLvlMCML_enum "" UBYTE POD_MCML_CM_uint8 0 0 0 255 ECU_ADDRESS 0xb0055d70 /* @ECU_Address@monr_VeSHM_CbnPressLvlMCML_enum@ */ /end MEASUREMENT
/begin MEASUREMENT monr_VbMCM_MotorBrkgL_flg "" UBYTE POD_MCML_CM_boolean 0 0 0 1 ECU_ADDRESS 0xb0055d28 /* @ECU_Address@monr_VbMCM_MotorBrkgL_flg@ */ /end MEASUREMENT
/begin MEASUREMENT monr_VbMCM_ManualAssistL_flag "" UBYTE POD_MCML_CM_boolean 0 0 0 1 ECU_ADDRESS 0xb0055d29 /* @ECU_Address@monr_VbMCM_ManualAssistL_flag@ */ /end MEASUREMENT
/begin MEASUREMENT monr_VbMCM_TipToRunL_flag "" UBYTE POD_MCML_CM_boolean 0 0 0 1 ECU_ADDRESS 0xb0055d2a /* @ECU_Address@monr_VbMCM_TipToRunL_flag@ */ /end MEASUREMENT
/begin MEASUREMENT monr_VbFH_FrbdMaiMotWrkLMCML_flg "" UBYTE POD_MCML_CM_boolean 0 0 0 1 ECU_ADDRESS 0xb0055d3e /* @ECU_Address@monr_VbFH_FrbdMaiMotWrkLMCML_flg@ */ /end MEASUREMENT
/begin MEASUREMENT monr_VbFH_HallSigErrLMCML_flg "" UBYTE POD_MCML_CM_boolean 0 0 0 1 ECU_ADDRESS 0xb0055d3f /* @ECU_Address@monr_VbFH_HallSigErrLMCML_flg@ */ /end MEASUREMENT
/begin MEASUREMENT monr_VbHHM_DoorOpenLMCML_flg "" UBYTE POD_MCML_CM_boolean 0 0 0 1 ECU_ADDRESS 0xb0055d50 /* @ECU_Address@monr_VbHHM_DoorOpenLMCML_flg@ */ /end MEASUREMENT
/begin MEASUREMENT monr_VbSMM_HoldModeLMCML_flg "" UBYTE POD_MCML_CM_boolean 0 0 0 1 ECU_ADDRESS 0xb0055d86 /* @ECU_Address@monr_VbSMM_HoldModeLMCML_flg@ */ /end MEASUREMENT
/begin COMPU_METHOD POD_MCML_CM_single "Q = V" RAT_FUNC "%8.6" "" COEFFS 0 1 0 0 0 1 /end COMPU_METHOD
/begin COMPU_METHOD POD_MCML_CM_uint16 "Q = V" RAT_FUNC "%5.0" "" COEFFS 0 1 0 0 0 1 /end COMPU_METHOD
/begin COMPU_METHOD POD_MCML_CM_boolean "Q = V" RAT_FUNC "%1.0" "" COEFFS 0 1 0 0 0 1 /end COMPU_METHOD
/begin COMPU_METHOD POD_MCML_CM_uint8 "Q = V" RAT_FUNC "%3.0" "" COEFFS 0 1 0 0 0 1 /end COMPU_METHOD
/begin COMPU_METHOD POD_MCML_CM_int16 "Q = V" RAT_FUNC "%5.0" "" COEFFS 0 1 0 0 0 1 /end COMPU_METHOD
/begin GROUP POD_MCML "POD_MCML" ROOT /begin SUB_GROUP Root_POD_MotorCtrlModuleL_Step_sys /end SUB_GROUP /end GROUP
/begin GROUP Root_POD_MotorCtrlModuleL_Step_sys "POD_MCML/POD_MotorCtrlModuleL_Step_sys" /begin SUB_GROUP S2_POD_MotorCtrlModuleL /end SUB_GROUP
 /begin REF_MEASUREMENT monr_VbFH_FrbdMaiMotWrkLMCML_flg monr_VbFH_HallSigErrLMCML_flg monr_VbHHM_DoorOpenLMCML_flg monr_VbSMM_HoldModeLMCML_flg monr_VeHHM_DoorMovStsLMCML_NULL monr_VeHHM_SectorIndexLMCML_enum monr_VeSHM_CbnPressLvlMCML_enum monr_VeSHM_DoorTypCfgMCML_enum monr_VeSMM_DOPFcnStateLMCML_enum monr_VeSMM_DoorLatPosnLMCML_enum monr_VeSMM_HoverModCtrlLMCML_enum monr_VeSMM_MotorCtrlModeLMCML_enum monr_VeSMM_MotorCtrlStateLMCML_enum monr_VeSMM_PushLockLMCML_NULL monr_VeSMM_StopEventLMCML_enum monr_VfHHM_AswHallPositionLMCML_deg monr_VfSHM_AmbTempMCML_C monr_VfSHM_BatVoltageValueMCML_MV monr_VfSHM_FrntIncinAgLMCML_deg monr_VfSHM_MainMotoCurrentLMCML_MA monr_VfSHM_SideIncinAgLMCML_deg monr_VfSHM_VehSpdLgtMCML_mps monr_VfSMM_TopDegforDoorOpenLMCML_NULL monr_VsHHM_AswHallAccLMCML_g monr_VsHHM_AswHallPositionLMCML_NULL monr_VsHHM_AswHallSpeedLMCML_rpm /end REF_MEASUREMENT
/end GROUP
/begin GROUP S2_POD_MotorCtrlModuleL "POD_MCML/POD_MotorCtrlModuleL_Step_sys/POD_MotorCtrlModuleL"
 /begin SUB_GROUP S3_Signal_Override S3_Signal_Override1 S3_Signal_Override2 S3_Signal_Override3 /end SUB_GROUP
 /begin REF_MEASUREMENT monr_VbMCM_ManualAssistL_flag monr_VbMCM_MotorBrkgL_flg monr_VbMCM_TipToRunL_flag monr_VeMCM_CmdStateL_NULL monr_VfMCM_BrakingTorqueL_NULL monr_VfMCM_GravityTorqueL_Nm monr_VfMCM_RoadInclnL_deg monr_VfMCM_SideIncinAgL_deg monr_VfMCM_TarPosL_NULL monr_VfMCM_TarSpdL_NULL monr_VfMCM_ldlToAntipinchL_MA monr_VsMCM_TarCurrentL_NULL /end REF_MEASUREMENT
/end GROUP
/begin GROUP S3_Signal_Override "POD_MCML/POD_MotorCtrlModuleL_Step_sys/POD_MotorCtrlModuleL/Signal_Override" /begin SUB_GROUP S4_Switch /end SUB_GROUP /begin REF_CHARACTERISTIC k_MCM_MotorCtrlModeL_flg k_MCM_MotorCtrlModeL_value /end REF_CHARACTERISTIC /end GROUP
/begin GROUP S3_Signal_Override1 "POD_MCML/POD_MotorCtrlModuleL_Step_sys/POD_MotorCtrlModuleL/Signal_Override1" /begin SUB_GROUP S5_Switch /end SUB_GROUP /begin REF_CHARACTERISTIC k_MCM_MotorCtrlDutyL_flg k_MCM_MotorCtrlDutyL_value /end REF_CHARACTERISTIC /end GROUP
/begin GROUP S3_Signal_Override2 "POD_MCML/POD_MotorCtrlModuleL_Step_sys/POD_MotorCtrlModuleL/Signal_Override2" /begin SUB_GROUP S6_Switch /end SUB_GROUP /begin REF_CHARACTERISTIC k_MCM_MotorCtrlDuty1L_flg k_MCM_MotorCtrlDuty1L_value /end REF_CHARACTERISTIC /end GROUP
/begin GROUP S3_Signal_Override3 "POD_MCML/POD_MotorCtrlModuleL_Step_sys/POD_MotorCtrlModuleL/Signal_Override3" /begin SUB_GROUP S7_Switch /end SUB_GROUP /begin REF_CHARACTERISTIC k_MCM_MotorCtrlDuty2L_flg k_MCM_MotorCtrlDuty2L_value /end REF_CHARACTERISTIC /end GROUP
/begin GROUP S4_Switch "POD_MCML/POD_MotorCtrlModuleL_Step_sys/POD_MotorCtrlModuleL/Signal_Override/Switch" /begin REF_MEASUREMENT monr_VeMCM_MotorCtrlModeL_enum /end REF_MEASUREMENT /end GROUP
/begin GROUP S5_Switch "POD_MCML/POD_MotorCtrlModuleL_Step_sys/POD_MotorCtrlModuleL/Signal_Override1/Switch" /begin REF_MEASUREMENT monr_VfMCM_MotorCtrlDutyL_NULL /end REF_MEASUREMENT /end GROUP
/begin GROUP S6_Switch "POD_MCML/POD_MotorCtrlModuleL_Step_sys/POD_MotorCtrlModuleL/Signal_Override2/Switch" /begin REF_MEASUREMENT monr_VuMCM_MotorCtrlDuty1L_NULL /end REF_MEASUREMENT /end GROUP
/begin GROUP S7_Switch "POD_MCML/POD_MotorCtrlModuleL_Step_sys/POD_MotorCtrlModuleL/Signal_Override3/Switch" /begin REF_MEASUREMENT monr_VuMCM_MotorCtrlDuty2L_NULL /end REF_MEASUREMENT /end GROUP
/begin MEASUREMENT monr_VfSHM_MainMotoCurrentRMCMR_MA "" FLOAT32_IEEE POD_MCMR_CM_single 0 0 -3.4E+38 3.4E+38 ECU_ADDRESS 0xb0055dc8 /* @ECU_Address@monr_VfSHM_MainMotoCurrentRMCMR_MA@ */ /end MEASUREMENT
/begin MEASUREMENT monr_VfSHM_BatVoltageValueMCMR_MV "" FLOAT32_IEEE POD_MCMR_CM_single 0 0 -3.4E+38 3.4E+38 ECU_ADDRESS 0xb0055dd4 /* @ECU_Address@monr_VfSHM_BatVoltageValueMCMR_MV@ */ /end MEASUREMENT
/begin MEASUREMENT monr_VfSMM_TopDegforDoorOpenRMCMR_NULL "" FLOAT32_IEEE POD_MCMR_CM_single 0 0 -3.4E+38 3.4E+38 ECU_ADDRESS 0xb0055de4 /* @ECU_Address@monr_VfSMM_TopDegforDoorOpenRMCMR_NULL@ */ /end MEASUREMENT
/begin MEASUREMENT monr_VfHHM_AswHallPositionRMCMR_deg "" FLOAT32_IEEE POD_MCMR_CM_single 0 0 -3.4E+38 3.4E+38 ECU_ADDRESS 0xb0055dec /* @ECU_Address@monr_VfHHM_AswHallPositionRMCMR_deg@ */ /end MEASUREMENT
/begin MEASUREMENT monr_VfSHM_AmbTempMCMR_C "" FLOAT32_IEEE POD_MCMR_CM_single 0 0 -3.4E+38 3.4E+38 ECU_ADDRESS 0xb0055dfc /* @ECU_Address@monr_VfSHM_AmbTempMCMR_C@ */ /end MEASUREMENT
/begin MEASUREMENT monr_VfSHM_FrntIncinAgRMCMR_deg "" FLOAT32_IEEE POD_MCMR_CM_single 0 0 -3.4E+38 3.4E+38 ECU_ADDRESS 0xb0055e14 /* @ECU_Address@monr_VfSHM_FrntIncinAgRMCMR_deg@ */ /end MEASUREMENT
/begin MEASUREMENT monr_VfSHM_SideIncinAgRMCMR_deg "" FLOAT32_IEEE POD_MCMR_CM_single 0 0 -3.4E+38 3.4E+38 ECU_ADDRESS 0xb0055e0c /* @ECU_Address@monr_VfSHM_SideIncinAgRMCMR_deg@ */ /end MEASUREMENT
/begin MEASUREMENT monr_VfMCM_MotorCtrlDutyR_NULL "" FLOAT32_IEEE POD_MCMR_CM_single 0 0 -3.4E+38 3.4E+38 ECU_ADDRESS 0xb0055da4 /* @ECU_Address@monr_VfMCM_MotorCtrlDutyR_NULL@ */ /end MEASUREMENT
/begin MEASUREMENT monr_VfMCM_ldlToAntipinchR_MA "" FLOAT32_IEEE POD_MCMR_CM_single 0 0 -3.4E+38 3.4E+38 ECU_ADDRESS 0xb0055e00 /* @ECU_Address@monr_VfMCM_ldlToAntipinchR_MA@ */ /end MEASUREMENT
/begin MEASUREMENT monr_VfMCM_BrakingTorqueR_NULL "" FLOAT32_IEEE POD_MCMR_CM_single 0 0 -3.4E+38 3.4E+38 ECU_ADDRESS 0xb0055e1c /* @ECU_Address@monr_VfMCM_BrakingTorqueR_NULL@ */ /end MEASUREMENT
/begin MEASUREMENT monr_VfMCM_TarSpdR_NULL "" FLOAT32_IEEE POD_MCMR_CM_single 0 0 -3.4E+38 3.4E+38 ECU_ADDRESS 0xb0055db0 /* @ECU_Address@monr_VfMCM_TarSpdR_NULL@ */ /end MEASUREMENT
/begin MEASUREMENT monr_VfMCM_TarPosR_NULL "" FLOAT32_IEEE POD_MCMR_CM_single 0 0 -3.4E+38 3.4E+38 ECU_ADDRESS 0xb0055e28 /* @ECU_Address@monr_VfMCM_TarPosR_NULL@ */ /end MEASUREMENT
/begin MEASUREMENT monr_VfMCM_GravityTorqueR_Nm "" FLOAT32_IEEE POD_MCMR_CM_single 0 0 -3.4E+38 3.4E+38 ECU_ADDRESS 0xb0055da8 /* @ECU_Address@monr_VfMCM_GravityTorqueR_Nm@ */ /end MEASUREMENT
/begin MEASUREMENT monr_VfMCM_SideIncinAgR_deg "" FLOAT32_IEEE POD_MCMR_CM_single 0 0 -3.4E+38 3.4E+38 ECU_ADDRESS 0xb0055db8 /* @ECU_Address@monr_VfMCM_SideIncinAgR_deg@ */ /end MEASUREMENT
/begin MEASUREMENT monr_VfMCM_RoadInclnR_deg "" FLOAT32_IEEE POD_MCMR_CM_single 0 0 -3.4E+38 3.4E+38 ECU_ADDRESS 0xb0055dc0 /* @ECU_Address@monr_VfMCM_RoadInclnR_deg@ */ /end MEASUREMENT
/begin MEASUREMENT monr_VfSHM_VehSpdLgtMCMR_mps "" FLOAT32_IEEE POD_MCMR_CM_single 0 0 -3.4E+38 3.4E+38 ECU_ADDRESS 0xb0055e08 /* @ECU_Address@monr_VfSHM_VehSpdLgtMCMR_mps@ */ /end MEASUREMENT
/begin MEASUREMENT monr_VuMCM_MotorCtrlDuty1R_NULL "" UWORD POD_MCMR_CM_uint16 0 0 0 65535 ECU_ADDRESS 0xb0055dce /* @ECU_Address@monr_VuMCM_MotorCtrlDuty1R_NULL@ */ /end MEASUREMENT
/begin MEASUREMENT monr_VuMCM_MotorCtrlDuty2R_NULL "" UWORD POD_MCMR_CM_uint16 0 0 0 65535 ECU_ADDRESS 0xb0055de0 /* @ECU_Address@monr_VuMCM_MotorCtrlDuty2R_NULL@ */ /end MEASUREMENT
/begin MEASUREMENT monr_VsHHM_AswHallPositionRMCMR_NULL "" SWORD POD_MCMR_CM_int16 0 0 -32768 32767 ECU_ADDRESS 0xb0055dea /* @ECU_Address@monr_VsHHM_AswHallPositionRMCMR_NULL@ */ /end MEASUREMENT
/begin MEASUREMENT monr_VsHHM_AswHallSpeedRMCMR_rpm "" SWORD POD_MCMR_CM_int16 0 0 -32768 32767 ECU_ADDRESS 0xb0055dfa /* @ECU_Address@monr_VsHHM_AswHallSpeedRMCMR_rpm@ */ /end MEASUREMENT
/begin MEASUREMENT monr_VsMCM_TarCurrentR_NULL "" SWORD POD_MCMR_CM_int16 0 0 -32768 32767 ECU_ADDRESS 0xb0055e2c /* @ECU_Address@monr_VsMCM_TarCurrentR_NULL@ */ /end MEASUREMENT
/begin MEASUREMENT monr_VsHHM_AswHallAccRMCMR_g "" SWORD POD_MCMR_CM_int16 0 0 -32768 32767 ECU_ADDRESS 0xb0055df0 /* @ECU_Address@monr_VsHHM_AswHallAccRMCMR_g@ */ /end MEASUREMENT
/begin MEASUREMENT monr_VeSMM_DOPFcnStateRMCMR_enum "" UBYTE POD_MCMR_CM_uint8 0 0 0 255 ECU_ADDRESS 0xb0055dd0 /* @ECU_Address@monr_VeSMM_DOPFcnStateRMCMR_enum@ */ /end MEASUREMENT
/begin MEASUREMENT monr_VeSMM_MotorCtrlModeRMCMR_enum "" UBYTE POD_MCMR_CM_uint8 0 0 0 255 ECU_ADDRESS 0xb0055dd9 /* @ECU_Address@monr_VeSMM_MotorCtrlModeRMCMR_enum@ */ /end MEASUREMENT
/begin MEASUREMENT monr_VeSMM_MotorCtrlStateRMCMR_enum "" UBYTE POD_MCMR_CM_uint8 0 0 0 255 ECU_ADDRESS 0xb0055dda /* @ECU_Address@monr_VeSMM_MotorCtrlStateRMCMR_enum@ */ /end MEASUREMENT
/begin MEASUREMENT monr_VeSMM_StopEventRMCMR_enum "" UBYTE POD_MCMR_CM_uint8 0 0 0 255 ECU_ADDRESS 0xb0055ddb /* @ECU_Address@monr_VeSMM_StopEventRMCMR_enum@ */ /end MEASUREMENT
/begin MEASUREMENT monr_VeSMM_DoorLatPosnRMCMR_enum "" UBYTE POD_MCMR_CM_uint8 0 0 0 255 ECU_ADDRESS 0xb0055ddc /* @ECU_Address@monr_VeSMM_DoorLatPosnRMCMR_enum@ */ /end MEASUREMENT
/begin MEASUREMENT monr_VeSMM_PushLockRMCMR_NULL "" UBYTE POD_MCMR_CM_uint8 0 0 0 255 ECU_ADDRESS 0xb0055ddf /* @ECU_Address@monr_VeSMM_PushLockRMCMR_NULL@ */ /end MEASUREMENT
/begin MEASUREMENT monr_VeSHM_DoorTypCfgMCMR_enum "" UBYTE POD_MCMR_CM_uint8 0 0 0 255 ECU_ADDRESS 0xb0055e18 /* @ECU_Address@monr_VeSHM_DoorTypCfgMCMR_enum@ */ /end MEASUREMENT
/begin MEASUREMENT monr_VeMCM_MotorCtrlModeR_enum "" UBYTE POD_MCMR_CM_uint8 0 0 0 255 ECU_ADDRESS 0xb0055e12 /* @ECU_Address@monr_VeMCM_MotorCtrlModeR_enum@ */ /end MEASUREMENT
/begin MEASUREMENT monr_VeMCM_CmdStateR_NULL "" UBYTE POD_MCMR_CM_uint8 0 0 0 255 ECU_ADDRESS 0xb0055e23 /* @ECU_Address@monr_VeMCM_CmdStateR_NULL@ */ /end MEASUREMENT
/begin MEASUREMENT monr_VeSMM_HoverModCtrlRMCMR_enum "" UBYTE POD_MCMR_CM_uint8 0 0 0 255 ECU_ADDRESS 0xb0055ddd /* @ECU_Address@monr_VeSMM_HoverModCtrlRMCMR_enum@ */ /end MEASUREMENT
/begin MEASUREMENT monr_VeHHM_DoorMovStsRMCMR_NULL "" UBYTE POD_MCMR_CM_uint8 0 0 0 255 ECU_ADDRESS 0xb0055de8 /* @ECU_Address@monr_VeHHM_DoorMovStsRMCMR_NULL@ */ /end MEASUREMENT
/begin MEASUREMENT monr_VeHHM_SectorIndexRMCMR_enum "" UBYTE POD_MCMR_CM_uint8 0 0 0 255 ECU_ADDRESS 0xb0055de9 /* @ECU_Address@monr_VeHHM_SectorIndexRMCMR_enum@ */ /end MEASUREMENT
/begin MEASUREMENT monr_VeSHM_CbnPressLvlMCMR_enum "" UBYTE POD_MCMR_CM_uint8 0 0 0 255 ECU_ADDRESS 0xb0055e04 /* @ECU_Address@monr_VeSHM_CbnPressLvlMCMR_enum@ */ /end MEASUREMENT
/begin MEASUREMENT monr_VbMCM_MotorBrkgR_flg "" UBYTE POD_MCMR_CM_boolean 0 0 0 1 ECU_ADDRESS 0xb0055dbc /* @ECU_Address@monr_VbMCM_MotorBrkgR_flg@ */ /end MEASUREMENT
/begin MEASUREMENT monr_VbMCM_ManualAssistR_flag "" UBYTE POD_MCMR_CM_boolean 0 0 0 1 ECU_ADDRESS 0xb0055dac /* @ECU_Address@monr_VbMCM_ManualAssistR_flag@ */ /end MEASUREMENT
/begin MEASUREMENT monr_VbMCM_TipToRunR_flag "" UBYTE POD_MCMR_CM_boolean 0 0 0 1 ECU_ADDRESS 0xb0055db4 /* @ECU_Address@monr_VbMCM_TipToRunR_flag@ */ /end MEASUREMENT
/begin MEASUREMENT monr_VbFH_HallSigErrLMCMR_flg "" UBYTE POD_MCMR_CM_boolean 0 0 0 1 ECU_ADDRESS 0xb0055dcc /* @ECU_Address@monr_VbFH_HallSigErrLMCMR_flg@ */ /end MEASUREMENT
/begin MEASUREMENT monr_VbFH_FrbdMaiMotWrkLMCMR_flg "" UBYTE POD_MCMR_CM_boolean 0 0 0 1 ECU_ADDRESS 0xb0055dd8 /* @ECU_Address@monr_VbFH_FrbdMaiMotWrkLMCMR_flg@ */ /end MEASUREMENT
/begin MEASUREMENT monr_VbHHM_DoorOpenLMCMR_flg "" UBYTE POD_MCMR_CM_boolean 0 0 0 1 ECU_ADDRESS 0xb0055dde /* @ECU_Address@monr_VbHHM_DoorOpenLMCMR_flg@ */ /end MEASUREMENT
/begin MEASUREMENT monr_VbSMM_HoldModeRMCMR_flg "" UBYTE POD_MCMR_CM_boolean 0 0 0 1 ECU_ADDRESS 0xb0055e19 /* @ECU_Address@monr_VbSMM_HoldModeRMCMR_flg@ */ /end MEASUREMENT
/begin COMPU_METHOD POD_MCMR_CM_single "Q = V" RAT_FUNC "%8.6" "" COEFFS 0 1 0 0 0 1 /end COMPU_METHOD
/begin COMPU_METHOD POD_MCMR_CM_uint16 "Q = V" RAT_FUNC "%5.0" "" COEFFS 0 1 0 0 0 1 /end COMPU_METHOD
/begin COMPU_METHOD POD_MCMR_CM_int16 "Q = V" RAT_FUNC "%5.0" "" COEFFS 0 1 0 0 0 1 /end COMPU_METHOD
/begin COMPU_METHOD POD_MCMR_CM_uint8 "Q = V" RAT_FUNC "%3.0" "" COEFFS 0 1 0 0 0 1 /end COMPU_METHOD
/begin COMPU_METHOD POD_MCMR_CM_boolean "Q = V" RAT_FUNC "%1.0" "" COEFFS 0 1 0 0 0 1 /end COMPU_METHOD
/begin GROUP POD_MCMR "POD_MCMR" ROOT /begin SUB_GROUP Root_POD_MotorCtrlModuleR_Step_sys /end SUB_GROUP /end GROUP
/begin GROUP Root_POD_MotorCtrlModuleR_Step_sys "POD_MCMR/POD_MotorCtrlModuleR_Step_sys" /begin SUB_GROUP S2_POD_MotorCtrlModuleR /end SUB_GROUP
 /begin REF_MEASUREMENT monr_VbFH_FrbdMaiMotWrkLMCMR_flg monr_VbFH_HallSigErrLMCMR_flg monr_VbHHM_DoorOpenLMCMR_flg monr_VbSMM_HoldModeRMCMR_flg monr_VeHHM_DoorMovStsRMCMR_NULL monr_VeHHM_SectorIndexRMCMR_enum monr_VeSHM_CbnPressLvlMCMR_enum monr_VeSHM_DoorTypCfgMCMR_enum monr_VeSMM_DOPFcnStateRMCMR_enum monr_VeSMM_DoorLatPosnRMCMR_enum monr_VeSMM_HoverModCtrlRMCMR_enum monr_VeSMM_MotorCtrlModeRMCMR_enum monr_VeSMM_MotorCtrlStateRMCMR_enum monr_VeSMM_PushLockRMCMR_NULL monr_VeSMM_StopEventRMCMR_enum monr_VfHHM_AswHallPositionRMCMR_deg monr_VfSHM_AmbTempMCMR_C monr_VfSHM_BatVoltageValueMCMR_MV monr_VfSHM_FrntIncinAgRMCMR_deg monr_VfSHM_MainMotoCurrentRMCMR_MA monr_VfSHM_SideIncinAgRMCMR_deg monr_VfSHM_VehSpdLgtMCMR_mps monr_VfSMM_TopDegforDoorOpenRMCMR_NULL monr_VsHHM_AswHallAccRMCMR_g monr_VsHHM_AswHallPositionRMCMR_NULL monr_VsHHM_AswHallSpeedRMCMR_rpm /end REF_MEASUREMENT
/end GROUP
/begin GROUP S2_POD_MotorCtrlModuleR "POD_MCMR/POD_MotorCtrlModuleR_Step_sys/POD_MotorCtrlModuleR"
 /begin REF_MEASUREMENT monr_VbMCM_ManualAssistR_flag monr_VbMCM_MotorBrkgR_flg monr_VbMCM_TipToRunR_flag monr_VeMCM_CmdStateR_NULL monr_VeMCM_MotorCtrlModeR_enum monr_VfMCM_BrakingTorqueR_NULL monr_VfMCM_GravityTorqueR_Nm monr_VfMCM_MotorCtrlDutyR_NULL monr_VfMCM_RoadInclnR_deg monr_VfMCM_SideIncinAgR_deg monr_VfMCM_TarPosR_NULL monr_VfMCM_TarSpdR_NULL monr_VfMCM_ldlToAntipinchR_MA monr_VsMCM_TarCurrentR_NULL monr_VuMCM_MotorCtrlDuty1R_NULL monr_VuMCM_MotorCtrlDuty2R_NULL /end REF_MEASUREMENT
/end GROUP
/begin CHARACTERISTIC k_ADCH_Fac_FilterForAmbTemp "" VALUE 0xb000648c /* @ECU_Address@k_ADCH_Fac_FilterForAmbTemp@ */ Scalar_FLOAT32_IEEE 0 POD_SignalHandModule_T_CM_single -3.4E+38 3.4E+38 /end CHARACTERISTIC
/begin CHARACTERISTIC k_ADCH_Fac_FilterForMaiMotCurr "" VALUE 0xb0006490 /* @ECU_Address@k_ADCH_Fac_FilterForMaiMotCurr@ */ Scalar_FLOAT32_IEEE 0 POD_SignalHandModule_T_CM_single -3.4E+38 3.4E+38 /end CHARACTERISTIC
/begin CHARACTERISTIC k_ADCH_Fac_FilterForUBRVolt "" VALUE 0xb0006498 /* @ECU_Address@k_ADCH_Fac_FilterForUBRVolt@ */ Scalar_FLOAT32_IEEE 0 POD_SignalHandModule_T_CM_single -3.4E+38 3.4E+38 /end CHARACTERISTIC
/begin MEASUREMENT monr_VfINP_VehSpdSHM_kph "" FLOAT32_IEEE POD_SignalHandModule_T_CM_single 0 0 -3.4E+38 3.4E+38 ECU_ADDRESS 0xb0055f50 /* @ECU_Address@monr_VfINP_VehSpdSHM_kph@ */ /end MEASUREMENT
/begin MEASUREMENT monr_VfINP_ExterTempSHM_C "" FLOAT32_IEEE POD_SignalHandModule_T_CM_single 0 0 -3.4E+38 3.4E+38 ECU_ADDRESS 0xb0055f38 /* @ECU_Address@monr_VfINP_ExterTempSHM_C@ */ /end MEASUREMENT
/begin MEASUREMENT monr_VfSHM_AmbTemp_C "" FLOAT32_IEEE POD_SignalHandModule_T_CM_single 0 0 -3.4E+38 3.4E+38 ECU_ADDRESS 0xb0055f6c /* @ECU_Address@monr_VfSHM_AmbTemp_C@ */ /end MEASUREMENT
/begin MEASUREMENT monr_VfINP_UBRVoltSHM_V "" FLOAT32_IEEE POD_SignalHandModule_T_CM_single 0 0 -3.4E+38 3.4E+38 ECU_ADDRESS 0xb0055f4c /* @ECU_Address@monr_VfINP_UBRVoltSHM_V@ */ /end MEASUREMENT
/begin MEASUREMENT monr_VfSHM_VehSpdLgt_mps "" FLOAT32_IEEE POD_SignalHandModule_T_CM_single 0 0 -3.4E+38 3.4E+38 ECU_ADDRESS 0xb0055fb8 /* @ECU_Address@monr_VfSHM_VehSpdLgt_mps@ */ /end MEASUREMENT
/begin MEASUREMENT monr_VfSHM_VehLVBatt_V "" FLOAT32_IEEE POD_SignalHandModule_T_CM_single 0 0 -3.4E+38 3.4E+38 ECU_ADDRESS 0xb0055fb4 /* @ECU_Address@monr_VfSHM_VehLVBatt_V@ */ /end MEASUREMENT
/begin MEASUREMENT monr_VfSHM_BatVoltageValue_MV "" FLOAT32_IEEE POD_SignalHandModule_T_CM_single 0 0 -3.4E+38 3.4E+38 ECU_ADDRESS 0xb0055f70 /* @ECU_Address@monr_VfSHM_BatVoltageValue_MV@ */ /end MEASUREMENT
/begin MEASUREMENT monr_VfINP_MaiMotCurrLSHM_A "" FLOAT32_IEEE POD_SignalHandModule_T_CM_single 0 0 -3.4E+38 3.4E+38 ECU_ADDRESS 0xb0055f44 /* @ECU_Address@monr_VfINP_MaiMotCurrLSHM_A@ */ /end MEASUREMENT
/begin MEASUREMENT monr_VfSHM_MainMotoCurrentL_MA "" FLOAT32_IEEE POD_SignalHandModule_T_CM_single 0 0 -3.4E+38 3.4E+38 ECU_ADDRESS 0xb0055f94 /* @ECU_Address@monr_VfSHM_MainMotoCurrentL_MA@ */ /end MEASUREMENT
/begin MEASUREMENT monr_VfINP_MaiMotCurrRSHM_A "" FLOAT32_IEEE POD_SignalHandModule_T_CM_single 0 0 -3.4E+38 3.4E+38 ECU_ADDRESS 0xb0055f48 /* @ECU_Address@monr_VfINP_MaiMotCurrRSHM_A@ */ /end MEASUREMENT
/begin MEASUREMENT monr_VfSHM_MainMotoCurrentR_MA "" FLOAT32_IEEE POD_SignalHandModule_T_CM_single 0 0 -3.4E+38 3.4E+38 ECU_ADDRESS 0xb0055f98 /* @ECU_Address@monr_VfSHM_MainMotoCurrentR_MA@ */ /end MEASUREMENT
/begin MEASUREMENT monr_VfINP_FLGYROAgSpdSHM_degps "" FLOAT32_IEEE POD_SignalHandModule_T_CM_single 0 0 -3.4E+38 3.4E+38 ECU_ADDRESS 0xb0055f3c /* @ECU_Address@monr_VfINP_FLGYROAgSpdSHM_degps@ */ /end MEASUREMENT
/begin MEASUREMENT monr_VfSHM_FLGYROAgSpd_degps "" FLOAT32_IEEE POD_SignalHandModule_T_CM_single 0 0 -3.4E+38 3.4E+38 ECU_ADDRESS 0xb0055f84 /* @ECU_Address@monr_VfSHM_FLGYROAgSpd_degps@ */ /end MEASUREMENT
/begin MEASUREMENT monr_VfINP_FRGYROAgSpdSHM_degps "" FLOAT32_IEEE POD_SignalHandModule_T_CM_single 0 0 -3.4E+38 3.4E+38 ECU_ADDRESS 0xb0055f40 /* @ECU_Address@monr_VfINP_FRGYROAgSpdSHM_degps@ */ /end MEASUREMENT
/begin MEASUREMENT monr_VfSHM_FRGYROAgSpd_degps "" FLOAT32_IEEE POD_SignalHandModule_T_CM_single 0 0 -3.4E+38 3.4E+38 ECU_ADDRESS 0xb0055f88 /* @ECU_Address@monr_VfSHM_FRGYROAgSpd_degps@ */ /end MEASUREMENT
/begin MEASUREMENT monr_VfINP_XLPitchAgSHM_deg "" FLOAT32_IEEE POD_SignalHandModule_T_CM_single 0 0 -3.4E+38 3.4E+38 ECU_ADDRESS 0xb0055f58 /* @ECU_Address@monr_VfINP_XLPitchAgSHM_deg@ */ /end MEASUREMENT
/begin MEASUREMENT monr_VfSHM_FrntIncinAgL_deg "" FLOAT32_IEEE POD_SignalHandModule_T_CM_single 0 0 -3.4E+38 3.4E+38 ECU_ADDRESS 0xb0055f8c /* @ECU_Address@monr_VfSHM_FrntIncinAgL_deg@ */ /end MEASUREMENT
/begin MEASUREMENT monr_VfINP_XRPitchAgSHM_deg "" FLOAT32_IEEE POD_SignalHandModule_T_CM_single 0 0 -3.4E+38 3.4E+38 ECU_ADDRESS 0xb0055f64 /* @ECU_Address@monr_VfINP_XRPitchAgSHM_deg@ */ /end MEASUREMENT
/begin MEASUREMENT monr_VfSHM_FrntIncinAgR_deg "" FLOAT32_IEEE POD_SignalHandModule_T_CM_single 0 0 -3.4E+38 3.4E+38 ECU_ADDRESS 0xb0055f90 /* @ECU_Address@monr_VfSHM_FrntIncinAgR_deg@ */ /end MEASUREMENT
/begin MEASUREMENT monr_VfINP_XLRollAgSHM_deg "" FLOAT32_IEEE POD_SignalHandModule_T_CM_single 0 0 -3.4E+38 3.4E+38 ECU_ADDRESS 0xb0055f5c /* @ECU_Address@monr_VfINP_XLRollAgSHM_deg@ */ /end MEASUREMENT
/begin MEASUREMENT monr_VfSHM_SideIncinAgL_deg "" FLOAT32_IEEE POD_SignalHandModule_T_CM_single 0 0 -3.4E+38 3.4E+38 ECU_ADDRESS 0xb0055fac /* @ECU_Address@monr_VfSHM_SideIncinAgL_deg@ */ /end MEASUREMENT
/begin MEASUREMENT monr_VfINP_XRRollAgSHM_deg "" FLOAT32_IEEE POD_SignalHandModule_T_CM_single 0 0 -3.4E+38 3.4E+38 ECU_ADDRESS 0xb0055f68 /* @ECU_Address@monr_VfINP_XRRollAgSHM_deg@ */ /end MEASUREMENT
/begin MEASUREMENT monr_VfSHM_SideIncinAgR_deg "" FLOAT32_IEEE POD_SignalHandModule_T_CM_single 0 0 -3.4E+38 3.4E+38 ECU_ADDRESS 0xb0055fb0 /* @ECU_Address@monr_VfSHM_SideIncinAgR_deg@ */ /end MEASUREMENT
/begin MEASUREMENT monr_VfHHM_AswHallPositionLSHM_deg "" FLOAT32_IEEE POD_SignalHandModule_T_CM_single 0 0 -3.4E+38 3.4E+38 ECU_ADDRESS 0xb0055f20 /* @ECU_Address@monr_VfHHM_AswHallPositionLSHM_deg@ */ /end MEASUREMENT
/begin MEASUREMENT monr_VfHHM_AswHallPositionRSHM_deg "" FLOAT32_IEEE POD_SignalHandModule_T_CM_single 0 0 -3.4E+38 3.4E+38 ECU_ADDRESS 0xb0055f24 /* @ECU_Address@monr_VfHHM_AswHallPositionRSHM_deg@ */ /end MEASUREMENT
/begin MEASUREMENT monr_VfINP_DoorRLOpenAgSHM_deg "" FLOAT32_IEEE POD_SignalHandModule_T_CM_single 0 0 -3.4E+38 3.4E+38 ECU_ADDRESS 0xb0055f30 /* @ECU_Address@monr_VfINP_DoorRLOpenAgSHM_deg@ */ /end MEASUREMENT
/begin MEASUREMENT monr_VfINP_DoorRROpenAgSHM_deg "" FLOAT32_IEEE POD_SignalHandModule_T_CM_single 0 0 -3.4E+38 3.4E+38 ECU_ADDRESS 0xb0055f34 /* @ECU_Address@monr_VfINP_DoorRROpenAgSHM_deg@ */ /end MEASUREMENT
/begin MEASUREMENT monr_VuMCM_MotorCtrlDuty2RSHM_NULL "" UWORD POD_SignalHandModule_T_CM_uint16 0 0 0 65535 ECU_ADDRESS 0xb0055fce /* @ECU_Address@monr_VuMCM_MotorCtrlDuty2RSHM_NULL@ */ /end MEASUREMENT
/begin MEASUREMENT monr_VuMCM_MotorCtrlDuty1LSHM_NULL "" UWORD POD_SignalHandModule_T_CM_uint16 0 0 0 65535 ECU_ADDRESS 0xb0055fc8 /* @ECU_Address@monr_VuMCM_MotorCtrlDuty1LSHM_NULL@ */ /end MEASUREMENT
/begin MEASUREMENT monr_VuMCM_MotorCtrlDuty2LSHM_NULL "" UWORD POD_SignalHandModule_T_CM_uint16 0 0 0 65535 ECU_ADDRESS 0xb0055fcc /* @ECU_Address@monr_VuMCM_MotorCtrlDuty2LSHM_NULL@ */ /end MEASUREMENT
/begin MEASUREMENT monr_VuMCM_MotorCtrlDuty1RSHM_NULL "" UWORD POD_SignalHandModule_T_CM_uint16 0 0 0 65535 ECU_ADDRESS 0xb0055fca /* @ECU_Address@monr_VuMCM_MotorCtrlDuty1RSHM_NULL@ */ /end MEASUREMENT
/begin MEASUREMENT monr_VeINP_ExterTempVDSHM_enum "" UBYTE POD_SignalHandModule_T_CM_uint8 0 0 0 255 ECU_ADDRESS 0xb0055ea3 /* @ECU_Address@monr_VeINP_ExterTempVDSHM_enum@ */ /end MEASUREMENT
/begin MEASUREMENT monr_VeINP_XLDoorLockStSHM_enum "" UBYTE POD_SignalHandModule_T_CM_uint8 0 0 0 255 ECU_ADDRESS 0xb0055ebb /* @ECU_Address@monr_VeINP_XLDoorLockStSHM_enum@ */ /end MEASUREMENT
/begin MEASUREMENT monr_VeINP_XRDoorLockStSHM_enum "" UBYTE POD_SignalHandModule_T_CM_uint8 0 0 0 255 ECU_ADDRESS 0xb0055ec6 /* @ECU_Address@monr_VeINP_XRDoorLockStSHM_enum@ */ /end MEASUREMENT
/begin MEASUREMENT monr_VeINP_DOWLXWarningSHM_enum "" UBYTE POD_SignalHandModule_T_CM_uint8 0 0 0 255 ECU_ADDRESS 0xb0055e9d /* @ECU_Address@monr_VeINP_DOWLXWarningSHM_enum@ */ /end MEASUREMENT
/begin MEASUREMENT monr_VeSHM_DoorOpenArlmL_enum "" UBYTE POD_SignalHandModule_T_CM_uint8 0 0 0 255 ECU_ADDRESS 0xb0055edb /* @ECU_Address@monr_VeSHM_DoorOpenArlmL_enum@ */ /end MEASUREMENT
/begin MEASUREMENT monr_VeINP_DOWRXWarningSHM_enum "" UBYTE POD_SignalHandModule_T_CM_uint8 0 0 0 255 ECU_ADDRESS 0xb0055e9e /* @ECU_Address@monr_VeINP_DOWRXWarningSHM_enum@ */ /end MEASUREMENT
/begin MEASUREMENT monr_VeSHM_DoorOpenArlmR_enum "" UBYTE POD_SignalHandModule_T_CM_uint8 0 0 0 255 ECU_ADDRESS 0xb0055edc /* @ECU_Address@monr_VeSHM_DoorOpenArlmR_enum@ */ /end MEASUREMENT
/begin MEASUREMENT monr_VeINP_VehSpdVDSHM_enum "" UBYTE POD_SignalHandModule_T_CM_uint8 0 0 0 255 ECU_ADDRESS 0xb0055eb8 /* @ECU_Address@monr_VeINP_VehSpdVDSHM_enum@ */ /end MEASUREMENT
/begin MEASUREMENT monr_VeSHM_VehSpdLgtQly_enum "" UBYTE POD_SignalHandModule_T_CM_uint8 0 0 0 255 ECU_ADDRESS 0xb0055f0b /* @ECU_Address@monr_VeSHM_VehSpdLgtQly_enum@ */ /end MEASUREMENT
/begin MEASUREMENT monr_VeINP_DoorOpenerXLReqSHM_enum "" UBYTE POD_SignalHandModule_T_CM_uint8 0 0 0 255 ECU_ADDRESS 0xb0055e9a /* @ECU_Address@monr_VeINP_DoorOpenerXLReqSHM_enum@ */ /end MEASUREMENT
/begin MEASUREMENT monr_VeSHM_DoorWrkReqL_enum "" UBYTE POD_SignalHandModule_T_CM_uint8 0 0 0 255 ECU_ADDRESS 0xb0055ee2 /* @ECU_Address@monr_VeSHM_DoorWrkReqL_enum@ */ /end MEASUREMENT
/begin MEASUREMENT monr_VeINP_DoorOpenerXRReqSHM_enum "" UBYTE POD_SignalHandModule_T_CM_uint8 0 0 0 255 ECU_ADDRESS 0xb0055e9b /* @ECU_Address@monr_VeINP_DoorOpenerXRReqSHM_enum@ */ /end MEASUREMENT
/begin MEASUREMENT monr_VeSHM_DoorWrkReqR_enum "" UBYTE POD_SignalHandModule_T_CM_uint8 0 0 0 255 ECU_ADDRESS 0xb0055ee3 /* @ECU_Address@monr_VeSHM_DoorWrkReqR_enum@ */ /end MEASUREMENT
/begin MEASUREMENT monr_VeINP_XLReqSHM_enum "" UBYTE POD_SignalHandModule_T_CM_uint8 0 0 0 255 ECU_ADDRESS 0xb0055ec4 /* @ECU_Address@monr_VeINP_XLReqSHM_enum@ */ /end MEASUREMENT
/begin MEASUREMENT monr_VeSHM_XLReq_enum "" UBYTE POD_SignalHandModule_T_CM_uint8 0 0 0 255 ECU_ADDRESS 0xb0055f14 /* @ECU_Address@monr_VeSHM_XLReq_enum@ */ /end MEASUREMENT
/begin MEASUREMENT monr_VeINP_XRReqSHM_enum "" UBYTE POD_SignalHandModule_T_CM_uint8 0 0 0 255 ECU_ADDRESS 0xb0055ecf /* @ECU_Address@monr_VeINP_XRReqSHM_enum@ */ /end MEASUREMENT
/begin MEASUREMENT monr_VeSHM_XRReq_enum "" UBYTE POD_SignalHandModule_T_CM_uint8 0 0 0 255 ECU_ADDRESS 0xb0055f19 /* @ECU_Address@monr_VeSHM_XRReq_enum@ */ /end MEASUREMENT
/begin MEASUREMENT monr_VeINP_XLPitchAgVDSHM_enum "" UBYTE POD_SignalHandModule_T_CM_uint8 0 0 0 255 ECU_ADDRESS 0xb0055ec3 /* @ECU_Address@monr_VeINP_XLPitchAgVDSHM_enum@ */ /end MEASUREMENT
/begin MEASUREMENT monr_VeINP_XRPitchAgVDSHM_enum "" UBYTE POD_SignalHandModule_T_CM_uint8 0 0 0 255 ECU_ADDRESS 0xb0055ece /* @ECU_Address@monr_VeINP_XRPitchAgVDSHM_enum@ */ /end MEASUREMENT
/begin MEASUREMENT monr_VeSHM_FrntIncinAgQlyL_enum "" UBYTE POD_SignalHandModule_T_CM_uint8 0 0 0 255 ECU_ADDRESS 0xb0055ef3 /* @ECU_Address@monr_VeSHM_FrntIncinAgQlyL_enum@ */ /end MEASUREMENT
/begin MEASUREMENT monr_VeSHM_FrntIncinAgQlyR_enum "" UBYTE POD_SignalHandModule_T_CM_uint8 0 0 0 255 ECU_ADDRESS 0xb0055ef4 /* @ECU_Address@monr_VeSHM_FrntIncinAgQlyR_enum@ */ /end MEASUREMENT
/begin MEASUREMENT monr_VeINP_XLRollAgVDSHM_enum "" UBYTE POD_SignalHandModule_T_CM_uint8 0 0 0 255 ECU_ADDRESS 0xb0055ec5 /* @ECU_Address@monr_VeINP_XLRollAgVDSHM_enum@ */ /end MEASUREMENT
/begin MEASUREMENT monr_VeINP_XRRollAgVDSHM_enum "" UBYTE POD_SignalHandModule_T_CM_uint8 0 0 0 255 ECU_ADDRESS 0xb0055ed0 /* @ECU_Address@monr_VeINP_XRRollAgVDSHM_enum@ */ /end MEASUREMENT
/begin MEASUREMENT monr_VeSHM_SideIncinAgQlyL_enum "" UBYTE POD_SignalHandModule_T_CM_uint8 0 0 0 255 ECU_ADDRESS 0xb0055f04 /* @ECU_Address@monr_VeSHM_SideIncinAgQlyL_enum@ */ /end MEASUREMENT
/begin MEASUREMENT monr_VeSHM_SideIncinAgQlyR_enum "" UBYTE POD_SignalHandModule_T_CM_uint8 0 0 0 255 ECU_ADDRESS 0xb0055f05 /* @ECU_Address@monr_VeSHM_SideIncinAgQlyR_enum@ */ /end MEASUREMENT
/begin MEASUREMENT monr_VeSMM_DOPFcnStateLSHM_enum "" UBYTE POD_SignalHandModule_T_CM_uint8 0 0 0 255 ECU_ADDRESS 0xb0055f1d /* @ECU_Address@monr_VeSMM_DOPFcnStateLSHM_enum@ */ /end MEASUREMENT
/begin MEASUREMENT monr_VeSMM_DOPFcnStateRSHM_enum "" UBYTE POD_SignalHandModule_T_CM_uint8 0 0 0 255 ECU_ADDRESS 0xb0055f1e /* @ECU_Address@monr_VeSMM_DOPFcnStateRSHM_enum@ */ /end MEASUREMENT
/begin MEASUREMENT monr_VeHHM_UsrSetMaxPstnLSHM_pct "" UBYTE POD_SignalHandModule_T_CM_uint8 0 0 0 255 ECU_ADDRESS 0xb0055e97 /* @ECU_Address@monr_VeHHM_UsrSetMaxPstnLSHM_pct@ */ /end MEASUREMENT
/begin MEASUREMENT monr_VeSHM_TopPercXLHmiFeedBack_pct "" UBYTE POD_SignalHandModule_T_CM_uint8 0 0 0 255 ECU_ADDRESS 0xb0055f06 /* @ECU_Address@monr_VeSHM_TopPercXLHmiFeedBack_pct@ */ /end MEASUREMENT
/begin MEASUREMENT monr_VeHHM_UsrSetMaxPstnRSHM_pct "" UBYTE POD_SignalHandModule_T_CM_uint8 0 0 0 255 ECU_ADDRESS 0xb0055e98 /* @ECU_Address@monr_VeHHM_UsrSetMaxPstnRSHM_pct@ */ /end MEASUREMENT
/begin MEASUREMENT monr_VeSHM_TopPercXRHmiFeedBack_pct "" UBYTE POD_SignalHandModule_T_CM_uint8 0 0 0 255 ECU_ADDRESS 0xb0055f07 /* @ECU_Address@monr_VeSHM_TopPercXRHmiFeedBack_pct@ */ /end MEASUREMENT
/begin MEASUREMENT monr_VeMCM_MotorCtrlModeLSHM_enum "" UBYTE POD_SignalHandModule_T_CM_uint8 0 0 0 255 ECU_ADDRESS 0xb0055ed1 /* @ECU_Address@monr_VeMCM_MotorCtrlModeLSHM_enum@ */ /end MEASUREMENT
/begin MEASUREMENT monr_VeSHM_MotorCtrlModeL_enum "" UBYTE POD_SignalHandModule_T_CM_uint8 0 0 0 255 ECU_ADDRESS 0xb0055ef6 /* @ECU_Address@monr_VeSHM_MotorCtrlModeL_enum@ */ /end MEASUREMENT
/begin MEASUREMENT monr_VeMCM_MotorCtrlModeRSHM_enum "" UBYTE POD_SignalHandModule_T_CM_uint8 0 0 0 255 ECU_ADDRESS 0xb0055ed2 /* @ECU_Address@monr_VeMCM_MotorCtrlModeRSHM_enum@ */ /end MEASUREMENT
/begin MEASUREMENT monr_VeSHM_MotorCtrlModeR_enum "" UBYTE POD_SignalHandModule_T_CM_uint8 0 0 0 255 ECU_ADDRESS 0xb0055ef7 /* @ECU_Address@monr_VeSHM_MotorCtrlModeR_enum@ */ /end MEASUREMENT
/begin MEASUREMENT monr_VeINP_XLDoorOpenAgSHM_deg "" UBYTE POD_SignalHandModule_T_CM_uint8 0 0 0 255 ECU_ADDRESS 0xb0055ebc /* @ECU_Address@monr_VeINP_XLDoorOpenAgSHM_deg@ */ /end MEASUREMENT
/begin MEASUREMENT monr_VeINP_XRDoorOpenAgSHM_deg "" UBYTE POD_SignalHandModule_T_CM_uint8 0 0 0 255 ECU_ADDRESS 0xb0055ec7 /* @ECU_Address@monr_VeINP_XRDoorOpenAgSHM_deg@ */ /end MEASUREMENT
/begin MEASUREMENT monr_VeINP_ModSetSHM_enum "" UBYTE POD_SignalHandModule_T_CM_uint8 0 0 0 255 ECU_ADDRESS 0xb0055eab /* @ECU_Address@monr_VeINP_ModSetSHM_enum@ */ /end MEASUREMENT
/begin MEASUREMENT monr_VeINP_DRMXLErrSHM_enum "" UBYTE POD_SignalHandModule_T_CM_uint8 0 0 0 255 ECU_ADDRESS 0xb0055e9f /* @ECU_Address@monr_VeINP_DRMXLErrSHM_enum@ */ /end MEASUREMENT
/begin MEASUREMENT monr_VeINP_DRMXRErrSHM_enum "" UBYTE POD_SignalHandModule_T_CM_uint8 0 0 0 255 ECU_ADDRESS 0xb0055ea1 /* @ECU_Address@monr_VeINP_DRMXRErrSHM_enum@ */ /end MEASUREMENT
/begin MEASUREMENT monr_VeINP_DRMXLStSHM_enum "" UBYTE POD_SignalHandModule_T_CM_uint8 0 0 0 255 ECU_ADDRESS 0xb0055ea0 /* @ECU_Address@monr_VeINP_DRMXLStSHM_enum@ */ /end MEASUREMENT
/begin MEASUREMENT monr_VeINP_DRMXRStSHM_enum "" UBYTE POD_SignalHandModule_T_CM_uint8 0 0 0 255 ECU_ADDRESS 0xb0055ea2 /* @ECU_Address@monr_VeINP_DRMXRStSHM_enum@ */ /end MEASUREMENT
/begin MEASUREMENT monr_VeINP_FLWinPosStFBSHM_pct "" UBYTE POD_SignalHandModule_T_CM_uint8 0 0 0 255 ECU_ADDRESS 0xb0055ea4 /* @ECU_Address@monr_VeINP_FLWinPosStFBSHM_pct@ */ /end MEASUREMENT
/begin MEASUREMENT monr_VeINP_FRWinPosStFBSHM_pct "" UBYTE POD_SignalHandModule_T_CM_uint8 0 0 0 255 ECU_ADDRESS 0xb0055ea5 /* @ECU_Address@monr_VeINP_FRWinPosStFBSHM_pct@ */ /end MEASUREMENT
/begin MEASUREMENT monr_VeINP_RLWinPosStFBSHM_pct "" UBYTE POD_SignalHandModule_T_CM_uint8 0 0 0 255 ECU_ADDRESS 0xb0055ead /* @ECU_Address@monr_VeINP_RLWinPosStFBSHM_pct@ */ /end MEASUREMENT
/begin MEASUREMENT monr_VeINP_RRWinPosStFBSHM_pct "" UBYTE POD_SignalHandModule_T_CM_uint8 0 0 0 255 ECU_ADDRESS 0xb0055eaf /* @ECU_Address@monr_VeINP_RRWinPosStFBSHM_pct@ */ /end MEASUREMENT
/begin MEASUREMENT monr_VeINP_TgatePosSHM_pct "" UBYTE POD_SignalHandModule_T_CM_uint8 0 0 0 255 ECU_ADDRESS 0xb0055eb6 /* @ECU_Address@monr_VeINP_TgatePosSHM_pct@ */ /end MEASUREMENT
/begin MEASUREMENT monr_VeINP_RoofPosValueSHM_pct "" UBYTE POD_SignalHandModule_T_CM_uint8 0 0 0 255 ECU_ADDRESS 0xb0055eae /* @ECU_Address@monr_VeINP_RoofPosValueSHM_pct@ */ /end MEASUREMENT
/begin MEASUREMENT monr_VeINP_AirIntakeStSHM_pct "" UBYTE POD_SignalHandModule_T_CM_uint8 0 0 0 255 ECU_ADDRESS 0xb0055e99 /* @ECU_Address@monr_VeINP_AirIntakeStSHM_pct@ */ /end MEASUREMENT
/begin MEASUREMENT monr_VeINP_WindExitSpdSHM_enum "" UBYTE POD_SignalHandModule_T_CM_uint8 0 0 0 255 ECU_ADDRESS 0xb0055eba /* @ECU_Address@monr_VeINP_WindExitSpdSHM_enum@ */ /end MEASUREMENT
/begin MEASUREMENT monr_VeINP_XLMaiMotSCGErrSHM_flg "" UBYTE POD_SignalHandModule_T_CM_uint8 0 0 0 255 ECU_ADDRESS 0xb0055ec2 /* @ECU_Address@monr_VeINP_XLMaiMotSCGErrSHM_flg@ */ /end MEASUREMENT
/begin MEASUREMENT monr_VeINP_XLMaiMotSCBErrSHM_flg "" UBYTE POD_SignalHandModule_T_CM_uint8 0 0 0 255 ECU_ADDRESS 0xb0055ec1 /* @ECU_Address@monr_VeINP_XLMaiMotSCBErrSHM_flg@ */ /end MEASUREMENT
/begin MEASUREMENT monr_VeINP_XLMaiMotOCErrSHM_flg "" UBYTE POD_SignalHandModule_T_CM_uint8 0 0 0 255 ECU_ADDRESS 0xb0055ec0 /* @ECU_Address@monr_VeINP_XLMaiMotOCErrSHM_flg@ */ /end MEASUREMENT
/begin MEASUREMENT monr_VeINP_XRMaiMotSCGErrSHM_flg "" UBYTE POD_SignalHandModule_T_CM_uint8 0 0 0 255 ECU_ADDRESS 0xb0055ecd /* @ECU_Address@monr_VeINP_XRMaiMotSCGErrSHM_flg@ */ /end MEASUREMENT
/begin MEASUREMENT monr_VeINP_XRMaiMotSCBErrSHM_flg "" UBYTE POD_SignalHandModule_T_CM_uint8 0 0 0 255 ECU_ADDRESS 0xb0055ecc /* @ECU_Address@monr_VeINP_XRMaiMotSCBErrSHM_flg@ */ /end MEASUREMENT
/begin MEASUREMENT monr_VeINP_XRMaiMotOCErrSHM_flg "" UBYTE POD_SignalHandModule_T_CM_uint8 0 0 0 255 ECU_ADDRESS 0xb0055ecb /* @ECU_Address@monr_VeINP_XRMaiMotOCErrSHM_flg@ */ /end MEASUREMENT
/begin MEASUREMENT monr_VbSMM_RdrWrkReqByCEMLSHM_flg "" UBYTE POD_SignalHandModule_T_CM_boolean 0 0 0 1 ECU_ADDRESS 0xb0055e92 /* @ECU_Address@monr_VbSMM_RdrWrkReqByCEMLSHM_flg@ */ /end MEASUREMENT
/begin MEASUREMENT monr_VbSMM_RdrWrkReqByCEMRSHM_flg "" UBYTE POD_SignalHandModule_T_CM_boolean 0 0 0 1 ECU_ADDRESS 0xb0055e93 /* @ECU_Address@monr_VbSMM_RdrWrkReqByCEMRSHM_flg@ */ /end MEASUREMENT
/begin MEASUREMENT monr_VbTTR_TipToRunRqstLSHM_flg "" UBYTE POD_SignalHandModule_T_CM_boolean 0 0 0 1 ECU_ADDRESS 0xb0055e96 /* @ECU_Address@monr_VbTTR_TipToRunRqstLSHM_flg@ */ /end MEASUREMENT
/begin MEASUREMENT monr_VbAP_AntiPinchStsDspRSHM_flg "" UBYTE POD_SignalHandModule_T_CM_boolean 0 0 0 1 ECU_ADDRESS 0xb0055e79 /* @ECU_Address@monr_VbAP_AntiPinchStsDspRSHM_flg@ */ /end MEASUREMENT
/begin COMPU_METHOD POD_SignalHandModule_T_CM_single "Q = V" RAT_FUNC "%8.6" "" COEFFS 0 1 0 0 0 1 /end COMPU_METHOD
/begin COMPU_METHOD POD_SignalHandModule_T_CM_uint16 "Q = V" RAT_FUNC "%5.0" "" COEFFS 0 1 0 0 0 1 /end COMPU_METHOD
/begin COMPU_METHOD POD_SignalHandModule_T_CM_uint8 "Q = V" RAT_FUNC "%3.0" "" COEFFS 0 1 0 0 0 1 /end COMPU_METHOD
/begin COMPU_METHOD POD_SignalHandModule_T_CM_boolean "Q = V" RAT_FUNC "%1.0" "" COEFFS 0 1 0 0 0 1 /end COMPU_METHOD
/begin GROUP POD_SignalHandModule_T "POD_SignalHandModule_T" ROOT /begin SUB_GROUP Root_POD_SignalHandModule /end SUB_GROUP /end GROUP
/begin GROUP Root_POD_SignalHandModule "POD_SignalHandModule_T/POD_SignalHandModule" /begin SUB_GROUP S2_SignalHandModule /end SUB_GROUP
 /begin REF_MEASUREMENT monr_VbAP_AntiPinchStsDspRSHM_flg monr_VbSMM_RdrWrkReqByCEMLSHM_flg monr_VbSMM_RdrWrkReqByCEMRSHM_flg monr_VbTTR_TipToRunRqstLSHM_flg monr_VeHHM_UsrSetMaxPstnLSHM_pct monr_VeHHM_UsrSetMaxPstnRSHM_pct monr_VeINP_AirIntakeStSHM_pct monr_VeINP_DOWLXWarningSHM_enum monr_VeINP_DOWRXWarningSHM_enum monr_VeINP_DRMXLErrSHM_enum monr_VeINP_DRMXLStSHM_enum monr_VeINP_DRMXRErrSHM_enum monr_VeINP_DRMXRStSHM_enum monr_VeINP_DoorOpenerXLReqSHM_enum monr_VeINP_DoorOpenerXRReqSHM_enum monr_VeINP_ExterTempVDSHM_enum monr_VeINP_FLWinPosStFBSHM_pct monr_VeINP_FRWinPosStFBSHM_pct monr_VeINP_ModSetSHM_enum monr_VeINP_RLWinPosStFBSHM_pct monr_VeINP_RRWinPosStFBSHM_pct monr_VeINP_RoofPosValueSHM_pct monr_VeINP_TgatePosSHM_pct monr_VeINP_VehSpdVDSHM_enum monr_VeINP_WindExitSpdSHM_enum monr_VeINP_XLDoorLockStSHM_enum monr_VeINP_XLDoorOpenAgSHM_deg monr_VeINP_XLMaiMotOCErrSHM_flg monr_VeINP_XLMaiMotSCBErrSHM_flg monr_VeINP_XLMaiMotSCGErrSHM_flg monr_VeINP_XLPitchAgVDSHM_enum monr_VeINP_XLReqSHM_enum monr_VeINP_XLRollAgVDSHM_enum monr_VeINP_XRDoorLockStSHM_enum monr_VeINP_XRDoorOpenAgSHM_deg monr_VeINP_XRMaiMotOCErrSHM_flg monr_VeINP_XRMaiMotSCBErrSHM_flg monr_VeINP_XRMaiMotSCGErrSHM_flg monr_VeINP_XRPitchAgVDSHM_enum monr_VeINP_XRReqSHM_enum monr_VeINP_XRRollAgVDSHM_enum monr_VeMCM_MotorCtrlModeLSHM_enum monr_VeMCM_MotorCtrlModeRSHM_enum monr_VeSMM_DOPFcnStateLSHM_enum monr_VeSMM_DOPFcnStateRSHM_enum monr_VfHHM_AswHallPositionLSHM_deg monr_VfHHM_AswHallPositionRSHM_deg monr_VfINP_DoorRLOpenAgSHM_deg monr_VfINP_DoorRROpenAgSHM_deg monr_VfINP_ExterTempSHM_C monr_VfINP_FLGYROAgSpdSHM_degps monr_VfINP_FRGYROAgSpdSHM_degps monr_VfINP_MaiMotCurrLSHM_A monr_VfINP_MaiMotCurrRSHM_A monr_VfINP_UBRVoltSHM_V monr_VfINP_VehSpdSHM_kph monr_VfINP_XLPitchAgSHM_deg monr_VfINP_XLRollAgSHM_deg monr_VfINP_XRPitchAgSHM_deg monr_VfINP_XRRollAgSHM_deg monr_VuMCM_MotorCtrlDuty1LSHM_NULL monr_VuMCM_MotorCtrlDuty1RSHM_NULL monr_VuMCM_MotorCtrlDuty2LSHM_NULL monr_VuMCM_MotorCtrlDuty2RSHM_NULL /end REF_MEASUREMENT
/end GROUP
/begin GROUP S2_SignalHandModule "POD_SignalHandModule_T/POD_SignalHandModule/SignalHandModule"
 /begin SUB_GROUP S3_ADCHandleModule S3_IMUSpeed S3_INP S3_LowVoltaBattery S3_MotorCtrl S3_VehSpd /end SUB_GROUP
 /begin REF_MEASUREMENT monr_VeSHM_TopPercXLHmiFeedBack_pct monr_VeSHM_TopPercXRHmiFeedBack_pct monr_VeSHM_XLReq_enum monr_VeSHM_XRReq_enum /end REF_MEASUREMENT
/end GROUP
/begin GROUP S3_ADCHandleModule "POD_SignalHandModule_T/POD_SignalHandModule/SignalHandModule/ADCHandleModule" /begin SUB_GROUP S4_1stOrderFilter1 S4_1stOrderFilter2 S4_1stOrderFilter4 /end SUB_GROUP
 /begin REF_CHARACTERISTIC k_ADCH_Fac_FilterForAmbTemp k_ADCH_Fac_FilterForMaiMotCurr k_ADCH_Fac_FilterForUBRVolt /end REF_CHARACTERISTIC
/end GROUP
/begin GROUP S3_IMUSpeed "POD_SignalHandModule_T/POD_SignalHandModule/SignalHandModule/IMUSpeed" /begin REF_MEASUREMENT monr_VfSHM_FLGYROAgSpd_degps monr_VfSHM_FRGYROAgSpd_degps /end REF_MEASUREMENT /end GROUP
/begin GROUP S3_INP "POD_SignalHandModule_T/POD_SignalHandModule/SignalHandModule/INP" /begin SUB_GROUP S10_INPL S10_INPR /end SUB_GROUP
 /begin REF_MEASUREMENT monr_VeSHM_DoorOpenArlmL_enum monr_VeSHM_DoorOpenArlmR_enum monr_VeSHM_FrntIncinAgQlyL_enum monr_VeSHM_FrntIncinAgQlyR_enum monr_VeSHM_SideIncinAgQlyL_enum monr_VeSHM_SideIncinAgQlyR_enum /end REF_MEASUREMENT
/end GROUP
/begin GROUP S3_LowVoltaBattery "POD_SignalHandModule_T/POD_SignalHandModule/SignalHandModule/LowVoltaBattery" /begin REF_MEASUREMENT monr_VfSHM_VehLVBatt_V /end REF_MEASUREMENT /end GROUP
/begin GROUP S3_MotorCtrl "POD_SignalHandModule_T/POD_SignalHandModule/SignalHandModule/MotorCtrl"
 /begin REF_MEASUREMENT monr_VeSHM_MotorCtrlModeL_enum monr_VeSHM_MotorCtrlModeR_enum /end REF_MEASUREMENT
/end GROUP
/begin GROUP S3_VehSpd "POD_SignalHandModule_T/POD_SignalHandModule/SignalHandModule/VehSpd" /begin SUB_GROUP S15_Switch1 /end SUB_GROUP /begin REF_MEASUREMENT monr_VeSHM_VehSpdLgtQly_enum /end REF_MEASUREMENT /end GROUP
/begin GROUP S4_1stOrderFilter1 "POD_SignalHandModule_T/POD_SignalHandModule/SignalHandModule/ADCHandleModule/1stOrderFilter1" /begin REF_MEASUREMENT monr_VfSHM_BatVoltageValue_MV /end REF_MEASUREMENT /end GROUP
/begin GROUP S4_1stOrderFilter2 "POD_SignalHandModule_T/POD_SignalHandModule/SignalHandModule/ADCHandleModule/1stOrderFilter2" /begin REF_MEASUREMENT monr_VfSHM_AmbTemp_C /end REF_MEASUREMENT /end GROUP
/begin GROUP S4_1stOrderFilter4 "POD_SignalHandModule_T/POD_SignalHandModule/SignalHandModule/ADCHandleModule/1stOrderFilter4" /begin REF_MEASUREMENT monr_VfSHM_MainMotoCurrentL_MA /end REF_MEASUREMENT /end GROUP
/begin GROUP S10_INPL "POD_SignalHandModule_T/POD_SignalHandModule/SignalHandModule/INP/INPL" /begin SUB_GROUP S22_CEM /end SUB_GROUP /end GROUP
/begin GROUP S10_INPR "POD_SignalHandModule_T/POD_SignalHandModule/SignalHandModule/INP/INPR" /begin SUB_GROUP S23_ADCHandleModule S23_CEM S23_DIO /end SUB_GROUP /end GROUP
/begin GROUP S15_Switch1 "POD_SignalHandModule_T/POD_SignalHandModule/SignalHandModule/VehSpd/Switch1" /begin REF_MEASUREMENT monr_VfSHM_VehSpdLgt_mps /end REF_MEASUREMENT /end GROUP
/begin GROUP S22_CEM "POD_SignalHandModule_T/POD_SignalHandModule/SignalHandModule/INP/INPL/CEM" /begin SUB_GROUP S24_FrontInclineAngle S24_SideInclineAngle /end SUB_GROUP /begin REF_MEASUREMENT monr_VeSHM_DoorWrkReqL_enum /end REF_MEASUREMENT /end GROUP
/begin GROUP S23_ADCHandleModule "POD_SignalHandModule_T/POD_SignalHandModule/SignalHandModule/INP/INPR/ADCHandleModule" /begin SUB_GROUP S39_1stOrderFilter4 /end SUB_GROUP /begin REF_CHARACTERISTIC k_ADCH_Fac_FilterForMaiMotCurr /end REF_CHARACTERISTIC /end GROUP
/begin GROUP S23_CEM "POD_SignalHandModule_T/POD_SignalHandModule/SignalHandModule/INP/INPR/CEM" /begin SUB_GROUP S40_FrontInclineAngle S40_SideInclineAngle /end SUB_GROUP /end GROUP
/begin GROUP S23_DIO "POD_SignalHandModule_T/POD_SignalHandModule/SignalHandModule/INP/INPR/DIO" /begin REF_MEASUREMENT monr_VeSHM_DoorWrkReqR_enum /end REF_MEASUREMENT /end GROUP
/begin GROUP S24_FrontInclineAngle "POD_SignalHandModule_T/POD_SignalHandModule/SignalHandModule/INP/INPL/CEM/FrontInclineAngle" /begin REF_MEASUREMENT monr_VfSHM_FrntIncinAgL_deg /end REF_MEASUREMENT /end GROUP
/begin GROUP S24_SideInclineAngle "POD_SignalHandModule_T/POD_SignalHandModule/SignalHandModule/INP/INPL/CEM/SideInclineAngle" /begin REF_MEASUREMENT monr_VfSHM_SideIncinAgL_deg /end REF_MEASUREMENT /end GROUP
/begin GROUP S39_1stOrderFilter4 "POD_SignalHandModule_T/POD_SignalHandModule/SignalHandModule/INP/INPR/ADCHandleModule/1stOrderFilter4" /begin REF_MEASUREMENT monr_VfSHM_MainMotoCurrentR_MA /end REF_MEASUREMENT /end GROUP
/begin GROUP S40_FrontInclineAngle "POD_SignalHandModule_T/POD_SignalHandModule/SignalHandModule/INP/INPR/CEM/FrontInclineAngle" /begin REF_MEASUREMENT monr_VfSHM_FrntIncinAgR_deg /end REF_MEASUREMENT /end GROUP
/begin GROUP S40_SideInclineAngle "POD_SignalHandModule_T/POD_SignalHandModule/SignalHandModule/INP/INPR/CEM/SideInclineAngle" /begin REF_MEASUREMENT monr_VfSHM_SideIncinAgR_deg /end REF_MEASUREMENT /end GROUP
/begin MEASUREMENT monr_VfHHM_MaxOpenPositionLSMML_deg "" FLOAT32_IEEE POD_SMML_CM_single 0 0 -3.4E+38 3.4E+38 ECU_ADDRESS 0xb0056010 /* @ECU_Address@monr_VfHHM_MaxOpenPositionLSMML_deg@ */ /end MEASUREMENT
/begin MEASUREMENT monr_VfHHM_AswHallPositionLSMML_deg "" FLOAT32_IEEE POD_SMML_CM_single 0 0 -3.4E+38 3.4E+38 ECU_ADDRESS 0xb0056014 /* @ECU_Address@monr_VfHHM_AswHallPositionLSMML_deg@ */ /end MEASUREMENT
/begin MEASUREMENT monr_VfHHM_DoorPstnLSMML_pct "" FLOAT32_IEEE POD_SMML_CM_single 0 0 -3.4E+38 3.4E+38 ECU_ADDRESS 0xb0056018 /* @ECU_Address@monr_VfHHM_DoorPstnLSMML_pct@ */ /end MEASUREMENT
/begin MEASUREMENT monr_VfIMU_AgSpdLSMML_degps "" FLOAT32_IEEE POD_SMML_CM_single 0 0 -3.4E+38 3.4E+38 ECU_ADDRESS 0xb0056020 /* @ECU_Address@monr_VfIMU_AgSpdLSMML_degps@ */ /end MEASUREMENT
/begin MEASUREMENT monr_VfSHM_MainMotoCurrentLSMML_MA "" FLOAT32_IEEE POD_SMML_CM_single 0 0 -3.4E+38 3.4E+38 ECU_ADDRESS 0xb0056028 /* @ECU_Address@monr_VfSHM_MainMotoCurrentLSMML_MA@ */ /end MEASUREMENT
/begin MEASUREMENT monr_VfSHM_AmbTempSMML_C "" FLOAT32_IEEE POD_SMML_CM_single 0 0 -3.4E+38 3.4E+38 ECU_ADDRESS 0xb005602c /* @ECU_Address@monr_VfSHM_AmbTempSMML_C@ */ /end MEASUREMENT
/begin MEASUREMENT monr_VfSHM_FrntIncinAgLSMML_deg "" FLOAT32_IEEE POD_SMML_CM_single 0 0 -3.4E+38 3.4E+38 ECU_ADDRESS 0xb0056034 /* @ECU_Address@monr_VfSHM_FrntIncinAgLSMML_deg@ */ /end MEASUREMENT
/begin MEASUREMENT monr_VfSHM_SideIncinAgLSMML_deg "" FLOAT32_IEEE POD_SMML_CM_single 0 0 -3.4E+38 3.4E+38 ECU_ADDRESS 0xb0056038 /* @ECU_Address@monr_VfSHM_SideIncinAgLSMML_deg@ */ /end MEASUREMENT
/begin MEASUREMENT monr_VfSHM_DoorRdrAgLSMML_deg "" FLOAT32_IEEE POD_SMML_CM_single 0 0 -3.4E+38 3.4E+38 ECU_ADDRESS 0xb0056040 /* @ECU_Address@monr_VfSHM_DoorRdrAgLSMML_deg@ */ /end MEASUREMENT
/begin MEASUREMENT monr_VfSMM_TopDegforDoorOpenL_NULL "" FLOAT32_IEEE POD_SMML_CM_single 0 0 -3.4E+38 3.4E+38 ECU_ADDRESS 0xb005604c /* @ECU_Address@monr_VfSMM_TopDegforDoorOpenL_NULL@ */ /end MEASUREMENT
/begin MEASUREMENT monr_VsHHM_AswHallPositionLSMML_NULL "" SWORD POD_SMML_CM_int16 0 0 -32768 32767 ECU_ADDRESS 0xb005600c /* @ECU_Address@monr_VsHHM_AswHallPositionLSMML_NULL@ */ /end MEASUREMENT
/begin MEASUREMENT monr_VsHHM_AntiPinchHallPositionLSMML_NULL "" SWORD POD_SMML_CM_int16 0 0 -32768 32767 ECU_ADDRESS 0xb005600e /* @ECU_Address@monr_VsHHM_AntiPinchHallPositionLSMML_NULL@ */ /end MEASUREMENT
/begin MEASUREMENT monr_VsHHM_AswHallSpeedLSMML_rpm "" SWORD POD_SMML_CM_int16 0 0 -32768 32767 ECU_ADDRESS 0xb005601c /* @ECU_Address@monr_VsHHM_AswHallSpeedLSMML_rpm@ */ /end MEASUREMENT
/begin MEASUREMENT monr_VeSHM_NVMDoorOprtStsLSMML_enum "" UBYTE POD_SMML_CM_uint8 0 0 0 255 ECU_ADDRESS 0xb0055ff5 /* @ECU_Address@monr_VeSHM_NVMDoorOprtStsLSMML_enum@ */ /end MEASUREMENT
/begin MEASUREMENT monr_VeSHM_DoorWrkReqLSMML_enum "" UBYTE POD_SMML_CM_uint8 0 0 0 255 ECU_ADDRESS 0xb0055ff6 /* @ECU_Address@monr_VeSHM_DoorWrkReqLSMML_enum@ */ /end MEASUREMENT
/begin MEASUREMENT monr_VeSHM_DoorWrkReqSrcLSMML_enum "" UBYTE POD_SMML_CM_uint8 0 0 0 255 ECU_ADDRESS 0xb0055ff7 /* @ECU_Address@monr_VeSHM_DoorWrkReqSrcLSMML_enum@ */ /end MEASUREMENT
/begin MEASUREMENT monr_VeSHM_DoorStsLSMML_enum "" UBYTE POD_SMML_CM_uint8 0 0 0 255 ECU_ADDRESS 0xb0055ff9 /* @ECU_Address@monr_VeSHM_DoorStsLSMML_enum@ */ /end MEASUREMENT
/begin MEASUREMENT monr_VeSHM_DoorLckPstnLSMML_enum "" UBYTE POD_SMML_CM_uint8 0 0 0 255 ECU_ADDRESS 0xb0055ffa /* @ECU_Address@monr_VeSHM_DoorLckPstnLSMML_enum@ */ /end MEASUREMENT
/begin MEASUREMENT monr_VeSHM_VehSptStsSMML_enum "" UBYTE POD_SMML_CM_uint8 0 0 0 255 ECU_ADDRESS 0xb0055fff /* @ECU_Address@monr_VeSHM_VehSptStsSMML_enum@ */ /end MEASUREMENT
/begin MEASUREMENT monr_VeSHM_DoorOpenArlmLSMML_enum "" UBYTE POD_SMML_CM_uint8 0 0 0 255 ECU_ADDRESS 0xb0056000 /* @ECU_Address@monr_VeSHM_DoorOpenArlmLSMML_enum@ */ /end MEASUREMENT
/begin MEASUREMENT monr_VeSHM_DoorModStsSMML_enum "" UBYTE POD_SMML_CM_uint8 0 0 0 255 ECU_ADDRESS 0xb0056001 /* @ECU_Address@monr_VeSHM_DoorModStsSMML_enum@ */ /end MEASUREMENT
/begin MEASUREMENT monr_VeHHM_UsrSetMaxPstnLSMML_pct "" UBYTE POD_SMML_CM_uint8 0 0 0 255 ECU_ADDRESS 0xb0056004 /* @ECU_Address@monr_VeHHM_UsrSetMaxPstnLSMML_pct@ */ /end MEASUREMENT
/begin MEASUREMENT monr_VeHHM_DoorMovStsLSMML_NULL "" UBYTE POD_SMML_CM_uint8 0 0 0 255 ECU_ADDRESS 0xb005600a /* @ECU_Address@monr_VeHHM_DoorMovStsLSMML_NULL@ */ /end MEASUREMENT
/begin MEASUREMENT monr_VeTTR_ManAsstRqstLSMML_enum "" UBYTE POD_SMML_CM_uint8 0 0 0 255 ECU_ADDRESS 0xb0056026 /* @ECU_Address@monr_VeTTR_ManAsstRqstLSMML_enum@ */ /end MEASUREMENT
/begin MEASUREMENT monr_VeMCM_CmdStateLSMML_NULL "" UBYTE POD_SMML_CM_uint8 0 0 0 255 ECU_ADDRESS 0xb0056049 /* @ECU_Address@monr_VeMCM_CmdStateLSMML_NULL@ */ /end MEASUREMENT
/begin MEASUREMENT monr_VeSHM_DoorTypCfgSMML_enum "" UBYTE POD_SMML_CM_uint8 0 0 0 255 ECU_ADDRESS 0xb0056050 /* @ECU_Address@monr_VeSHM_DoorTypCfgSMML_enum@ */ /end MEASUREMENT
/begin MEASUREMENT monr_VeSMM_DOPFcnStateL_enum "" UBYTE POD_SMML_CM_uint8 0 0 0 255 ECU_ADDRESS 0xb0055feb /* @ECU_Address@monr_VeSMM_DOPFcnStateL_enum@ */ /end MEASUREMENT
/begin MEASUREMENT monr_VeSMM_MotorCtrlModeL_enum "" UBYTE POD_SMML_CM_uint8 0 0 0 255 ECU_ADDRESS 0xb0055fe6 /* @ECU_Address@monr_VeSMM_MotorCtrlModeL_enum@ */ /end MEASUREMENT
/begin MEASUREMENT monr_VeSMM_MotorCtrlStateL_enum "" UBYTE POD_SMML_CM_uint8 0 0 0 255 ECU_ADDRESS 0xb0055ff1 /* @ECU_Address@monr_VeSMM_MotorCtrlStateL_enum@ */ /end MEASUREMENT
/begin MEASUREMENT monr_VeSMM_DoorLatPosnL_enum "" UBYTE POD_SMML_CM_uint8 0 0 0 255 ECU_ADDRESS 0xb0056007 /* @ECU_Address@monr_VeSMM_DoorLatPosnL_enum@ */ /end MEASUREMENT
/begin MEASUREMENT monr_VeSMM_OpenDoorCmdL_enum "" UBYTE POD_SMML_CM_uint8 0 0 0 255 ECU_ADDRESS 0xb0055ffc /* @ECU_Address@monr_VeSMM_OpenDoorCmdL_enum@ */ /end MEASUREMENT
/begin MEASUREMENT monr_VeSMM_PushLockL_NULL "" UBYTE POD_SMML_CM_uint8 0 0 0 255 ECU_ADDRESS 0xb0056024 /* @ECU_Address@monr_VeSMM_PushLockL_NULL@ */ /end MEASUREMENT
/begin MEASUREMENT monr_VeSMM_StopEventL_enum "" UBYTE POD_SMML_CM_uint8 0 0 0 255 ECU_ADDRESS 0xb005603c /* @ECU_Address@monr_VeSMM_StopEventL_enum@ */ /end MEASUREMENT
/begin MEASUREMENT monr_VeSMM_VehModStsL_enum "" UBYTE POD_SMML_CM_uint8 0 0 0 255 ECU_ADDRESS 0xb0056051 /* @ECU_Address@monr_VeSMM_VehModStsL_enum@ */ /end MEASUREMENT
/begin MEASUREMENT monr_VeSMM_HoverModCtrlL_enum "" UBYTE POD_SMML_CM_uint8 0 0 0 255 ECU_ADDRESS 0xb0055fed /* @ECU_Address@monr_VeSMM_HoverModCtrlL_enum@ */ /end MEASUREMENT
/begin MEASUREMENT monr_VbFH_ECUWakeUpLSMML_flg "" UBYTE POD_SMML_CM_boolean 0 0 0 1 ECU_ADDRESS 0xb0055ff4 /* @ECU_Address@monr_VbFH_ECUWakeUpLSMML_flg@ */ /end MEASUREMENT
/begin MEASUREMENT monr_VbSHM_IceBreakDoorActvLSMML_flg "" UBYTE POD_SMML_CM_boolean 0 0 0 1 ECU_ADDRESS 0xb0055ff8 /* @ECU_Address@monr_VbSHM_IceBreakDoorActvLSMML_flg@ */ /end MEASUREMENT
/begin MEASUREMENT monr_VbAP_AntiPinchStsDspLSMML_flg "" UBYTE POD_SMML_CM_boolean 0 0 0 1 ECU_ADDRESS 0xb0056005 /* @ECU_Address@monr_VbAP_AntiPinchStsDspLSMML_flg@ */ /end MEASUREMENT
/begin MEASUREMENT monr_VbFH_AnptiplayLSMML_flg "" UBYTE POD_SMML_CM_boolean 0 0 0 1 ECU_ADDRESS 0xb0056006 /* @ECU_Address@monr_VbFH_AnptiplayLSMML_flg@ */ /end MEASUREMENT
/begin MEASUREMENT monr_VbAP_ThermprotnLSMML_flg "" UBYTE POD_SMML_CM_boolean 0 0 0 1 ECU_ADDRESS 0xb0056008 /* @ECU_Address@monr_VbAP_ThermprotnLSMML_flg@ */ /end MEASUREMENT
/begin MEASUREMENT monr_VbHHM_DoorOpenLSMML_flg "" UBYTE POD_SMML_CM_boolean 0 0 0 1 ECU_ADDRESS 0xb0056009 /* @ECU_Address@monr_VbHHM_DoorOpenLSMML_flg@ */ /end MEASUREMENT
/begin MEASUREMENT monr_VbTTR_TipToRunRqstLSMML_flg "" UBYTE POD_SMML_CM_boolean 0 0 0 1 ECU_ADDRESS 0xb0056025 /* @ECU_Address@monr_VbTTR_TipToRunRqstLSMML_flg@ */ /end MEASUREMENT
/begin MEASUREMENT monr_VbFH_FrntIncinAgFltLSMML_flg "" UBYTE POD_SMML_CM_boolean 0 0 0 1 ECU_ADDRESS 0xb005603d /* @ECU_Address@monr_VbFH_FrntIncinAgFltLSMML_flg@ */ /end MEASUREMENT
/begin MEASUREMENT monr_VbFH_SideIncinAgFltLSMML_flg "" UBYTE POD_SMML_CM_boolean 0 0 0 1 ECU_ADDRESS 0xb005603e /* @ECU_Address@monr_VbFH_SideIncinAgFltLSMML_flg@ */ /end MEASUREMENT
/begin MEASUREMENT monr_VbFH_RdrTioutLSMML_flg "" UBYTE POD_SMML_CM_boolean 0 0 0 1 ECU_ADDRESS 0xb0056044 /* @ECU_Address@monr_VbFH_RdrTioutLSMML_flg@ */ /end MEASUREMENT
/begin MEASUREMENT monr_VbFH_HallSigErrLSMML_flg "" UBYTE POD_SMML_CM_boolean 0 0 0 1 ECU_ADDRESS 0xb0056045 /* @ECU_Address@monr_VbFH_HallSigErrLSMML_flg@ */ /end MEASUREMENT
/begin MEASUREMENT monr_VbFH_FrbdMaiMotWrkLSMML_flg "" UBYTE POD_SMML_CM_boolean 0 0 0 1 ECU_ADDRESS 0xb0056047 /* @ECU_Address@monr_VbFH_FrbdMaiMotWrkLSMML_flg@ */ /end MEASUREMENT
/begin MEASUREMENT monr_VbSMM_DoorFreeMovgL_flg "" UBYTE POD_SMML_CM_boolean 0 0 0 1 ECU_ADDRESS 0xb0055fe7 /* @ECU_Address@monr_VbSMM_DoorFreeMovgL_flg@ */ /end MEASUREMENT
/begin MEASUREMENT monr_VbSMM_TiptoRunEnableL_flg "" UBYTE POD_SMML_CM_boolean 0 0 0 1 ECU_ADDRESS 0xb0056052 /* @ECU_Address@monr_VbSMM_TiptoRunEnableL_flg@ */ /end MEASUREMENT
/begin MEASUREMENT monr_VbSMM_ManAsstEnableL_flg "" UBYTE POD_SMML_CM_boolean 0 0 0 1 ECU_ADDRESS 0xb0055fe8 /* @ECU_Address@monr_VbSMM_ManAsstEnableL_flg@ */ /end MEASUREMENT
/begin MEASUREMENT monr_VbSMM_BrkMotModCtrlL_flg "" UBYTE POD_SMML_CM_boolean 0 0 0 1 ECU_ADDRESS 0xb0055fec /* @ECU_Address@monr_VbSMM_BrkMotModCtrlL_flg@ */ /end MEASUREMENT
/begin MEASUREMENT monr_VbSMM_BrkFrcRelsL_flg "" UBYTE POD_SMML_CM_boolean 0 0 0 1 ECU_ADDRESS 0xb0055fee /* @ECU_Address@monr_VbSMM_BrkFrcRelsL_flg@ */ /end MEASUREMENT
/begin MEASUREMENT monr_VbSMM_RdrWrkReqL_flg "" UBYTE POD_SMML_CM_boolean 0 0 0 1 ECU_ADDRESS 0xb0055fe9 /* @ECU_Address@monr_VbSMM_RdrWrkReqL_flg@ */ /end MEASUREMENT
/begin MEASUREMENT monr_VbSMM_RdrWrkReqByCEML_flg "" UBYTE POD_SMML_CM_boolean 0 0 0 1 ECU_ADDRESS 0xb0055fea /* @ECU_Address@monr_VbSMM_RdrWrkReqByCEML_flg@ */ /end MEASUREMENT
/begin MEASUREMENT monr_VbSMM_ElecDoorClsReqL_flg "" UBYTE POD_SMML_CM_boolean 0 0 0 1 ECU_ADDRESS 0xb0055ff0 /* @ECU_Address@monr_VbSMM_ElecDoorClsReqL_flg@ */ /end MEASUREMENT
/begin MEASUREMENT monr_VbSMM_ElecDoorOpenReqL_flg "" UBYTE POD_SMML_CM_boolean 0 0 0 1 ECU_ADDRESS 0xb0055ff3 /* @ECU_Address@monr_VbSMM_ElecDoorOpenReqL_flg@ */ /end MEASUREMENT
/begin MEASUREMENT monr_VbSMM_HoldModeL_flg "" UBYTE POD_SMML_CM_boolean 0 0 0 1 ECU_ADDRESS 0xb0055ff2 /* @ECU_Address@monr_VbSMM_HoldModeL_flg@ */ /end MEASUREMENT
/begin COMPU_METHOD POD_SMML_CM_single "Q = V" RAT_FUNC "%8.6" "" COEFFS 0 1 0 0 0 1 /end COMPU_METHOD
/begin COMPU_METHOD POD_SMML_CM_int16 "Q = V" RAT_FUNC "%5.0" "" COEFFS 0 1 0 0 0 1 /end COMPU_METHOD
/begin COMPU_METHOD POD_SMML_CM_uint8 "Q = V" RAT_FUNC "%3.0" "" COEFFS 0 1 0 0 0 1 /end COMPU_METHOD
/begin COMPU_METHOD POD_SMML_CM_boolean "Q = V" RAT_FUNC "%1.0" "" COEFFS 0 1 0 0 0 1 /end COMPU_METHOD
/begin GROUP POD_SMML "POD_SMML" ROOT /begin SUB_GROUP Root_POD_StateManageMduleL_Step_sys /end SUB_GROUP /end GROUP
/begin GROUP Root_POD_StateManageMduleL_Step_sys "POD_SMML/POD_StateManageMduleL_Step_sys" /begin SUB_GROUP S1_POD_StateManageMduleL /end SUB_GROUP
 /begin REF_MEASUREMENT monr_VbAP_AntiPinchStsDspLSMML_flg monr_VbAP_ThermprotnLSMML_flg monr_VbFH_AnptiplayLSMML_flg monr_VbFH_ECUWakeUpLSMML_flg monr_VbFH_FrbdMaiMotWrkLSMML_flg monr_VbFH_FrntIncinAgFltLSMML_flg monr_VbFH_HallSigErrLSMML_flg monr_VbFH_RdrTioutLSMML_flg monr_VbFH_SideIncinAgFltLSMML_flg monr_VbHHM_DoorOpenLSMML_flg monr_VbSHM_IceBreakDoorActvLSMML_flg monr_VbTTR_TipToRunRqstLSMML_flg monr_VeHHM_DoorMovStsLSMML_NULL monr_VeHHM_UsrSetMaxPstnLSMML_pct monr_VeMCM_CmdStateLSMML_NULL monr_VeSHM_DoorLckPstnLSMML_enum monr_VeSHM_DoorModStsSMML_enum monr_VeSHM_DoorOpenArlmLSMML_enum monr_VeSHM_DoorStsLSMML_enum monr_VeSHM_DoorTypCfgSMML_enum monr_VeSHM_DoorWrkReqLSMML_enum monr_VeSHM_DoorWrkReqSrcLSMML_enum monr_VeSHM_NVMDoorOprtStsLSMML_enum monr_VeSHM_VehSptStsSMML_enum monr_VeTTR_ManAsstRqstLSMML_enum monr_VfHHM_AswHallPositionLSMML_deg monr_VfHHM_DoorPstnLSMML_pct monr_VfHHM_MaxOpenPositionLSMML_deg monr_VfIMU_AgSpdLSMML_degps monr_VfSHM_AmbTempSMML_C monr_VfSHM_DoorRdrAgLSMML_deg monr_VfSHM_FrntIncinAgLSMML_deg monr_VfSHM_MainMotoCurrentLSMML_MA monr_VfSHM_SideIncinAgLSMML_deg monr_VsHHM_AntiPinchHallPositionLSMML_NULL monr_VsHHM_AswHallPositionLSMML_NULL monr_VsHHM_AswHallSpeedLSMML_rpm /end REF_MEASUREMENT
/end GROUP
/begin GROUP S1_POD_StateManageMduleL "POD_SMML/POD_StateManageMduleL_Step_sys/POD_StateManageMduleL"
 /begin REF_MEASUREMENT monr_VbSMM_BrkFrcRelsL_flg monr_VbSMM_BrkMotModCtrlL_flg monr_VbSMM_DoorFreeMovgL_flg monr_VbSMM_ElecDoorClsReqL_flg monr_VbSMM_ElecDoorOpenReqL_flg monr_VbSMM_HoldModeL_flg monr_VbSMM_ManAsstEnableL_flg monr_VbSMM_RdrWrkReqByCEML_flg monr_VbSMM_RdrWrkReqL_flg monr_VbSMM_TiptoRunEnableL_flg monr_VeSMM_DOPFcnStateL_enum monr_VeSMM_DoorLatPosnL_enum monr_VeSMM_HoverModCtrlL_enum monr_VeSMM_MotorCtrlModeL_enum monr_VeSMM_MotorCtrlStateL_enum monr_VeSMM_OpenDoorCmdL_enum monr_VeSMM_PushLockL_NULL monr_VeSMM_StopEventL_enum monr_VeSMM_VehModStsL_enum monr_VfSMM_TopDegforDoorOpenL_NULL /end REF_MEASUREMENT
/end GROUP
/begin MEASUREMENT monr_VfHHM_MaxOpenPositionRSMMR_deg "" FLOAT32_IEEE POD_SMMR_CM_single 0 0 -3.4E+38 3.4E+38 ECU_ADDRESS 0xb0056078 /* @ECU_Address@monr_VfHHM_MaxOpenPositionRSMMR_deg@ */ /end MEASUREMENT
/begin MEASUREMENT monr_VfHHM_AswHallPositionRSMMR_deg "" FLOAT32_IEEE POD_SMMR_CM_single 0 0 -3.4E+38 3.4E+38 ECU_ADDRESS 0xb0056080 /* @ECU_Address@monr_VfHHM_AswHallPositionRSMMR_deg@ */ /end MEASUREMENT
/begin MEASUREMENT monr_VfHHM_DoorPstnRSMMR_pct "" FLOAT32_IEEE POD_SMMR_CM_single 0 0 -3.4E+38 3.4E+38 ECU_ADDRESS 0xb0056060 /* @ECU_Address@monr_VfHHM_DoorPstnRSMMR_pct@ */ /end MEASUREMENT
/begin MEASUREMENT monr_VfIMU_AgSpdRSMMR_degps "" FLOAT32_IEEE POD_SMMR_CM_single 0 0 -3.4E+38 3.4E+38 ECU_ADDRESS 0xb005605c /* @ECU_Address@monr_VfIMU_AgSpdRSMMR_degps@ */ /end MEASUREMENT
/begin MEASUREMENT monr_VfSHM_MainMotoCurrentRSMMR_MA "" FLOAT32_IEEE POD_SMMR_CM_single 0 0 -3.4E+38 3.4E+38 ECU_ADDRESS 0xb0056068 /* @ECU_Address@monr_VfSHM_MainMotoCurrentRSMMR_MA@ */ /end MEASUREMENT
/begin MEASUREMENT monr_VfSHM_AmbTempSMMR_C "" FLOAT32_IEEE POD_SMMR_CM_single 0 0 -3.4E+38 3.4E+38 ECU_ADDRESS 0xb005606c /* @ECU_Address@monr_VfSHM_AmbTempSMMR_C@ */ /end MEASUREMENT
/begin MEASUREMENT monr_VfSHM_FrntIncinAgRSMMR_deg "" FLOAT32_IEEE POD_SMMR_CM_single 0 0 -3.4E+38 3.4E+38 ECU_ADDRESS 0xb0056094 /* @ECU_Address@monr_VfSHM_FrntIncinAgRSMMR_deg@ */ /end MEASUREMENT
/begin MEASUREMENT monr_VfSHM_SideIncinAgRSMMR_deg "" FLOAT32_IEEE POD_SMMR_CM_single 0 0 -3.4E+38 3.4E+38 ECU_ADDRESS 0xb005609c /* @ECU_Address@monr_VfSHM_SideIncinAgRSMMR_deg@ */ /end MEASUREMENT
/begin MEASUREMENT monr_VfSHM_DoorRdrAgRSMMR_deg "" FLOAT32_IEEE POD_SMMR_CM_single 0 0 -3.4E+38 3.4E+38 ECU_ADDRESS 0xb00560a0 /* @ECU_Address@monr_VfSHM_DoorRdrAgRSMMR_deg@ */ /end MEASUREMENT
/begin MEASUREMENT monr_VfSMM_TopDegforDoorOpenR_NULL "" FLOAT32_IEEE POD_SMMR_CM_single 0 0 -3.4E+38 3.4E+38 ECU_ADDRESS 0xb00560ac /* @ECU_Address@monr_VfSMM_TopDegforDoorOpenR_NULL@ */ /end MEASUREMENT
/begin MEASUREMENT monr_VsHHM_AswHallPositionRSMMR_NULL "" SWORD POD_SMMR_CM_int16 0 0 -32768 32767 ECU_ADDRESS 0xb005607c /* @ECU_Address@monr_VsHHM_AswHallPositionRSMMR_NULL@ */ /end MEASUREMENT
/begin MEASUREMENT monr_VsHHM_AntiPinchHallPositionRSMMR_NULL "" SWORD POD_SMMR_CM_int16 0 0 -32768 32767 ECU_ADDRESS 0xb0056076 /* @ECU_Address@monr_VsHHM_AntiPinchHallPositionRSMMR_NULL@ */ /end MEASUREMENT
/begin MEASUREMENT monr_VsHHM_AswHallSpeedRSMMR_rpm "" SWORD POD_SMMR_CM_int16 0 0 -32768 32767 ECU_ADDRESS 0xb0056084 /* @ECU_Address@monr_VsHHM_AswHallSpeedRSMMR_rpm@ */ /end MEASUREMENT
/begin MEASUREMENT monr_VeSHM_NVMDoorOprtStsRSMMR_enum "" UBYTE POD_SMMR_CM_uint8 0 0 0 255 ECU_ADDRESS 0xb005608d /* @ECU_Address@monr_VeSHM_NVMDoorOprtStsRSMMR_enum@ */ /end MEASUREMENT
/begin MEASUREMENT monr_VeSHM_DoorWrkReqRSMMR_enum "" UBYTE POD_SMMR_CM_uint8 0 0 0 255 ECU_ADDRESS 0xb0056065 /* @ECU_Address@monr_VeSHM_DoorWrkReqRSMMR_enum@ */ /end MEASUREMENT
/begin MEASUREMENT monr_VeSHM_DoorWrkReqSrcRSMMR_enum "" UBYTE POD_SMMR_CM_uint8 0 0 0 255 ECU_ADDRESS 0xb005607e /* @ECU_Address@monr_VeSHM_DoorWrkReqSrcRSMMR_enum@ */ /end MEASUREMENT
/begin MEASUREMENT monr_VeSHM_DoorStsRSMMR_enum "" UBYTE POD_SMMR_CM_uint8 0 0 0 255 ECU_ADDRESS 0xb00560bf /* @ECU_Address@monr_VeSHM_DoorStsRSMMR_enum@ */ /end MEASUREMENT
/begin MEASUREMENT monr_VeSHM_DoorLckPstnRSMMR_enum "" UBYTE POD_SMMR_CM_uint8 0 0 0 255 ECU_ADDRESS 0xb00560a6 /* @ECU_Address@monr_VeSHM_DoorLckPstnRSMMR_enum@ */ /end MEASUREMENT
/begin MEASUREMENT monr_VeSHM_VehSptStsSMMR_enum "" UBYTE POD_SMMR_CM_uint8 0 0 0 255 ECU_ADDRESS 0xb00560c1 /* @ECU_Address@monr_VeSHM_VehSptStsSMMR_enum@ */ /end MEASUREMENT
/begin MEASUREMENT monr_VeSHM_DoorOpenArlmRSMMR_enum "" UBYTE POD_SMMR_CM_uint8 0 0 0 255 ECU_ADDRESS 0xb0056054 /* @ECU_Address@monr_VeSHM_DoorOpenArlmRSMMR_enum@ */ /end MEASUREMENT
/begin MEASUREMENT monr_VeSHM_DoorModStsSMMR_enum "" UBYTE POD_SMMR_CM_uint8 0 0 0 255 ECU_ADDRESS 0xb0056056 /* @ECU_Address@monr_VeSHM_DoorModStsSMMR_enum@ */ /end MEASUREMENT
/begin MEASUREMENT monr_VeHHM_UsrSetMaxPstnRSMMR_pct "" UBYTE POD_SMMR_CM_uint8 0 0 0 255 ECU_ADDRESS 0xb0056058 /* @ECU_Address@monr_VeHHM_UsrSetMaxPstnRSMMR_pct@ */ /end MEASUREMENT
/begin MEASUREMENT monr_VeHHM_DoorMovStsRSMMR_NULL "" UBYTE POD_SMMR_CM_uint8 0 0 0 255 ECU_ADDRESS 0xb0056074 /* @ECU_Address@monr_VeHHM_DoorMovStsRSMMR_NULL@ */ /end MEASUREMENT
/begin MEASUREMENT monr_VeTTR_ManAsstRqstRSMMR_enum "" UBYTE POD_SMMR_CM_uint8 0 0 0 255 ECU_ADDRESS 0xb0056070 /* @ECU_Address@monr_VeTTR_ManAsstRqstRSMMR_enum@ */ /end MEASUREMENT
/begin MEASUREMENT monr_VeMCM_CmdStateRSMMR_NULL "" UBYTE POD_SMMR_CM_uint8 0 0 0 255 ECU_ADDRESS 0xb005608a /* @ECU_Address@monr_VeMCM_CmdStateRSMMR_NULL@ */ /end MEASUREMENT
/begin MEASUREMENT monr_VeSHM_DoorTypCfgSMMR_enum "" UBYTE POD_SMMR_CM_uint8 0 0 0 255 ECU_ADDRESS 0xb005608b /* @ECU_Address@monr_VeSHM_DoorTypCfgSMMR_enum@ */ /end MEASUREMENT
/begin MEASUREMENT monr_VeSMM_DOPFcnStateR_enum "" UBYTE POD_SMMR_CM_uint8 0 0 0 255 ECU_ADDRESS 0xb00560a5 /* @ECU_Address@monr_VeSMM_DOPFcnStateR_enum@ */ /end MEASUREMENT
/begin MEASUREMENT monr_VeSMM_MotorCtrlModeR_enum "" UBYTE POD_SMMR_CM_uint8 0 0 0 255 ECU_ADDRESS 0xb00560a7 /* @ECU_Address@monr_VeSMM_MotorCtrlModeR_enum@ */ /end MEASUREMENT
/begin MEASUREMENT monr_VeSMM_MotorCtrlStateR_enum "" UBYTE POD_SMMR_CM_uint8 0 0 0 255 ECU_ADDRESS 0xb00560a8 /* @ECU_Address@monr_VeSMM_MotorCtrlStateR_enum@ */ /end MEASUREMENT
/begin MEASUREMENT monr_VeSMM_DoorLatPosnR_enum "" UBYTE POD_SMMR_CM_uint8 0 0 0 255 ECU_ADDRESS 0xb00560a9 /* @ECU_Address@monr_VeSMM_DoorLatPosnR_enum@ */ /end MEASUREMENT
/begin MEASUREMENT monr_VeSMM_OpenDoorCmdR_enum "" UBYTE POD_SMMR_CM_uint8 0 0 0 255 ECU_ADDRESS 0xb00560aa /* @ECU_Address@monr_VeSMM_OpenDoorCmdR_enum@ */ /end MEASUREMENT
/begin MEASUREMENT monr_VeSMM_PushLockR_NULL "" UBYTE POD_SMMR_CM_uint8 0 0 0 255 ECU_ADDRESS 0xb00560ab /* @ECU_Address@monr_VeSMM_PushLockR_NULL@ */ /end MEASUREMENT
/begin MEASUREMENT monr_VeSMM_StopEventR_enum "" UBYTE POD_SMMR_CM_uint8 0 0 0 255 ECU_ADDRESS 0xb00560b0 /* @ECU_Address@monr_VeSMM_StopEventR_enum@ */ /end MEASUREMENT
/begin MEASUREMENT monr_VeSMM_VehModStsR_enum "" UBYTE POD_SMMR_CM_uint8 0 0 0 255 ECU_ADDRESS 0xb00560b1 /* @ECU_Address@monr_VeSMM_VehModStsR_enum@ */ /end MEASUREMENT
/begin MEASUREMENT monr_VeSMM_HoverModCtrlR_enum "" UBYTE POD_SMMR_CM_uint8 0 0 0 255 ECU_ADDRESS 0xb00560b6 /* @ECU_Address@monr_VeSMM_HoverModCtrlR_enum@ */ /end MEASUREMENT
/begin MEASUREMENT monr_VbFH_ECUWakeUpRSMMR_flg "" UBYTE POD_SMMR_CM_boolean 0 0 0 1 ECU_ADDRESS 0xb0056053 /* @ECU_Address@monr_VbFH_ECUWakeUpRSMMR_flg@ */ /end MEASUREMENT
/begin MEASUREMENT monr_VbSHM_IceBreakDoorActvRSMMR_flg "" UBYTE POD_SMMR_CM_boolean 0 0 0 1 ECU_ADDRESS 0xb005608e /* @ECU_Address@monr_VbSHM_IceBreakDoorActvRSMMR_flg@ */ /end MEASUREMENT
/begin MEASUREMENT monr_VbAP_AntiPinchStsDspRSMMR_flg "" UBYTE POD_SMMR_CM_boolean 0 0 0 1 ECU_ADDRESS 0xb005605a /* @ECU_Address@monr_VbAP_AntiPinchStsDspRSMMR_flg@ */ /end MEASUREMENT
/begin MEASUREMENT monr_VbFH_AnptiplayRSMMR_flg "" UBYTE POD_SMMR_CM_boolean 0 0 0 1 ECU_ADDRESS 0xb0056073 /* @ECU_Address@monr_VbFH_AnptiplayRSMMR_flg@ */ /end MEASUREMENT
/begin MEASUREMENT monr_VbFH_ThermprotnRSMMR_flg "" UBYTE POD_SMMR_CM_boolean 0 0 0 1 ECU_ADDRESS 0xb0056071 /* @ECU_Address@monr_VbFH_ThermprotnRSMMR_flg@ */ /end MEASUREMENT
/begin MEASUREMENT monr_VbHHM_DoorOpenRSMMR_flg "" UBYTE POD_SMMR_CM_boolean 0 0 0 1 ECU_ADDRESS 0xb0056072 /* @ECU_Address@monr_VbHHM_DoorOpenRSMMR_flg@ */ /end MEASUREMENT
/begin MEASUREMENT monr_VbTTR_TipToRunRqstRSMMR_flg "" UBYTE POD_SMMR_CM_boolean 0 0 0 1 ECU_ADDRESS 0xb0056064 /* @ECU_Address@monr_VbTTR_TipToRunRqstRSMMR_flg@ */ /end MEASUREMENT
/begin MEASUREMENT monr_VbFH_FrntIncinAgFltRSMMR_flg "" UBYTE POD_SMMR_CM_boolean 0 0 0 1 ECU_ADDRESS 0xb0056098 /* @ECU_Address@monr_VbFH_FrntIncinAgFltRSMMR_flg@ */ /end MEASUREMENT
/begin MEASUREMENT monr_VbFH_SideIncinAgFltRSMMR_flg "" UBYTE POD_SMMR_CM_boolean 0 0 0 1 ECU_ADDRESS 0xb0056099 /* @ECU_Address@monr_VbFH_SideIncinAgFltRSMMR_flg@ */ /end MEASUREMENT
/begin MEASUREMENT monr_VbFH_RdrTioutRSMMR_flg "" UBYTE POD_SMMR_CM_boolean 0 0 0 1 ECU_ADDRESS 0xb0056088 /* @ECU_Address@monr_VbFH_RdrTioutRSMMR_flg@ */ /end MEASUREMENT
/begin MEASUREMENT monr_VbFH_HallSigErrRSMMR_flg "" UBYTE POD_SMMR_CM_boolean 0 0 0 1 ECU_ADDRESS 0xb00560a4 /* @ECU_Address@monr_VbFH_HallSigErrRSMMR_flg@ */ /end MEASUREMENT
/begin MEASUREMENT monr_VbFH_FrbdMaiMotWrkRSMMR_flg "" UBYTE POD_SMMR_CM_boolean 0 0 0 1 ECU_ADDRESS 0xb0056089 /* @ECU_Address@monr_VbFH_FrbdMaiMotWrkRSMMR_flg@ */ /end MEASUREMENT
/begin MEASUREMENT monr_VbSMM_DoorFreeMovgR_flg "" UBYTE POD_SMMR_CM_boolean 0 0 0 1 ECU_ADDRESS 0xb00560b2 /* @ECU_Address@monr_VbSMM_DoorFreeMovgR_flg@ */ /end MEASUREMENT
/begin MEASUREMENT monr_VbSMM_TiptoRunEnableR_flg "" UBYTE POD_SMMR_CM_boolean 0 0 0 1 ECU_ADDRESS 0xb00560b3 /* @ECU_Address@monr_VbSMM_TiptoRunEnableR_flg@ */ /end MEASUREMENT
/begin MEASUREMENT monr_VbSMM_ManAsstEnableR_flg "" UBYTE POD_SMMR_CM_boolean 0 0 0 1 ECU_ADDRESS 0xb00560b5 /* @ECU_Address@monr_VbSMM_ManAsstEnableR_flg@ */ /end MEASUREMENT
/begin MEASUREMENT monr_VbSMM_BrkMotModCtrlR_flg "" UBYTE POD_SMMR_CM_boolean 0 0 0 1 ECU_ADDRESS 0xb00560b7 /* @ECU_Address@monr_VbSMM_BrkMotModCtrlR_flg@ */ /end MEASUREMENT
/begin MEASUREMENT monr_VbSMM_BrkFrcRelsR_flg "" UBYTE POD_SMMR_CM_boolean 0 0 0 1 ECU_ADDRESS 0xb00560b8 /* @ECU_Address@monr_VbSMM_BrkFrcRelsR_flg@ */ /end MEASUREMENT
/begin MEASUREMENT monr_VbSMM_RdrWrkReqR_flg "" UBYTE POD_SMMR_CM_boolean 0 0 0 1 ECU_ADDRESS 0xb00560b9 /* @ECU_Address@monr_VbSMM_RdrWrkReqR_flg@ */ /end MEASUREMENT
/begin MEASUREMENT monr_VbSMM_RdrWrkReqByCEMR_flg "" UBYTE POD_SMMR_CM_boolean 0 0 0 1 ECU_ADDRESS 0xb00560bb /* @ECU_Address@monr_VbSMM_RdrWrkReqByCEMR_flg@ */ /end MEASUREMENT
/begin MEASUREMENT monr_VbSMM_ElecDoorClsReqR_flg "" UBYTE POD_SMMR_CM_boolean 0 0 0 1 ECU_ADDRESS 0xb00560bc /* @ECU_Address@monr_VbSMM_ElecDoorClsReqR_flg@ */ /end MEASUREMENT
/begin MEASUREMENT monr_VbSMM_ElecDoorOpenReqR_flg "" UBYTE POD_SMMR_CM_boolean 0 0 0 1 ECU_ADDRESS 0xb00560bd /* @ECU_Address@monr_VbSMM_ElecDoorOpenReqR_flg@ */ /end MEASUREMENT
/begin MEASUREMENT monr_VbSMM_HoldModeR_flg "" UBYTE POD_SMMR_CM_boolean 0 0 0 1 ECU_ADDRESS 0xb00560be /* @ECU_Address@monr_VbSMM_HoldModeR_flg@ */ /end MEASUREMENT
/begin COMPU_METHOD POD_SMMR_CM_single "Q = V" RAT_FUNC "%8.6" "" COEFFS 0 1 0 0 0 1 /end COMPU_METHOD
/begin COMPU_METHOD POD_SMMR_CM_int16 "Q = V" RAT_FUNC "%5.0" "" COEFFS 0 1 0 0 0 1 /end COMPU_METHOD
/begin COMPU_METHOD POD_SMMR_CM_uint8 "Q = V" RAT_FUNC "%3.0" "" COEFFS 0 1 0 0 0 1 /end COMPU_METHOD
/begin COMPU_METHOD POD_SMMR_CM_boolean "Q = V" RAT_FUNC "%1.0" "" COEFFS 0 1 0 0 0 1 /end COMPU_METHOD
/begin GROUP POD_SMMR "POD_SMMR" ROOT /begin SUB_GROUP Root_POD_StateManageMduleR_Step_sys /end SUB_GROUP /end GROUP
/begin GROUP Root_POD_StateManageMduleR_Step_sys "POD_SMMR/POD_StateManageMduleR_Step_sys" /begin SUB_GROUP S1_POD_StateManageMduleR /end SUB_GROUP
 /begin REF_MEASUREMENT monr_VbAP_AntiPinchStsDspRSMMR_flg monr_VbFH_AnptiplayRSMMR_flg monr_VbFH_ECUWakeUpRSMMR_flg monr_VbFH_FrbdMaiMotWrkRSMMR_flg monr_VbFH_FrntIncinAgFltRSMMR_flg monr_VbFH_HallSigErrRSMMR_flg monr_VbFH_RdrTioutRSMMR_flg monr_VbFH_SideIncinAgFltRSMMR_flg monr_VbFH_ThermprotnRSMMR_flg monr_VbHHM_DoorOpenRSMMR_flg monr_VbSHM_IceBreakDoorActvRSMMR_flg monr_VbTTR_TipToRunRqstRSMMR_flg monr_VeHHM_DoorMovStsRSMMR_NULL monr_VeHHM_UsrSetMaxPstnRSMMR_pct monr_VeMCM_CmdStateRSMMR_NULL monr_VeSHM_DoorLckPstnRSMMR_enum monr_VeSHM_DoorModStsSMMR_enum monr_VeSHM_DoorOpenArlmRSMMR_enum monr_VeSHM_DoorStsRSMMR_enum monr_VeSHM_DoorTypCfgSMMR_enum monr_VeSHM_DoorWrkReqRSMMR_enum monr_VeSHM_DoorWrkReqSrcRSMMR_enum monr_VeSHM_NVMDoorOprtStsRSMMR_enum monr_VeSHM_VehSptStsSMMR_enum monr_VeTTR_ManAsstRqstRSMMR_enum monr_VfHHM_AswHallPositionRSMMR_deg monr_VfHHM_DoorPstnRSMMR_pct monr_VfHHM_MaxOpenPositionRSMMR_deg monr_VfIMU_AgSpdRSMMR_degps monr_VfSHM_AmbTempSMMR_C monr_VfSHM_DoorRdrAgRSMMR_deg monr_VfSHM_FrntIncinAgRSMMR_deg monr_VfSHM_MainMotoCurrentRSMMR_MA monr_VfSHM_SideIncinAgRSMMR_deg monr_VsHHM_AntiPinchHallPositionRSMMR_NULL monr_VsHHM_AswHallPositionRSMMR_NULL monr_VsHHM_AswHallSpeedRSMMR_rpm /end REF_MEASUREMENT
/end GROUP
/begin GROUP S1_POD_StateManageMduleR "POD_SMMR/POD_StateManageMduleR_Step_sys/POD_StateManageMduleR"
 /begin REF_MEASUREMENT monr_VbSMM_BrkFrcRelsR_flg monr_VbSMM_BrkMotModCtrlR_flg monr_VbSMM_DoorFreeMovgR_flg monr_VbSMM_ElecDoorClsReqR_flg monr_VbSMM_ElecDoorOpenReqR_flg monr_VbSMM_HoldModeR_flg monr_VbSMM_ManAsstEnableR_flg monr_VbSMM_RdrWrkReqByCEMR_flg monr_VbSMM_RdrWrkReqR_flg monr_VbSMM_TiptoRunEnableR_flg monr_VeSMM_DOPFcnStateR_enum monr_VeSMM_DoorLatPosnR_enum monr_VeSMM_HoverModCtrlR_enum monr_VeSMM_MotorCtrlModeR_enum monr_VeSMM_MotorCtrlStateR_enum monr_VeSMM_OpenDoorCmdR_enum monr_VeSMM_PushLockR_NULL monr_VeSMM_StopEventR_enum monr_VeSMM_VehModStsR_enum monr_VfSMM_TopDegforDoorOpenR_NULL /end REF_MEASUREMENT
/end GROUP
/begin CHARACTERISTIC k_TTR_Ti_DoorOpenStartTimer "" VALUE 0xb00064bc /* @ECU_Address@k_TTR_Ti_DoorOpenStartTimer@ */ Scalar_FLOAT32_IEEE 0 POD_TipToRun_CM_single -3.4E+38 3.4E+38 /end CHARACTERISTIC
/begin CHARACTERISTIC k_TTR_Ti_SequenceTimer "" VALUE 0xb00064e4 /* @ECU_Address@k_TTR_Ti_SequenceTimer@ */ Scalar_FLOAT32_IEEE 0 POD_TipToRun_CM_single -3.4E+38 3.4E+38 /end CHARACTERISTIC
/begin MEASUREMENT monr_VfSHM_FrntIncinAgRTTR_deg "" FLOAT32_IEEE POD_TipToRun_CM_single 0 0 -3.4E+38 3.4E+38 ECU_ADDRESS 0xb005619c /* @ECU_Address@monr_VfSHM_FrntIncinAgRTTR_deg@ */ /end MEASUREMENT
/begin MEASUREMENT monr_VfSHM_SideIncinAgRTTR_deg "" FLOAT32_IEEE POD_TipToRun_CM_single 0 0 -3.4E+38 3.4E+38 ECU_ADDRESS 0xb00561a4 /* @ECU_Address@monr_VfSHM_SideIncinAgRTTR_deg@ */ /end MEASUREMENT
/begin MEASUREMENT monr_VfSHM_FrntIncinAgLTTR_deg "" FLOAT32_IEEE POD_TipToRun_CM_single 0 0 -3.4E+38 3.4E+38 ECU_ADDRESS 0xb0056198 /* @ECU_Address@monr_VfSHM_FrntIncinAgLTTR_deg@ */ /end MEASUREMENT
/begin MEASUREMENT monr_VfSHM_SideIncinAgLTTR_deg "" FLOAT32_IEEE POD_TipToRun_CM_single 0 0 -3.4E+38 3.4E+38 ECU_ADDRESS 0xb00561a0 /* @ECU_Address@monr_VfSHM_SideIncinAgLTTR_deg@ */ /end MEASUREMENT
/begin MEASUREMENT monr_VfHHM_AswHallPositionLTTR_deg "" FLOAT32_IEEE POD_TipToRun_CM_single 0 0 -3.4E+38 3.4E+38 ECU_ADDRESS 0xb0056188 /* @ECU_Address@monr_VfHHM_AswHallPositionLTTR_deg@ */ /end MEASUREMENT
/begin MEASUREMENT monr_VfHHM_AswHallPositionRTTR_deg "" FLOAT32_IEEE POD_TipToRun_CM_single 0 0 -3.4E+38 3.4E+38 ECU_ADDRESS 0xb005618c /* @ECU_Address@monr_VfHHM_AswHallPositionRTTR_deg@ */ /end MEASUREMENT
/begin MEASUREMENT monr_VsHHM_AswHallPositionLTTR_NULL "" SWORD POD_TipToRun_CM_int16 0 0 -32768 32767 ECU_ADDRESS 0xb00561ac /* @ECU_Address@monr_VsHHM_AswHallPositionLTTR_NULL@ */ /end MEASUREMENT
/begin MEASUREMENT monr_VsHHM_AswHallPositionRTTR_NULL "" SWORD POD_TipToRun_CM_int16 0 0 -32768 32767 ECU_ADDRESS 0xb00561ae /* @ECU_Address@monr_VsHHM_AswHallPositionRTTR_NULL@ */ /end MEASUREMENT
/begin MEASUREMENT monr_VsTTR_IMUAgSpdRTTR_degps "" SWORD POD_TipToRun_CM_int16 0 0 -32768 32767 ECU_ADDRESS 0xb005614a /* @ECU_Address@monr_VsTTR_IMUAgSpdRTTR_degps@ */ /end MEASUREMENT
/begin MEASUREMENT monr_VsTTR_IMUAgSpdAccRTTR_g "" SWORD POD_TipToRun_CM_int16 0 0 -32768 32767 ECU_ADDRESS 0xb0056146 /* @ECU_Address@monr_VsTTR_IMUAgSpdAccRTTR_g@ */ /end MEASUREMENT
/begin MEASUREMENT monr_VsHHM_AswHallSpeedRTTR_rpm "" SWORD POD_TipToRun_CM_int16 0 0 -32768 32767 ECU_ADDRESS 0xb00561b2 /* @ECU_Address@monr_VsHHM_AswHallSpeedRTTR_rpm@ */ /end MEASUREMENT
/begin MEASUREMENT monr_VsHHM_AntiPinchHallPositionRTTR_NULL "" SWORD POD_TipToRun_CM_int16 0 0 -32768 32767 ECU_ADDRESS 0xb00561aa /* @ECU_Address@monr_VsHHM_AntiPinchHallPositionRTTR_NULL@ */ /end MEASUREMENT
/begin MEASUREMENT monr_VsHHM_AntiPinchHallPositionLTTR_NULL "" SWORD POD_TipToRun_CM_int16 0 0 -32768 32767 ECU_ADDRESS 0xb00561a8 /* @ECU_Address@monr_VsHHM_AntiPinchHallPositionLTTR_NULL@ */ /end MEASUREMENT
/begin MEASUREMENT monr_VsHHM_AswHallSpeedLTTR_rpm "" SWORD POD_TipToRun_CM_int16 0 0 -32768 32767 ECU_ADDRESS 0xb00561b0 /* @ECU_Address@monr_VsHHM_AswHallSpeedLTTR_rpm@ */ /end MEASUREMENT
/begin MEASUREMENT monr_VsTTR_IMUAgSpdLTTR_degps "" SWORD POD_TipToRun_CM_int16 0 0 -32768 32767 ECU_ADDRESS 0xb0056148 /* @ECU_Address@monr_VsTTR_IMUAgSpdLTTR_degps@ */ /end MEASUREMENT
/begin MEASUREMENT monr_VsTTR_IMUAgSpdAccLTTR_g "" SWORD POD_TipToRun_CM_int16 0 0 -32768 32767 ECU_ADDRESS 0xb0056144 /* @ECU_Address@monr_VsTTR_IMUAgSpdAccLTTR_g@ */ /end MEASUREMENT
/begin MEASUREMENT monr_VeSMM_MotorCtrlStateLTTR_enum "" UBYTE POD_TipToRun_CM_uint8 0 0 0 255 ECU_ADDRESS 0xb005617f /* @ECU_Address@monr_VeSMM_MotorCtrlStateLTTR_enum@ */ /end MEASUREMENT
/begin MEASUREMENT monr_VeSMM_DOPFcnStateLTTR_enum "" UBYTE POD_TipToRun_CM_uint8 0 0 0 255 ECU_ADDRESS 0xb0056179 /* @ECU_Address@monr_VeSMM_DOPFcnStateLTTR_enum@ */ /end MEASUREMENT
/begin MEASUREMENT monr_VeSMM_MotorCtrlModeLTTR_enum "" UBYTE POD_TipToRun_CM_uint8 0 0 0 255 ECU_ADDRESS 0xb005617d /* @ECU_Address@monr_VeSMM_MotorCtrlModeLTTR_enum@ */ /end MEASUREMENT
/begin MEASUREMENT monr_VeSMM_MotorCtrlStateRTTR_enum "" UBYTE POD_TipToRun_CM_uint8 0 0 0 255 ECU_ADDRESS 0xb0056180 /* @ECU_Address@monr_VeSMM_MotorCtrlStateRTTR_enum@ */ /end MEASUREMENT
/begin MEASUREMENT monr_VeSMM_DOPFcnStateRTTR_enum "" UBYTE POD_TipToRun_CM_uint8 0 0 0 255 ECU_ADDRESS 0xb005617a /* @ECU_Address@monr_VeSMM_DOPFcnStateRTTR_enum@ */ /end MEASUREMENT
/begin MEASUREMENT monr_VeSMM_MotorCtrlModeRTTR_enum "" UBYTE POD_TipToRun_CM_uint8 0 0 0 255 ECU_ADDRESS 0xb005617e /* @ECU_Address@monr_VeSMM_MotorCtrlModeRTTR_enum@ */ /end MEASUREMENT
/begin MEASUREMENT monr_VeHHM_DoorMovStsRTTR_NULL "" UBYTE POD_TipToRun_CM_uint8 0 0 0 255 ECU_ADDRESS 0xb0056177 /* @ECU_Address@monr_VeHHM_DoorMovStsRTTR_NULL@ */ /end MEASUREMENT
/begin MEASUREMENT monr_VeSHM_DoorTypCfgTTR_enum "" UBYTE POD_TipToRun_CM_uint8 0 0 0 255 ECU_ADDRESS 0xb0056178 /* @ECU_Address@monr_VeSHM_DoorTypCfgTTR_enum@ */ /end MEASUREMENT
/begin MEASUREMENT monr_VeSMM_HoverModCtrlRTTR_enum "" UBYTE POD_TipToRun_CM_uint8 0 0 0 255 ECU_ADDRESS 0xb005617c /* @ECU_Address@monr_VeSMM_HoverModCtrlRTTR_enum@ */ /end MEASUREMENT
/begin MEASUREMENT monr_VeTTR_ManAsstRqstR_enum "" UBYTE POD_TipToRun_CM_uint8 0 0 0 255 ECU_ADDRESS 0xb0056184 /* @ECU_Address@monr_VeTTR_ManAsstRqstR_enum@ */ /end MEASUREMENT
/begin MEASUREMENT monr_VeHHM_DoorMovStsLTTR_NULL "" UBYTE POD_TipToRun_CM_uint8 0 0 0 255 ECU_ADDRESS 0xb0056176 /* @ECU_Address@monr_VeHHM_DoorMovStsLTTR_NULL@ */ /end MEASUREMENT
/begin MEASUREMENT monr_VeSMM_HoverModCtrlLTTR_enum "" UBYTE POD_TipToRun_CM_uint8 0 0 0 255 ECU_ADDRESS 0xb005617b /* @ECU_Address@monr_VeSMM_HoverModCtrlLTTR_enum@ */ /end MEASUREMENT
/begin MEASUREMENT monr_VeTTR_ManAsstRqstL_enum "" UBYTE POD_TipToRun_CM_uint8 0 0 0 255 ECU_ADDRESS 0xb0056183 /* @ECU_Address@monr_VeTTR_ManAsstRqstL_enum@ */ /end MEASUREMENT
/begin MEASUREMENT monr_VeSMM_StopEventLTTR_enum "" UBYTE POD_TipToRun_CM_uint8 0 0 0 255 ECU_ADDRESS 0xb0056181 /* @ECU_Address@monr_VeSMM_StopEventLTTR_enum@ */ /end MEASUREMENT
/begin MEASUREMENT monr_VeSMM_StopEventRTTR_enum "" UBYTE POD_TipToRun_CM_uint8 0 0 0 255 ECU_ADDRESS 0xb0056182 /* @ECU_Address@monr_VeSMM_StopEventRTTR_enum@ */ /end MEASUREMENT
/begin MEASUREMENT monr_VbSMM_TiptoRunEnableRTTR_flg "" UBYTE POD_TipToRun_CM_boolean 0 0 0 1 ECU_ADDRESS 0xb0056173 /* @ECU_Address@monr_VbSMM_TiptoRunEnableRTTR_flg@ */ /end MEASUREMENT
/begin MEASUREMENT monr_VbSMM_ManAsstEnableRTTR_flg "" UBYTE POD_TipToRun_CM_boolean 0 0 0 1 ECU_ADDRESS 0xb0056171 /* @ECU_Address@monr_VbSMM_ManAsstEnableRTTR_flg@ */ /end MEASUREMENT
/begin MEASUREMENT monr_VbSMM_BrkMotModCtrlRTTR_flg "" UBYTE POD_TipToRun_CM_boolean 0 0 0 1 ECU_ADDRESS 0xb005616d /* @ECU_Address@monr_VbSMM_BrkMotModCtrlRTTR_flg@ */ /end MEASUREMENT
/begin MEASUREMENT monr_VbTTR_TipToRunRqstR_flg "" UBYTE POD_TipToRun_CM_boolean 0 0 0 1 ECU_ADDRESS 0xb0056175 /* @ECU_Address@monr_VbTTR_TipToRunRqstR_flg@ */ /end MEASUREMENT
/begin MEASUREMENT monr_VbSMM_DoorFreeMovgRTTR_flg "" UBYTE POD_TipToRun_CM_boolean 0 0 0 1 ECU_ADDRESS 0xb005616f /* @ECU_Address@monr_VbSMM_DoorFreeMovgRTTR_flg@ */ /end MEASUREMENT
/begin MEASUREMENT monr_VbSMM_TiptoRunEnableLTTR_flg "" UBYTE POD_TipToRun_CM_boolean 0 0 0 1 ECU_ADDRESS 0xb0056172 /* @ECU_Address@monr_VbSMM_TiptoRunEnableLTTR_flg@ */ /end MEASUREMENT
/begin MEASUREMENT monr_VbSMM_ManAsstEnableLTTR_flg "" UBYTE POD_TipToRun_CM_boolean 0 0 0 1 ECU_ADDRESS 0xb0056170 /* @ECU_Address@monr_VbSMM_ManAsstEnableLTTR_flg@ */ /end MEASUREMENT
/begin MEASUREMENT monr_VbTTR_TipToRunRqstL_flg "" UBYTE POD_TipToRun_CM_boolean 0 0 0 1 ECU_ADDRESS 0xb0056174 /* @ECU_Address@monr_VbTTR_TipToRunRqstL_flg@ */ /end MEASUREMENT
/begin MEASUREMENT monr_VbSMM_BrkMotModCtrlLTTR_flg "" UBYTE POD_TipToRun_CM_boolean 0 0 0 1 ECU_ADDRESS 0xb005616c /* @ECU_Address@monr_VbSMM_BrkMotModCtrlLTTR_flg@ */ /end MEASUREMENT
/begin MEASUREMENT monr_VbSMM_DoorFreeMovgLTTR_flg "" UBYTE POD_TipToRun_CM_boolean 0 0 0 1 ECU_ADDRESS 0xb005616e /* @ECU_Address@monr_VbSMM_DoorFreeMovgLTTR_flg@ */ /end MEASUREMENT
/begin MEASUREMENT monr_VbFH_HallSigErrLTTR_flg "" UBYTE POD_TipToRun_CM_boolean 0 0 0 1 ECU_ADDRESS 0xb005616a /* @ECU_Address@monr_VbFH_HallSigErrLTTR_flg@ */ /end MEASUREMENT
/begin MEASUREMENT monr_VbFH_HallSigErrRTTR_flg "" UBYTE POD_TipToRun_CM_boolean 0 0 0 1 ECU_ADDRESS 0xb005616b /* @ECU_Address@monr_VbFH_HallSigErrRTTR_flg@ */ /end MEASUREMENT
/begin MEASUREMENT monr_VbFH_GyroSigFltLTTR_flg "" UBYTE POD_TipToRun_CM_boolean 0 0 0 1 ECU_ADDRESS 0xb0056168 /* @ECU_Address@monr_VbFH_GyroSigFltLTTR_flg@ */ /end MEASUREMENT
/begin MEASUREMENT monr_VbFH_GyroSigFltRTTR_flg "" UBYTE POD_TipToRun_CM_boolean 0 0 0 1 ECU_ADDRESS 0xb0056169 /* @ECU_Address@monr_VbFH_GyroSigFltRTTR_flg@ */ /end MEASUREMENT
/begin COMPU_METHOD POD_TipToRun_CM_single "Q = V" RAT_FUNC "%8.6" "" COEFFS 0 1 0 0 0 1 /end COMPU_METHOD
/begin COMPU_METHOD POD_TipToRun_CM_int16 "Q = V" RAT_FUNC "%5.0" "" COEFFS 0 1 0 0 0 1 /end COMPU_METHOD
/begin COMPU_METHOD POD_TipToRun_CM_uint8 "Q = V" RAT_FUNC "%3.0" "" COEFFS 0 1 0 0 0 1 /end COMPU_METHOD
/begin COMPU_METHOD POD_TipToRun_CM_boolean "Q = V" RAT_FUNC "%1.0" "" COEFFS 0 1 0 0 0 1 /end COMPU_METHOD
/begin GROUP POD_TipToRun "POD_TipToRun" ROOT /begin SUB_GROUP Root_POD_TipToRun /end SUB_GROUP /end GROUP
/begin GROUP Root_POD_TipToRun "POD_TipToRun/POD_TipToRun" /begin SUB_GROUP S2_TipToRun /end SUB_GROUP
 /begin REF_MEASUREMENT monr_VbFH_GyroSigFltLTTR_flg monr_VbFH_GyroSigFltRTTR_flg monr_VbFH_HallSigErrLTTR_flg monr_VbFH_HallSigErrRTTR_flg monr_VbSMM_BrkMotModCtrlLTTR_flg monr_VbSMM_BrkMotModCtrlRTTR_flg monr_VbSMM_DoorFreeMovgLTTR_flg monr_VbSMM_DoorFreeMovgRTTR_flg monr_VbSMM_ManAsstEnableLTTR_flg monr_VbSMM_ManAsstEnableRTTR_flg monr_VbSMM_TiptoRunEnableLTTR_flg monr_VbSMM_TiptoRunEnableRTTR_flg monr_VeHHM_DoorMovStsLTTR_NULL monr_VeHHM_DoorMovStsRTTR_NULL monr_VeSHM_DoorTypCfgTTR_enum monr_VeSMM_DOPFcnStateLTTR_enum monr_VeSMM_DOPFcnStateRTTR_enum monr_VeSMM_HoverModCtrlLTTR_enum monr_VeSMM_HoverModCtrlRTTR_enum monr_VeSMM_MotorCtrlModeLTTR_enum monr_VeSMM_MotorCtrlModeRTTR_enum monr_VeSMM_MotorCtrlStateLTTR_enum monr_VeSMM_MotorCtrlStateRTTR_enum monr_VeSMM_StopEventLTTR_enum monr_VeSMM_StopEventRTTR_enum monr_VfHHM_AswHallPositionLTTR_deg monr_VfHHM_AswHallPositionRTTR_deg monr_VfSHM_FrntIncinAgLTTR_deg monr_VfSHM_FrntIncinAgRTTR_deg monr_VfSHM_SideIncinAgLTTR_deg monr_VfSHM_SideIncinAgRTTR_deg monr_VsHHM_AntiPinchHallPositionLTTR_NULL monr_VsHHM_AntiPinchHallPositionRTTR_NULL monr_VsHHM_AswHallPositionLTTR_NULL monr_VsHHM_AswHallPositionRTTR_NULL monr_VsHHM_AswHallSpeedLTTR_rpm monr_VsHHM_AswHallSpeedRTTR_rpm /end REF_MEASUREMENT
/end GROUP
/begin GROUP S2_TipToRun "POD_TipToRun/POD_TipToRun/TipToRun" /begin SUB_GROUP S3_TipToRunL S3_TipToRunR /end SUB_GROUP /begin REF_MEASUREMENT monr_VeTTR_ManAsstRqstL_enum monr_VeTTR_ManAsstRqstR_enum /end REF_MEASUREMENT /end GROUP
/begin GROUP S3_TipToRunL "POD_TipToRun/POD_TipToRun/TipToRun/TipToRunL" /begin SUB_GROUP S4_IMU S4_ManAsstRqst S4_TipToRunRqst /end SUB_GROUP /end GROUP
/begin GROUP S3_TipToRunR "POD_TipToRun/POD_TipToRun/TipToRun/TipToRunR" /begin SUB_GROUP S5_IMU S5_ManAsstRqst S5_TipToRunRqst /end SUB_GROUP /end GROUP
/begin GROUP S4_IMU "POD_TipToRun/POD_TipToRun/TipToRun/TipToRunL/IMU" /begin SUB_GROUP S6_Rising_Debounce S6_Rising_Debounce1 /end SUB_GROUP /begin REF_MEASUREMENT monr_VsTTR_IMUAgSpdAccLTTR_g monr_VsTTR_IMUAgSpdLTTR_degps /end REF_MEASUREMENT /end GROUP
/begin GROUP S4_ManAsstRqst "POD_TipToRun/POD_TipToRun/TipToRun/TipToRunL/ManAsstRqst" /begin SUB_GROUP S7_ElecToAssist S7_ManualSpdBack S7_StopToAssist /end SUB_GROUP /end GROUP
/begin GROUP S4_TipToRunRqst "POD_TipToRun/POD_TipToRun/TipToRun/TipToRunL/TipToRunRqst" /begin SUB_GROUP S8_ForR_Para /end SUB_GROUP /begin REF_MEASUREMENT monr_VbTTR_TipToRunRqstL_flg /end REF_MEASUREMENT /end GROUP
/begin GROUP S5_IMU "POD_TipToRun/POD_TipToRun/TipToRun/TipToRunR/IMU" /begin SUB_GROUP S174_Rising_Debounce S174_Rising_Debounce1 /end SUB_GROUP /begin REF_MEASUREMENT monr_VsTTR_IMUAgSpdAccRTTR_g monr_VsTTR_IMUAgSpdRTTR_degps /end REF_MEASUREMENT /end GROUP
/begin GROUP S5_ManAsstRqst "POD_TipToRun/POD_TipToRun/TipToRun/TipToRunR/ManAsstRqst" /begin SUB_GROUP S175_ElecToAssist S175_ManualSpdBack S175_StopToAssist /end SUB_GROUP /end GROUP
/begin GROUP S5_TipToRunRqst "POD_TipToRun/POD_TipToRun/TipToRun/TipToRunR/TipToRunRqst" /begin SUB_GROUP S176_ForR_Para /end SUB_GROUP /begin REF_MEASUREMENT monr_VbTTR_TipToRunRqstR_flg /end REF_MEASUREMENT /end GROUP
/begin GROUP S6_Rising_Debounce "POD_TipToRun/POD_TipToRun/TipToRun/TipToRunL/IMU/Rising Debounce" /begin REF_CHARACTERISTIC k_TTR_Ti_DoorOpenStartTimer k_TTR_Ti_SequenceTimer /end REF_CHARACTERISTIC /end GROUP
/begin GROUP S6_Rising_Debounce1 "POD_TipToRun/POD_TipToRun/TipToRun/TipToRunL/IMU/Rising Debounce1" /begin REF_CHARACTERISTIC k_TTR_Ti_SequenceTimer /end REF_CHARACTERISTIC /end GROUP
/begin GROUP S7_ElecToAssist "POD_TipToRun/POD_TipToRun/TipToRun/TipToRunL/ManAsstRqst/ElecToAssist"
 /begin SUB_GROUP S15_ElecMovInBrkgIMUSpdJudge S15_ElecMovOutBrkgIMUSpdJudge S15_ElecToAssistCloseJudge S15_ElecToAssistIMUErrorSpdOrAccJudge S15_ElecToAssistIMUSpdJudge S15_ElecToAssistOpenJudge S15_ElecToManualCloseIMUAccJudge S15_ElecToManualOpenIMUAccJudge S15_ForR_Para /end SUB_GROUP
/end GROUP
/begin GROUP S7_ManualSpdBack "POD_TipToRun/POD_TipToRun/TipToRun/TipToRunL/ManAsstRqst/ManualSpdBack"
 /begin SUB_GROUP S17_ForR_Para S17_ManualAssistJudge S17_ManualCloseToOpenJudge S17_ManualOpenOrCloseMaxPos S17_ManualOpenToCloseJudge /end SUB_GROUP
/end GROUP
/begin GROUP S174_Rising_Debounce "POD_TipToRun/POD_TipToRun/TipToRun/TipToRunR/IMU/Rising Debounce" /begin REF_CHARACTERISTIC k_TTR_Ti_DoorOpenStartTimer k_TTR_Ti_SequenceTimer /end REF_CHARACTERISTIC /end GROUP
/begin GROUP S174_Rising_Debounce1 "POD_TipToRun/POD_TipToRun/TipToRun/TipToRunR/IMU/Rising Debounce1" /begin REF_CHARACTERISTIC k_TTR_Ti_SequenceTimer /end REF_CHARACTERISTIC /end GROUP
/begin GROUP S15_ElecMovInBrkgIMUSpdJudge "POD_TipToRun/POD_TipToRun/TipToRun/TipToRunL/ManAsstRqst/ElecToAssist/ElecMovInBrkgIMUSpdJudge" /begin REF_CHARACTERISTIC k_TTR_Ti_SequenceTimer /end REF_CHARACTERISTIC /end GROUP
/begin GROUP S15_ElecMovOutBrkgIMUSpdJudge "POD_TipToRun/POD_TipToRun/TipToRun/TipToRunL/ManAsstRqst/ElecToAssist/ElecMovOutBrkgIMUSpdJudge" /begin REF_CHARACTERISTIC k_TTR_Ti_SequenceTimer /end REF_CHARACTERISTIC /end GROUP
/begin GROUP S15_ElecToAssistIMUErrorSpdOrAccJudge "POD_TipToRun/POD_TipToRun/TipToRun/TipToRunL/ManAsstRqst/ElecToAssist/ElecToAssistIMUErrorSpdOrAccJudge" /begin REF_CHARACTERISTIC k_TTR_Ti_SequenceTimer /end REF_CHARACTERISTIC /end GROUP
/begin GROUP S18_Rising_Debounce "POD_TipToRun/POD_TipToRun/TipToRun/TipToRunL/ManAsstRqst/StopToAssist/Rising Debounce" /begin REF_CHARACTERISTIC k_TTR_Ti_SequenceTimer /end REF_CHARACTERISTIC /end GROUP
/begin GROUP S18_Rising_Debounce1 "POD_TipToRun/POD_TipToRun/TipToRun/TipToRunL/ManAsstRqst/StopToAssist/Rising Debounce1" /begin REF_CHARACTERISTIC k_TTR_Ti_SequenceTimer /end REF_CHARACTERISTIC /end GROUP
/begin GROUP S18_Rising_Debounce2 "POD_TipToRun/POD_TipToRun/TipToRun/TipToRunL/ManAsstRqst/StopToAssist/Rising Debounce2" /begin REF_CHARACTERISTIC k_TTR_Ti_SequenceTimer /end REF_CHARACTERISTIC /end GROUP
/begin GROUP S18_Rising_Debounce3 "POD_TipToRun/POD_TipToRun/TipToRun/TipToRunL/ManAsstRqst/StopToAssist/Rising Debounce3" /begin REF_CHARACTERISTIC k_TTR_Ti_SequenceTimer /end REF_CHARACTERISTIC /end GROUP
/begin GROUP S183_ElecMovInBrkgIMUSpdJudge "POD_TipToRun/POD_TipToRun/TipToRun/TipToRunR/ManAsstRqst/ElecToAssist/ElecMovInBrkgIMUSpdJudge" /begin REF_CHARACTERISTIC k_TTR_Ti_SequenceTimer /end REF_CHARACTERISTIC /end GROUP
/begin GROUP S183_ElecMovOutBrkgIMUSpdJudge "POD_TipToRun/POD_TipToRun/TipToRun/TipToRunR/ManAsstRqst/ElecToAssist/ElecMovOutBrkgIMUSpdJudge" /begin REF_CHARACTERISTIC k_TTR_Ti_SequenceTimer /end REF_CHARACTERISTIC /end GROUP
/begin GROUP S183_ElecToAssistIMUErrorSpdOrAccJudge "POD_TipToRun/POD_TipToRun/TipToRun/TipToRunR/ManAsstRqst/ElecToAssist/ElecToAssistIMUErrorSpdOrAccJudge" /begin REF_CHARACTERISTIC k_TTR_Ti_SequenceTimer /end REF_CHARACTERISTIC /end GROUP
/begin GROUP S186_Rising_Debounce "POD_TipToRun/POD_TipToRun/TipToRun/TipToRunR/ManAsstRqst/StopToAssist/Rising Debounce" /begin REF_CHARACTERISTIC k_TTR_Ti_SequenceTimer /end REF_CHARACTERISTIC /end GROUP
/begin GROUP S186_Rising_Debounce1 "POD_TipToRun/POD_TipToRun/TipToRun/TipToRunR/ManAsstRqst/StopToAssist/Rising Debounce1" /begin REF_CHARACTERISTIC k_TTR_Ti_SequenceTimer /end REF_CHARACTERISTIC /end GROUP
/begin GROUP S186_Rising_Debounce2 "POD_TipToRun/POD_TipToRun/TipToRun/TipToRunR/ManAsstRqst/StopToAssist/Rising Debounce2" /begin REF_CHARACTERISTIC k_TTR_Ti_SequenceTimer /end REF_CHARACTERISTIC /end GROUP
/begin GROUP S186_Rising_Debounce3 "POD_TipToRun/POD_TipToRun/TipToRun/TipToRunR/ManAsstRqst/StopToAssist/Rising Debounce3" /begin REF_CHARACTERISTIC k_TTR_Ti_SequenceTimer /end REF_CHARACTERISTIC /end GROUP
/begin GROUP S20_Rising_Debounce1 "POD_TipToRun/POD_TipToRun/TipToRun/TipToRunL/ManAsstRqst/ElecToAssist/ElecMovOutBrkgIMUSpdJudge/Rising Debounce1" /begin REF_CHARACTERISTIC k_TTR_Ti_SequenceTimer /end REF_CHARACTERISTIC /end GROUP
/begin GROUP S23_Falling_Debounce "POD_TipToRun/POD_TipToRun/TipToRun/TipToRunL/ManAsstRqst/ElecToAssist/ElecToAssistIMUErrorSpdOrAccJudge/Falling Debounce" /begin REF_CHARACTERISTIC k_TTR_Ti_SequenceTimer /end REF_CHARACTERISTIC /end GROUP
/begin GROUP S23_Falling_Debounce1 "POD_TipToRun/POD_TipToRun/TipToRun/TipToRunL/ManAsstRqst/ElecToAssist/ElecToAssistIMUErrorSpdOrAccJudge/Falling Debounce1" /begin REF_CHARACTERISTIC k_TTR_Ti_SequenceTimer /end REF_CHARACTERISTIC /end GROUP
/begin GROUP S24_Rising_Debounce "POD_TipToRun/POD_TipToRun/TipToRun/TipToRunL/ManAsstRqst/ElecToAssist/ElecToAssistIMUSpdJudge/Rising Debounce" /begin REF_CHARACTERISTIC k_TTR_Ti_SequenceTimer /end REF_CHARACTERISTIC /end GROUP
/begin GROUP S24_Rising_Debounce1 "POD_TipToRun/POD_TipToRun/TipToRun/TipToRunL/ManAsstRqst/ElecToAssist/ElecToAssistIMUSpdJudge/Rising Debounce1" /begin REF_CHARACTERISTIC k_TTR_Ti_SequenceTimer /end REF_CHARACTERISTIC /end GROUP
/begin GROUP S26_Rising_Debounce2 "POD_TipToRun/POD_TipToRun/TipToRun/TipToRunL/ManAsstRqst/ElecToAssist/ElecToManualCloseIMUAccJudge/Rising Debounce2" /begin REF_CHARACTERISTIC k_TTR_Ti_SequenceTimer /end REF_CHARACTERISTIC /end GROUP
/begin GROUP S26_Rising_Debounce4 "POD_TipToRun/POD_TipToRun/TipToRun/TipToRunL/ManAsstRqst/ElecToAssist/ElecToManualCloseIMUAccJudge/Rising Debounce4" /begin REF_CHARACTERISTIC k_TTR_Ti_SequenceTimer /end REF_CHARACTERISTIC /end GROUP
/begin GROUP S27_Rising_Debounce1 "POD_TipToRun/POD_TipToRun/TipToRun/TipToRunL/ManAsstRqst/ElecToAssist/ElecToManualOpenIMUAccJudge/Rising Debounce1" /begin REF_CHARACTERISTIC k_TTR_Ti_SequenceTimer /end REF_CHARACTERISTIC /end GROUP
/begin GROUP S27_Rising_Debounce2 "POD_TipToRun/POD_TipToRun/TipToRun/TipToRunL/ManAsstRqst/ElecToAssist/ElecToManualOpenIMUAccJudge/Rising Debounce2" /begin REF_CHARACTERISTIC k_TTR_Ti_SequenceTimer /end REF_CHARACTERISTIC /end GROUP
/begin GROUP S27_Rising_Debounce3 "POD_TipToRun/POD_TipToRun/TipToRun/TipToRunL/ManAsstRqst/ElecToAssist/ElecToManualOpenIMUAccJudge/Rising Debounce3" /begin REF_CHARACTERISTIC k_TTR_Ti_SequenceTimer /end REF_CHARACTERISTIC /end GROUP
/begin GROUP S113_Rising_Debounce1 "POD_TipToRun/POD_TipToRun/TipToRun/TipToRunL/ManAsstRqst/ManualSpdBack/ManualCloseToOpenJudge/Rising Debounce1" /begin REF_CHARACTERISTIC k_TTR_Ti_SequenceTimer /end REF_CHARACTERISTIC /end GROUP
/begin GROUP S113_Rising_Debounce2 "POD_TipToRun/POD_TipToRun/TipToRun/TipToRunL/ManAsstRqst/ManualSpdBack/ManualCloseToOpenJudge/Rising Debounce2" /begin REF_CHARACTERISTIC k_TTR_Ti_SequenceTimer /end REF_CHARACTERISTIC /end GROUP
/begin GROUP S114_Rising_Debounce "POD_TipToRun/POD_TipToRun/TipToRun/TipToRunL/ManAsstRqst/ManualSpdBack/ManualOpenOrCloseMaxPos/Rising Debounce" /begin REF_CHARACTERISTIC k_TTR_Ti_SequenceTimer /end REF_CHARACTERISTIC /end GROUP
/begin GROUP S115_Rising_Debounce1 "POD_TipToRun/POD_TipToRun/TipToRun/TipToRunL/ManAsstRqst/ManualSpdBack/ManualOpenToCloseJudge/Rising Debounce1" /begin REF_CHARACTERISTIC k_TTR_Ti_SequenceTimer /end REF_CHARACTERISTIC /end GROUP
/begin GROUP S115_Rising_Debounce2 "POD_TipToRun/POD_TipToRun/TipToRun/TipToRunL/ManAsstRqst/ManualSpdBack/ManualOpenToCloseJudge/Rising Debounce2" /begin REF_CHARACTERISTIC k_TTR_Ti_SequenceTimer /end REF_CHARACTERISTIC /end GROUP
/begin GROUP S188_Rising_Debounce1 "POD_TipToRun/POD_TipToRun/TipToRun/TipToRunR/ManAsstRqst/ElecToAssist/ElecMovOutBrkgIMUSpdJudge/Rising Debounce1" /begin REF_CHARACTERISTIC k_TTR_Ti_SequenceTimer /end REF_CHARACTERISTIC /end GROUP
/begin GROUP S191_Falling_Debounce "POD_TipToRun/POD_TipToRun/TipToRun/TipToRunR/ManAsstRqst/ElecToAssist/ElecToAssistIMUErrorSpdOrAccJudge/Falling Debounce" /begin REF_CHARACTERISTIC k_TTR_Ti_SequenceTimer /end REF_CHARACTERISTIC /end GROUP
/begin GROUP S191_Falling_Debounce1 "POD_TipToRun/POD_TipToRun/TipToRun/TipToRunR/ManAsstRqst/ElecToAssist/ElecToAssistIMUErrorSpdOrAccJudge/Falling Debounce1" /begin REF_CHARACTERISTIC k_TTR_Ti_SequenceTimer /end REF_CHARACTERISTIC /end GROUP
/begin GROUP S192_Rising_Debounce "POD_TipToRun/POD_TipToRun/TipToRun/TipToRunR/ManAsstRqst/ElecToAssist/ElecToAssistIMUSpdJudge/Rising Debounce" /begin REF_CHARACTERISTIC k_TTR_Ti_SequenceTimer /end REF_CHARACTERISTIC /end GROUP
/begin GROUP S192_Rising_Debounce1 "POD_TipToRun/POD_TipToRun/TipToRun/TipToRunR/ManAsstRqst/ElecToAssist/ElecToAssistIMUSpdJudge/Rising Debounce1" /begin REF_CHARACTERISTIC k_TTR_Ti_SequenceTimer /end REF_CHARACTERISTIC /end GROUP
/begin GROUP S194_Rising_Debounce2 "POD_TipToRun/POD_TipToRun/TipToRun/TipToRunR/ManAsstRqst/ElecToAssist/ElecToManualCloseIMUAccJudge/Rising Debounce2" /begin REF_CHARACTERISTIC k_TTR_Ti_SequenceTimer /end REF_CHARACTERISTIC /end GROUP
/begin GROUP S194_Rising_Debounce4 "POD_TipToRun/POD_TipToRun/TipToRun/TipToRunR/ManAsstRqst/ElecToAssist/ElecToManualCloseIMUAccJudge/Rising Debounce4" /begin REF_CHARACTERISTIC k_TTR_Ti_SequenceTimer /end REF_CHARACTERISTIC /end GROUP
/begin GROUP S195_Rising_Debounce1 "POD_TipToRun/POD_TipToRun/TipToRun/TipToRunR/ManAsstRqst/ElecToAssist/ElecToManualOpenIMUAccJudge/Rising Debounce1" /begin REF_CHARACTERISTIC k_TTR_Ti_SequenceTimer /end REF_CHARACTERISTIC /end GROUP
/begin GROUP S195_Rising_Debounce2 "POD_TipToRun/POD_TipToRun/TipToRun/TipToRunR/ManAsstRqst/ElecToAssist/ElecToManualOpenIMUAccJudge/Rising Debounce2" /begin REF_CHARACTERISTIC k_TTR_Ti_SequenceTimer /end REF_CHARACTERISTIC /end GROUP
/begin GROUP S195_Rising_Debounce3 "POD_TipToRun/POD_TipToRun/TipToRun/TipToRunR/ManAsstRqst/ElecToAssist/ElecToManualOpenIMUAccJudge/Rising Debounce3" /begin REF_CHARACTERISTIC k_TTR_Ti_SequenceTimer /end REF_CHARACTERISTIC /end GROUP
/begin GROUP S281_Rising_Debounce1 "POD_TipToRun/POD_TipToRun/TipToRun/TipToRunR/ManAsstRqst/ManualSpdBack/ManualCloseToOpenJudge/Rising Debounce1" /begin REF_CHARACTERISTIC k_TTR_Ti_SequenceTimer /end REF_CHARACTERISTIC /end GROUP
/begin GROUP S281_Rising_Debounce2 "POD_TipToRun/POD_TipToRun/TipToRun/TipToRunR/ManAsstRqst/ManualSpdBack/ManualCloseToOpenJudge/Rising Debounce2" /begin REF_CHARACTERISTIC k_TTR_Ti_SequenceTimer /end REF_CHARACTERISTIC /end GROUP
/begin GROUP S282_Rising_Debounce "POD_TipToRun/POD_TipToRun/TipToRun/TipToRunR/ManAsstRqst/ManualSpdBack/ManualOpenOrCloseMaxPos/Rising Debounce" /begin REF_CHARACTERISTIC k_TTR_Ti_SequenceTimer /end REF_CHARACTERISTIC /end GROUP
/begin GROUP S283_Rising_Debounce1 "POD_TipToRun/POD_TipToRun/TipToRun/TipToRunR/ManAsstRqst/ManualSpdBack/ManualOpenToCloseJudge/Rising Debounce1" /begin REF_CHARACTERISTIC k_TTR_Ti_SequenceTimer /end REF_CHARACTERISTIC /end GROUP
/begin GROUP S283_Rising_Debounce2 "POD_TipToRun/POD_TipToRun/TipToRun/TipToRunR/ManAsstRqst/ManualSpdBack/ManualOpenToCloseJudge/Rising Debounce2" /begin REF_CHARACTERISTIC k_TTR_Ti_SequenceTimer /end REF_CHARACTERISTIC /end GROUP
/end MODULE
/end PROJECT
