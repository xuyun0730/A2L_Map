ASAP2_VERSION 1 70
/begin PROJECT ProjectName "CARIAD XCP On CAN"
/begin MODULE ZCU "this is a module for XCP A2l"
/begin MOD_COMMON "" ALIGNMENT_BYTE 1 ALIGNMENT_WORD 2 ALIGNMENT_LONG 4 ALIGNMENT_FLOAT32_IEEE 4 ALIGNMENT_FLOAT64_IEEE 8 ALIGNMENT_INT64 8 /end MOD_COMMON
/begin RECORD_LAYOUT __FLOAT32_IEEE_S FNC_VALUES 1 FLOAT32_IEEE COLUMN_DIR DIRECT /end RECORD_LAYOUT
/begin RECORD_LAYOUT __FLOAT64_IEEE_S FNC_VALUES 1 FLOAT64_IEEE COLUMN_DIR DIRECT /end RECORD_LAYOUT
/begin RECORD_LAYOUT RL.FNC.FLOAT32_IEEE.ROW_DIR FNC_VALUES 1 FLOAT32_IEEE ROW_DIR DIRECT /end RECORD_LAYOUT
/begin RECORD_LAYOUT UBYTE_RL FNC_VALUES 1 UBYTE COLUMN_DIR DIRECT /end RECORD_LAYOUT
/begin RECORD_LAYOUT STANDARD_VALUE_U32 FNC_VALUES 1 ULONG COLUMN_DIR DIRECT /end RECORD_LAYOUT
/***************** ******Add the matlab A2L Generate Code From This*****************************/
/begin RECORD_LAYOUT Scalar_UBYTE FNC_VALUES 1 UBYTE COLUMN_DIR DIRECT /end RECORD_LAYOUT
/begin RECORD_LAYOUT Scalar_SBYTE FNC_VALUES 1 SBYTE COLUMN_DIR DIRECT /end RECORD_LAYOUT
/begin RECORD_LAYOUT Scalar_UWORD FNC_VALUES 1 UWORD COLUMN_DIR DIRECT /end RECORD_LAYOUT
/begin RECORD_LAYOUT Scalar_SWORD FNC_VALUES 1 SWORD COLUMN_DIR DIRECT /end RECORD_LAYOUT
/begin RECORD_LAYOUT Scalar_ULONG FNC_VALUES 1 ULONG COLUMN_DIR DIRECT /end RECORD_LAYOUT
/begin RECORD_LAYOUT Scalar_SLONG FNC_VALUES 1 SLONG COLUMN_DIR DIRECT /end RECORD_LAYOUT
/begin RECORD_LAYOUT Scalar_FLOAT32_IEEE FNC_VALUES 1 FLOAT32_IEEE COLUMN_DIR DIRECT /end RECORD_LAYOUT
/begin RECORD_LAYOUT Array_UBYTE FNC_VALUES 1 UBYTE COLUMN_DIR DIRECT /end RECORD_LAYOUT
/begin CHARACTERISTIC CalEn_Config_Console "" VALUE 0xb00072f8 /* @ECU_Address@CalEn_Config_Console@ */ Scalar_UBYTE 0 DIAG_CarConfig_CM_uint8 0 255 /end CHARACTERISTIC
/begin CHARACTERISTIC CalVal_Config_Console "" VALUE 0xb00072f9 /* @ECU_Address@CalVal_Config_Console@ */ Scalar_UBYTE 0 DIAG_CarConfig_CM_uint8 0 255 /end CHARACTERISTIC
/begin CHARACTERISTIC CalEn_Config_SecRowLtSeatTilting "" VALUE 0xb00072fa /* @ECU_Address@CalEn_Config_SecRowLtSeatTilting@ */ Scalar_UBYTE 0 DIAG_CarConfig_CM_uint8 0 255 /end CHARACTERISTIC
/begin CHARACTERISTIC CalVal_Config_SecRowLtSeatTilting "" VALUE 0xb00072fb /* @ECU_Address@CalVal_Config_SecRowLtSeatTilting@ */ Scalar_UBYTE 0 DIAG_CarConfig_CM_uint8 0 255 /end CHARACTERISTIC
/begin CHARACTERISTIC CalEn_Config_SecRowRtSeatTilting "" VALUE 0xb00072fc /* @ECU_Address@CalEn_Config_SecRowRtSeatTilting@ */ Scalar_UBYTE 0 DIAG_CarConfig_CM_uint8 0 255 /end CHARACTERISTIC
/begin CHARACTERISTIC CalVal_Config_SecRowRtSeatTilting "" VALUE 0xb00072fd /* @ECU_Address@CalVal_Config_SecRowRtSeatTilting@ */ Scalar_UBYTE 0 DIAG_CarConfig_CM_uint8 0 255 /end CHARACTERISTIC
/begin CHARACTERISTIC CalEn_Config_SecRowLtSeatCshExt "" VALUE 0xb00072fe /* @ECU_Address@CalEn_Config_SecRowLtSeatCshExt@ */ Scalar_UBYTE 0 DIAG_CarConfig_CM_uint8 0 255 /end CHARACTERISTIC
/begin CHARACTERISTIC CalVal_Config_SecRowLtSeatCshExt "" VALUE 0xb00072ff /* @ECU_Address@CalVal_Config_SecRowLtSeatCshExt@ */ Scalar_UBYTE 0 DIAG_CarConfig_CM_uint8 0 255 /end CHARACTERISTIC
/begin CHARACTERISTIC CalEn_Config_SecRowRtSeatCshExt "" VALUE 0xb0007300 /* @ECU_Address@CalEn_Config_SecRowRtSeatCshExt@ */ Scalar_UBYTE 0 DIAG_CarConfig_CM_uint8 0 255 /end CHARACTERISTIC
/begin CHARACTERISTIC CalVal_Config_SecRowRtSeatCshExt "" VALUE 0xb0007301 /* @ECU_Address@CalVal_Config_SecRowRtSeatCshExt@ */ Scalar_UBYTE 0 DIAG_CarConfig_CM_uint8 0 255 /end CHARACTERISTIC
/begin CHARACTERISTIC CalEn_Config_SecRowLtSeatHorz "" VALUE 0xb0007302 /* @ECU_Address@CalEn_Config_SecRowLtSeatHorz@ */ Scalar_UBYTE 0 DIAG_CarConfig_CM_uint8 0 255 /end CHARACTERISTIC
/begin CHARACTERISTIC CalVal_Config_SecRowLtSeatHorz "" VALUE 0xb0007303 /* @ECU_Address@CalVal_Config_SecRowLtSeatHorz@ */ Scalar_UBYTE 0 DIAG_CarConfig_CM_uint8 0 255 /end CHARACTERISTIC
/begin CHARACTERISTIC CalEn_Config_SecRowRtSeatHorz "" VALUE 0xb0007304 /* @ECU_Address@CalEn_Config_SecRowRtSeatHorz@ */ Scalar_UBYTE 0 DIAG_CarConfig_CM_uint8 0 255 /end CHARACTERISTIC
/begin CHARACTERISTIC CalVal_Config_SecRowRtSeatHorz "" VALUE 0xb0007305 /* @ECU_Address@CalVal_Config_SecRowRtSeatHorz@ */ Scalar_UBYTE 0 DIAG_CarConfig_CM_uint8 0 255 /end CHARACTERISTIC
/begin CHARACTERISTIC CalEn_Config_TrdRowLtSeatTilting "" VALUE 0xb0007306 /* @ECU_Address@CalEn_Config_TrdRowLtSeatTilting@ */ Scalar_UBYTE 0 DIAG_CarConfig_CM_uint8 0 255 /end CHARACTERISTIC
/begin CHARACTERISTIC CalVal_Config_TrdRowLtSeatTilting "" VALUE 0xb0007307 /* @ECU_Address@CalVal_Config_TrdRowLtSeatTilting@ */ Scalar_UBYTE 0 DIAG_CarConfig_CM_uint8 0 255 /end CHARACTERISTIC
/begin CHARACTERISTIC CalEn_Config_TrdRowRtSeatTilting "" VALUE 0xb0007308 /* @ECU_Address@CalEn_Config_TrdRowRtSeatTilting@ */ Scalar_UBYTE 0 DIAG_CarConfig_CM_uint8 0 255 /end CHARACTERISTIC
/begin CHARACTERISTIC CalVal_Config_TrdRowRtSeatTilting "" VALUE 0xb0007309 /* @ECU_Address@CalVal_Config_TrdRowRtSeatTilting@ */ Scalar_UBYTE 0 DIAG_CarConfig_CM_uint8 0 255 /end CHARACTERISTIC
/begin CHARACTERISTIC CalEn_Config_UWB "" VALUE 0xb000730a /* @ECU_Address@CalEn_Config_UWB@ */ Scalar_UBYTE 0 DIAG_CarConfig_CM_uint8 0 255 /end CHARACTERISTIC
/begin CHARACTERISTIC CalVal_Config_UWB "" VALUE 0xb000730b /* @ECU_Address@CalVal_Config_UWB@ */ Scalar_UBYTE 0 DIAG_CarConfig_CM_uint8 0 255 /end CHARACTERISTIC
/begin CHARACTERISTIC CalEn_Config_PhysicalKeyType "" VALUE 0xb000730c /* @ECU_Address@CalEn_Config_PhysicalKeyType@ */ Scalar_UBYTE 0 DIAG_CarConfig_CM_uint8 0 255 /end CHARACTERISTIC
/begin CHARACTERISTIC CalVal_Config_PhysicalKeyType "" VALUE 0xb000730d /* @ECU_Address@CalVal_Config_PhysicalKeyType@ */ Scalar_UBYTE 0 DIAG_CarConfig_CM_uint8 0 255 /end CHARACTERISTIC
/begin CHARACTERISTIC CalEn_Config_TailGatetype "" VALUE 0xb000730e /* @ECU_Address@CalEn_Config_TailGatetype@ */ Scalar_UBYTE 0 DIAG_CarConfig_CM_uint8 0 255 /end CHARACTERISTIC
/begin CHARACTERISTIC CalVal_Config_TailGatetype "" VALUE 0xb000730f /* @ECU_Address@CalVal_Config_TailGatetype@ */ Scalar_UBYTE 0 DIAG_CarConfig_CM_uint8 0 255 /end CHARACTERISTIC
/begin CHARACTERISTIC CalEn_Config_TgateLatch "" VALUE 0xb0007310 /* @ECU_Address@CalEn_Config_TgateLatch@ */ Scalar_UBYTE 0 DIAG_CarConfig_CM_uint8 0 255 /end CHARACTERISTIC
/begin CHARACTERISTIC CalVal_Config_TgateLatch "" VALUE 0xb0007311 /* @ECU_Address@CalVal_Config_TgateLatch@ */ Scalar_UBYTE 0 DIAG_CarConfig_CM_uint8 0 255 /end CHARACTERISTIC
/begin CHARACTERISTIC CalEn_Config_PowerDoor "" VALUE 0xb0007312 /* @ECU_Address@CalEn_Config_PowerDoor@ */ Scalar_UBYTE 0 DIAG_CarConfig_CM_uint8 0 255 /end CHARACTERISTIC
/begin CHARACTERISTIC CalVal_Config_PowerDoor "" VALUE 0xb0007313 /* @ECU_Address@CalVal_Config_PowerDoor@ */ Scalar_UBYTE 0 DIAG_CarConfig_CM_uint8 0 255 /end CHARACTERISTIC
/begin MEASUREMENT Monr_Config_Console "" UBYTE DIAG_CarConfig_CM_uint8 0 0 0.0 255 ECU_ADDRESS 0xb005638e /* @ECU_Address@Monr_Config_Console@ */ /end MEASUREMENT
/begin MEASUREMENT Monr_Config_SecRowLtSeatTilting "" UBYTE DIAG_CarConfig_CM_uint8 0 0 0.0 255 ECU_ADDRESS 0xb005638f /* @ECU_Address@Monr_Config_SecRowLtSeatTilting@ */ /end MEASUREMENT
/begin MEASUREMENT Monr_Config_SecRowRtSeatTilting "" UBYTE DIAG_CarConfig_CM_uint8 0 0 0.0 255 ECU_ADDRESS 0xb0056390 /* @ECU_Address@Monr_Config_SecRowRtSeatTilting@ */ /end MEASUREMENT
/begin MEASUREMENT Monr_Config_SecRowLtSeatCshExt "" UBYTE DIAG_CarConfig_CM_uint8 0 0 0.0 255 ECU_ADDRESS 0xb0056391 /* @ECU_Address@Monr_Config_SecRowLtSeatCshExt@ */ /end MEASUREMENT
/begin MEASUREMENT Monr_Config_SecRowRtSeatCshExt "" UBYTE DIAG_CarConfig_CM_uint8 0 0 0.0 255 ECU_ADDRESS 0xb0056392 /* @ECU_Address@Monr_Config_SecRowRtSeatCshExt@ */ /end MEASUREMENT
/begin MEASUREMENT Monr_Config_SecRowLtSeatHorz "" UBYTE DIAG_CarConfig_CM_uint8 0 0 0.0 255 ECU_ADDRESS 0xb0056393 /* @ECU_Address@Monr_Config_SecRowLtSeatHorz@ */ /end MEASUREMENT
/begin MEASUREMENT Monr_Config_SecRowRtSeatHorz "" UBYTE DIAG_CarConfig_CM_uint8 0 0 0.0 255 ECU_ADDRESS 0xb0056394 /* @ECU_Address@Monr_Config_SecRowRtSeatHorz@ */ /end MEASUREMENT
/begin MEASUREMENT Monr_Config_TrdRowLtSeatTilting "" UBYTE DIAG_CarConfig_CM_uint8 0 0 0.0 255 ECU_ADDRESS 0xb0056395 /* @ECU_Address@Monr_Config_TrdRowLtSeatTilting@ */ /end MEASUREMENT
/begin MEASUREMENT Monr_Config_TrdRowRtSeatTilting "" UBYTE DIAG_CarConfig_CM_uint8 0 0 0.0 255 ECU_ADDRESS 0xb0056396 /* @ECU_Address@Monr_Config_TrdRowRtSeatTilting@ */ /end MEASUREMENT
/begin MEASUREMENT Monr_Config_UWB "" UBYTE DIAG_CarConfig_CM_uint8 0 0 0.0 255 ECU_ADDRESS 0xb0056397 /* @ECU_Address@Monr_Config_UWB@ */ /end MEASUREMENT
/begin MEASUREMENT Monr_Config_PhysicalKeyType "" UBYTE DIAG_CarConfig_CM_uint8 0 0 0.0 255 ECU_ADDRESS 0xb0056398 /* @ECU_Address@Monr_Config_PhysicalKeyType@ */ /end MEASUREMENT
/begin MEASUREMENT Monr_Config_TailGatetype "" UBYTE DIAG_CarConfig_CM_uint8 0 0 0.0 255 ECU_ADDRESS 0xb0056399 /* @ECU_Address@Monr_Config_TailGatetype@ */ /end MEASUREMENT
/begin MEASUREMENT Monr_Config_TgateLatch "" UBYTE DIAG_CarConfig_CM_uint8 0 0 0.0 255 ECU_ADDRESS 0xb005639a /* @ECU_Address@Monr_Config_TgateLatch@ */ /end MEASUREMENT
/begin MEASUREMENT Monr_Config_PowerDoor "" UBYTE DIAG_CarConfig_CM_uint8 0 0 0.0 255 ECU_ADDRESS 0xb005639b /* @ECU_Address@Monr_Config_PowerDoor@ */ /end MEASUREMENT
/begin COMPU_METHOD DIAG_CarConfig_CM_uint8 "Q = V" RAT_FUNC "%3.0" "" COEFFS 0 1 0 0 0 1 /end COMPU_METHOD
/begin CHARACTERISTIC K_TTR_Value_RoadManualOpenIMUFactor "" CURVE 0xb0006fa4 /* @ECU_Address@K_TTR_Value_RoadManualOpenIMUFactor@ */ Lookup1D_FLOAT32_IEEE 0 POD_TipToRun_CM_single -3.4E+38 3.4E+38
 /begin AXIS_DESCR COM_AXIS monr_VfSHM_FrntIncinAgLTTR_deg POD_TipToRun_CM_single 11 -3.4E+38 3.4E+38 AXIS_PTS_REF K_TTR_Value_SectorForIMURollAndRoad /end AXIS_DESCR
/end CHARACTERISTIC
/begin AXIS_PTS K_TTR_Value_SectorForIMURollAndRoad "" 0x80774028 /* @ECU_Address@K_TTR_Value_SectorForIMURollAndRoad@ */ monr_VfSHM_FrntIncinAgLTTR_deg Lookup1D_X_FLOAT32_IEEE 0 POD_TipToRun_CM_single 11 -3.4E+38 3.4E+38 /end AXIS_PTS
/begin CHARACTERISTIC K_TTR_Value_RollManualOpenIMUFactor "" CURVE 0xb0006ffc /* @ECU_Address@K_TTR_Value_RollManualOpenIMUFactor@ */ Lookup1D_FLOAT32_IEEE 0 POD_TipToRun_CM_single -3.4E+38 3.4E+38
 /begin AXIS_DESCR COM_AXIS monr_VfSHM_SideIncinAgLTTR_deg POD_TipToRun_CM_single 11 -3.4E+38 3.4E+38 AXIS_PTS_REF K_TTR_Value_SectorForIMURollAndRoad /end AXIS_DESCR
/end CHARACTERISTIC
/begin CHARACTERISTIC K_TTR_Value_RoadManualCloseIMUFactor "" CURVE 0xb0006f78 /* @ECU_Address@K_TTR_Value_RoadManualCloseIMUFactor@ */ Lookup1D_FLOAT32_IEEE 0 POD_TipToRun_CM_single -3.4E+38 3.4E+38
 /begin AXIS_DESCR COM_AXIS monr_VfSHM_FrntIncinAgLTTR_deg POD_TipToRun_CM_single 11 -3.4E+38 3.4E+38 AXIS_PTS_REF K_TTR_Value_SectorForIMURollAndRoad /end AXIS_DESCR
/end CHARACTERISTIC
/begin CHARACTERISTIC K_TTR_Value_RollManualCloseIMUFactor "" CURVE 0xb0006fd0 /* @ECU_Address@K_TTR_Value_RollManualCloseIMUFactor@ */ Lookup1D_FLOAT32_IEEE 0 POD_TipToRun_CM_single -3.4E+38 3.4E+38
 /begin AXIS_DESCR COM_AXIS monr_VfSHM_SideIncinAgLTTR_deg POD_TipToRun_CM_single 11 -3.4E+38 3.4E+38 AXIS_PTS_REF K_TTR_Value_SectorForIMURollAndRoad /end AXIS_DESCR
/end CHARACTERISTIC
/begin CHARACTERISTIC k_TTR_Deg_RoadInclnThdAssis "" VALUE 0xb000649c /* @ECU_Address@k_TTR_Deg_RoadInclnThdAssis@ */ Scalar_FLOAT32_IEEE 0 POD_TipToRun_CM_single -3.4E+38 3.4E+38 /end CHARACTERISTIC
/begin CHARACTERISTIC k_TTR_Deg_RollAgGlbThdAssis "" VALUE 0xb00064a0 /* @ECU_Address@k_TTR_Deg_RollAgGlbThdAssis@ */ Scalar_FLOAT32_IEEE 0 POD_TipToRun_CM_single -3.4E+38 3.4E+38 /end CHARACTERISTIC
/begin CHARACTERISTIC k_TTR_Ti_DoorBrkgToAssistCloseTi "" VAL_BLK 0xb0006538 /* @ECU_Address@k_TTR_Ti_DoorBrkgToAssistCloseTi@ */ Scalar_FLOAT32_IEEE 0 POD_TipToRun_CM_single -3.4E+38 3.4E+38 NUMBER 2 /end CHARACTERISTIC
/begin CHARACTERISTIC k_TTR_Ti_DoorBrkgToAssistOpenTi "" VAL_BLK 0xb0006540 /* @ECU_Address@k_TTR_Ti_DoorBrkgToAssistOpenTi@ */ Scalar_FLOAT32_IEEE 0 POD_TipToRun_CM_single -3.4E+38 3.4E+38 NUMBER 2 /end CHARACTERISTIC
/begin CHARACTERISTIC k_TTR_Ti_DoorCloseACCDecJudgeTi "" VAL_BLK 0xb0006548 /* @ECU_Address@k_TTR_Ti_DoorCloseACCDecJudgeTi@ */ Scalar_FLOAT32_IEEE 0 POD_TipToRun_CM_single -3.4E+38 3.4E+38 NUMBER 2 /end CHARACTERISTIC
/begin CHARACTERISTIC k_TTR_Ti_DoorCloseACCIncJudgeTi "" VAL_BLK 0xb0006550 /* @ECU_Address@k_TTR_Ti_DoorCloseACCIncJudgeTi@ */ Scalar_FLOAT32_IEEE 0 POD_TipToRun_CM_single -3.4E+38 3.4E+38 NUMBER 2 /end CHARACTERISTIC
/begin CHARACTERISTIC k_TTR_Ti_DoorCloseInitialTi "" VALUE 0xb00064a8 /* @ECU_Address@k_TTR_Ti_DoorCloseInitialTi@ */ Scalar_FLOAT32_IEEE 0 POD_TipToRun_CM_single -3.4E+38 3.4E+38 /end CHARACTERISTIC
/begin CHARACTERISTIC k_TTR_Ti_DoorCloseToAssistAccStateTi "" VALUE 0xb00064ac /* @ECU_Address@k_TTR_Ti_DoorCloseToAssistAccStateTi@ */ Scalar_FLOAT32_IEEE 0 POD_TipToRun_CM_single -3.4E+38 3.4E+38 /end CHARACTERISTIC
/begin CHARACTERISTIC k_TTR_Ti_DoorOpenACCDecJudgeTi "" VAL_BLK 0xb0006558 /* @ECU_Address@k_TTR_Ti_DoorOpenACCDecJudgeTi@ */ Scalar_FLOAT32_IEEE 0 POD_TipToRun_CM_single -3.4E+38 3.4E+38 NUMBER 2 /end CHARACTERISTIC
/begin CHARACTERISTIC k_TTR_Ti_DoorOpenACCIncJudgeTi "" VAL_BLK 0xb0006560 /* @ECU_Address@k_TTR_Ti_DoorOpenACCIncJudgeTi@ */ Scalar_FLOAT32_IEEE 0 POD_TipToRun_CM_single -3.4E+38 3.4E+38 NUMBER 2 /end CHARACTERISTIC
/begin CHARACTERISTIC k_TTR_Ti_DoorOpenBrkgToAssistAgSpdDelayTi "" VALUE 0xb00064b0 /* @ECU_Address@k_TTR_Ti_DoorOpenBrkgToAssistAgSpdDelayTi@ */ Scalar_FLOAT32_IEEE 0 POD_TipToRun_CM_single -3.4E+38 3.4E+38 /end CHARACTERISTIC
/begin CHARACTERISTIC k_TTR_Ti_DoorOpenDecToAssistAccStateTi "" VALUE 0xb00064b4 /* @ECU_Address@k_TTR_Ti_DoorOpenDecToAssistAccStateTi@ */ Scalar_FLOAT32_IEEE 0 POD_TipToRun_CM_single -3.4E+38 3.4E+38 /end CHARACTERISTIC
/begin CHARACTERISTIC k_TTR_Ti_DoorOpenInitialTi "" VALUE 0xb00064b8 /* @ECU_Address@k_TTR_Ti_DoorOpenInitialTi@ */ Scalar_FLOAT32_IEEE 0 POD_TipToRun_CM_single -3.4E+38 3.4E+38 /end CHARACTERISTIC
/begin CHARACTERISTIC k_TTR_Ti_DoorOpenToAssistAccStateTi "" VALUE 0xb00064c0 /* @ECU_Address@k_TTR_Ti_DoorOpenToAssistAccStateTi@ */ Scalar_FLOAT32_IEEE 0 POD_TipToRun_CM_single -3.4E+38 3.4E+38 /end CHARACTERISTIC
/begin CHARACTERISTIC k_TTR_Ti_ErrorSpeedDelayTi "" VALUE 0xb00064c4 /* @ECU_Address@k_TTR_Ti_ErrorSpeedDelayTi@ */ Scalar_FLOAT32_IEEE 0 POD_TipToRun_CM_single -3.4E+38 3.4E+38 /end CHARACTERISTIC
/begin CHARACTERISTIC k_TTR_Ti_LowSpeedManualCloseTi "" VALUE 0xb00064c8 /* @ECU_Address@k_TTR_Ti_LowSpeedManualCloseTi@ */ Scalar_FLOAT32_IEEE 0 POD_TipToRun_CM_single -3.4E+38 3.4E+38 /end CHARACTERISTIC
/begin CHARACTERISTIC k_TTR_Ti_LowSpeedManualOpenTi "" VALUE 0xb00064cc /* @ECU_Address@k_TTR_Ti_LowSpeedManualOpenTi@ */ Scalar_FLOAT32_IEEE 0 POD_TipToRun_CM_single -3.4E+38 3.4E+38 /end CHARACTERISTIC
/begin CHARACTERISTIC k_TTR_Ti_ManualAssistJudgeCnt "" VALUE 0xb00064d0 /* @ECU_Address@k_TTR_Ti_ManualAssistJudgeCnt@ */ Scalar_FLOAT32_IEEE 0 POD_TipToRun_CM_single -3.4E+38 3.4E+38 /end CHARACTERISTIC
/begin CHARACTERISTIC k_TTR_Ti_ManualCloseDistanceMaxJudgeTi "" VALUE 0xb00064d4 /* @ECU_Address@k_TTR_Ti_ManualCloseDistanceMaxJudgeTi@ */ Scalar_FLOAT32_IEEE 0 POD_TipToRun_CM_single -3.4E+38 3.4E+38 /end CHARACTERISTIC
/begin CHARACTERISTIC k_TTR_Ti_ManualCloseSpdAccDelayTi "" VALUE 0xb00064d8 /* @ECU_Address@k_TTR_Ti_ManualCloseSpdAccDelayTi@ */ Scalar_FLOAT32_IEEE 0 POD_TipToRun_CM_single -3.4E+38 3.4E+38 /end CHARACTERISTIC
/begin CHARACTERISTIC k_TTR_Ti_ManualOpenMaxPosJudgeTi "" VALUE 0xb00064dc /* @ECU_Address@k_TTR_Ti_ManualOpenMaxPosJudgeTi@ */ Scalar_FLOAT32_IEEE 0 POD_TipToRun_CM_single -3.4E+38 3.4E+38 /end CHARACTERISTIC
/begin CHARACTERISTIC k_TTR_Ti_ManualOpenSpdAccDelayTi "" VALUE 0xb00064e0 /* @ECU_Address@k_TTR_Ti_ManualOpenSpdAccDelayTi@ */ Scalar_FLOAT32_IEEE 0 POD_TipToRun_CM_single -3.4E+38 3.4E+38 /end CHARACTERISTIC
/begin CHARACTERISTIC k_TTR_Value_HoldModeIMURisTimer "" VALUE 0xb00064f4 /* @ECU_Address@k_TTR_Value_HoldModeIMURisTimer@ */ Scalar_FLOAT32_IEEE 0 POD_TipToRun_CM_single -3.4E+38 3.4E+38 /end CHARACTERISTIC
/begin CHARACTERISTIC k_TTR_Value_HoldModePosOnTimer "" VALUE 0xb00064f8 /* @ECU_Address@k_TTR_Value_HoldModePosOnTimer@ */ Scalar_FLOAT32_IEEE 0 POD_TipToRun_CM_single -3.4E+38 3.4E+38 /end CHARACTERISTIC
/begin CHARACTERISTIC k_TTR_Value_HoldModeRisTimer "" VALUE 0xb00064fc /* @ECU_Address@k_TTR_Value_HoldModeRisTimer@ */ Scalar_FLOAT32_IEEE 0 POD_TipToRun_CM_single -3.4E+38 3.4E+38 /end CHARACTERISTIC
/begin CHARACTERISTIC k_TTR_Value_IMUAngSpdAccDecRate "" VALUE 0xb0006500 /* @ECU_Address@k_TTR_Value_IMUAngSpdAccDecRate@ */ Scalar_FLOAT32_IEEE 0 POD_TipToRun_CM_single -3.4E+38 3.4E+38 /end CHARACTERISTIC
/begin CHARACTERISTIC k_TTR_Value_IMUAngSpdAccToCloseDecRate "" VALUE 0xb0006504 /* @ECU_Address@k_TTR_Value_IMUAngSpdAccToCloseDecRate@ */ Scalar_FLOAT32_IEEE 0 POD_TipToRun_CM_single -3.4E+38 3.4E+38 /end CHARACTERISTIC
/begin CHARACTERISTIC k_TTR_Pluse_ManualAssistMinPos "" VALUE 0xb00064a4 /* @ECU_Address@k_TTR_Pluse_ManualAssistMinPos@ */ Scalar_SWORD 0 POD_TipToRun_CM_int16 -32768 32767 /end CHARACTERISTIC
/begin CHARACTERISTIC k_TTR_Value_ElecCloseDoorMinAcc "" VALUE 0xb00064e8 /* @ECU_Address@k_TTR_Value_ElecCloseDoorMinAcc@ */ Scalar_SWORD 0 POD_TipToRun_CM_int16 -32768 32767 /end CHARACTERISTIC
/begin CHARACTERISTIC k_TTR_Value_ElecOpenDoorMinAcc "" VALUE 0xb00064ea /* @ECU_Address@k_TTR_Value_ElecOpenDoorMinAcc@ */ Scalar_SWORD 0 POD_TipToRun_CM_int16 -32768 32767 /end CHARACTERISTIC
/begin CHARACTERISTIC k_TTR_Value_ElecToManualCloseMinSpeed "" VALUE 0xb00064ec /* @ECU_Address@k_TTR_Value_ElecToManualCloseMinSpeed@ */ Scalar_SWORD 0 POD_TipToRun_CM_int16 -32768 32767 /end CHARACTERISTIC
/begin CHARACTERISTIC k_TTR_Value_ElecToManualOpenMinSpeed "" VALUE 0xb00064ee /* @ECU_Address@k_TTR_Value_ElecToManualOpenMinSpeed@ */ Scalar_SWORD 0 POD_TipToRun_CM_int16 -32768 32767 /end CHARACTERISTIC
/begin CHARACTERISTIC k_TTR_Value_HoldHallPosExit "" VALUE 0xb00064f0 /* @ECU_Address@k_TTR_Value_HoldHallPosExit@ */ Scalar_SWORD 0 POD_TipToRun_CM_int16 -32768 32767 /end CHARACTERISTIC
/begin CHARACTERISTIC k_TTR_Value_IMUAngSpdProtectMaxRebound "" VALUE 0xb0006508 /* @ECU_Address@k_TTR_Value_IMUAngSpdProtectMaxRebound@ */ Scalar_SWORD 0 POD_TipToRun_CM_int16 -32768 32767 /end CHARACTERISTIC
/begin CHARACTERISTIC k_TTR_Value_IMUAngSpdToCloseOffset "" VALUE 0xb000650a /* @ECU_Address@k_TTR_Value_IMUAngSpdToCloseOffset@ */ Scalar_SWORD 0 POD_TipToRun_CM_int16 -32768 32767 /end CHARACTERISTIC
/begin CHARACTERISTIC k_TTR_Value_IMUAngSpdToOpenOffset "" VALUE 0xb000650c /* @ECU_Address@k_TTR_Value_IMUAngSpdToOpenOffset@ */ Scalar_SWORD 0 POD_TipToRun_CM_int16 -32768 32767 /end CHARACTERISTIC
/begin CHARACTERISTIC k_TTR_Value_IMUHoldExitMinSpeed "" VALUE 0xb000650e /* @ECU_Address@k_TTR_Value_IMUHoldExitMinSpeed@ */ Scalar_SWORD 0 POD_TipToRun_CM_int16 -32768 32767 /end CHARACTERISTIC
/begin CHARACTERISTIC k_TTR_Value_ImuAngAccSpdThdforTTR "" VAL_BLK 0xb0006568 /* @ECU_Address@k_TTR_Value_ImuAngAccSpdThdforTTR@ */ Scalar_SWORD 0 POD_TipToRun_CM_int16 -32768 32767 NUMBER 2 /end CHARACTERISTIC
/begin CHARACTERISTIC k_TTR_Value_ImuAngSpdThdforTTR "" VAL_BLK 0xb000656c /* @ECU_Address@k_TTR_Value_ImuAngSpdThdforTTR@ */ Scalar_SWORD 0 POD_TipToRun_CM_int16 -32768 32767 NUMBER 2 /end CHARACTERISTIC
/begin CHARACTERISTIC k_TTR_Value_ManualBackMinHallSpeed "" VALUE 0xb0006510 /* @ECU_Address@k_TTR_Value_ManualBackMinHallSpeed@ */ Scalar_SWORD 0 POD_TipToRun_CM_int16 -32768 32767 /end CHARACTERISTIC
/begin CHARACTERISTIC k_TTR_Value_ManualBrkgCloseMaxAcc "" VALUE 0xb0006512 /* @ECU_Address@k_TTR_Value_ManualBrkgCloseMaxAcc@ */ Scalar_SWORD 0 POD_TipToRun_CM_int16 -32768 32767 /end CHARACTERISTIC
/begin CHARACTERISTIC k_TTR_Value_ManualBrkgCloseMinAcc "" VAL_BLK 0xb0006570 /* @ECU_Address@k_TTR_Value_ManualBrkgCloseMinAcc@ */ Scalar_SWORD 0 POD_TipToRun_CM_int16 -32768 32767 NUMBER 2 /end CHARACTERISTIC
/begin CHARACTERISTIC k_TTR_Value_ManualBrkgOpenMaxAcc "" VALUE 0xb0006514 /* @ECU_Address@k_TTR_Value_ManualBrkgOpenMaxAcc@ */ Scalar_SWORD 0 POD_TipToRun_CM_int16 -32768 32767 /end CHARACTERISTIC
/begin CHARACTERISTIC k_TTR_Value_ManualBrkgOpenMinAcc "" VALUE 0xb0006516 /* @ECU_Address@k_TTR_Value_ManualBrkgOpenMinAcc@ */ Scalar_SWORD 0 POD_TipToRun_CM_int16 -32768 32767 /end CHARACTERISTIC
/begin CHARACTERISTIC k_TTR_Value_ManualBrkgToCloseMinPos "" VALUE 0xb0006518 /* @ECU_Address@k_TTR_Value_ManualBrkgToCloseMinPos@ */ Scalar_SWORD 0 POD_TipToRun_CM_int16 -32768 32767 /end CHARACTERISTIC
/begin CHARACTERISTIC k_TTR_Value_ManualBrkgToOpenMinPos "" VALUE 0xb000651a /* @ECU_Address@k_TTR_Value_ManualBrkgToOpenMinPos@ */ Scalar_SWORD 0 POD_TipToRun_CM_int16 -32768 32767 /end CHARACTERISTIC
/begin CHARACTERISTIC k_TTR_Value_ManualCloseACCDiff "" VALUE 0xb000651c /* @ECU_Address@k_TTR_Value_ManualCloseACCDiff@ */ Scalar_SWORD 0 POD_TipToRun_CM_int16 -32768 32767 /end CHARACTERISTIC
/begin CHARACTERISTIC k_TTR_Value_ManualCloseIMUBaseAngSpd "" VAL_BLK 0xb0006574 /* @ECU_Address@k_TTR_Value_ManualCloseIMUBaseAngSpd@ */ Scalar_SWORD 0 POD_TipToRun_CM_int16 -32768 32767 NUMBER 2 /end CHARACTERISTIC
/begin CHARACTERISTIC k_TTR_Value_ManualCloseIMUBaseAngSpdOffset "" VALUE 0xb000651e /* @ECU_Address@k_TTR_Value_ManualCloseIMUBaseAngSpdOffset@ */ Scalar_SWORD 0 POD_TipToRun_CM_int16 -32768 32767 /end CHARACTERISTIC
/begin CHARACTERISTIC k_TTR_Value_ManualCloseMaxAcc "" VALUE 0xb0006520 /* @ECU_Address@k_TTR_Value_ManualCloseMaxAcc@ */ Scalar_SWORD 0 POD_TipToRun_CM_int16 -32768 32767 /end CHARACTERISTIC
/begin CHARACTERISTIC k_TTR_Value_ManualCloseMaxSpeed "" VALUE 0xb0006522 /* @ECU_Address@k_TTR_Value_ManualCloseMaxSpeed@ */ Scalar_SWORD 0 POD_TipToRun_CM_int16 -32768 32767 /end CHARACTERISTIC
/begin CHARACTERISTIC k_TTR_Value_ManualCloseMinAcc "" VALUE 0xb0006524 /* @ECU_Address@k_TTR_Value_ManualCloseMinAcc@ */ Scalar_SWORD 0 POD_TipToRun_CM_int16 -32768 32767 /end CHARACTERISTIC
/begin CHARACTERISTIC k_TTR_Value_ManualCloseMinSpeed "" VALUE 0xb0006526 /* @ECU_Address@k_TTR_Value_ManualCloseMinSpeed@ */ Scalar_SWORD 0 POD_TipToRun_CM_int16 -32768 32767 /end CHARACTERISTIC
/begin CHARACTERISTIC k_TTR_Value_ManualMaxAcc "" VALUE 0xb0006528 /* @ECU_Address@k_TTR_Value_ManualMaxAcc@ */ Scalar_SWORD 0 POD_TipToRun_CM_int16 -32768 32767 /end CHARACTERISTIC
/begin CHARACTERISTIC k_TTR_Value_ManualMinAcc "" VALUE 0xb000652a /* @ECU_Address@k_TTR_Value_ManualMinAcc@ */ Scalar_SWORD 0 POD_TipToRun_CM_int16 -32768 32767 /end CHARACTERISTIC
/begin CHARACTERISTIC k_TTR_Value_ManualOpenACCDiff "" VAL_BLK 0xb0006578 /* @ECU_Address@k_TTR_Value_ManualOpenACCDiff@ */ Scalar_SWORD 0 POD_TipToRun_CM_int16 -32768 32767 NUMBER 2 /end CHARACTERISTIC
/begin CHARACTERISTIC k_TTR_Value_ManualOpenIMUBaseAngSpd "" VAL_BLK 0xb000657c /* @ECU_Address@k_TTR_Value_ManualOpenIMUBaseAngSpd@ */ Scalar_SWORD 0 POD_TipToRun_CM_int16 -32768 32767 NUMBER 2 /end CHARACTERISTIC
/begin CHARACTERISTIC k_TTR_Value_ManualOpenMaxSpeed "" VALUE 0xb000652c /* @ECU_Address@k_TTR_Value_ManualOpenMaxSpeed@ */ Scalar_SWORD 0 POD_TipToRun_CM_int16 -32768 32767 /end CHARACTERISTIC
/begin CHARACTERISTIC k_TTR_Value_ManualOpenMinSpeed "" VALUE 0xb000652e /* @ECU_Address@k_TTR_Value_ManualOpenMinSpeed@ */ Scalar_SWORD 0 POD_TipToRun_CM_int16 -32768 32767 /end CHARACTERISTIC
/begin CHARACTERISTIC k_TTR_Value_MovInBrkgToManualCloseMinSpeed "" VAL_BLK 0xb0006580 /* @ECU_Address@k_TTR_Value_MovInBrkgToManualCloseMinSpeed@ */ Scalar_SWORD 0 POD_TipToRun_CM_int16 -32768 32767 NUMBER 2 /end CHARACTERISTIC
/begin CHARACTERISTIC k_TTR_Value_MovInBrkgToManualCloseOffSetSpeed "" VALUE 0xb0006530 /* @ECU_Address@k_TTR_Value_MovInBrkgToManualCloseOffSetSpeed@ */ Scalar_SWORD 0 POD_TipToRun_CM_int16 -32768 32767 /end CHARACTERISTIC
/begin CHARACTERISTIC k_TTR_Value_MovOutBrkgToManualOpenMinSpeed "" VAL_BLK 0xb0006584 /* @ECU_Address@k_TTR_Value_MovOutBrkgToManualOpenMinSpeed@ */ Scalar_SWORD 0 POD_TipToRun_CM_int16 -32768 32767 NUMBER 2 /end CHARACTERISTIC
/begin CHARACTERISTIC k_TTR_Value_MovOutBrkgToManualOpenOffSetSpeed "" VAL_BLK 0xb0006588 /* @ECU_Address@k_TTR_Value_MovOutBrkgToManualOpenOffSetSpeed@ */ Scalar_SWORD 0 POD_TipToRun_CM_int16 -32768 32767 NUMBER 2 /end CHARACTERISTIC
/begin CHARACTERISTIC k_TTR_Value_SpdLowerThdforAsst "辅助转速下限阈值" VALUE 0xb0006532 /* @ECU_Address@k_TTR_Value_SpdLowerThdforAsst@ */ Scalar_SWORD 0 POD_TipToRun_CM_int16_rpm -9999.0 9999.0 /end CHARACTERISTIC
/begin CHARACTERISTIC k_TTR_Value_SpdThdforTTR "TTR转速阈值" VAL_BLK 0xb000658c /* @ECU_Address@k_TTR_Value_SpdThdforTTR@ */ Scalar_SWORD 0 POD_TipToRun_CM_int16_rpm -9999.0 9999.0 NUMBER 2 /end CHARACTERISTIC
/begin CHARACTERISTIC k_TTR_Value_SpdUpperThdforAsst "辅助转速上限阈值" VALUE 0xb0006534 /* @ECU_Address@k_TTR_Value_SpdUpperThdforAsst@ */ Scalar_SWORD 0 POD_TipToRun_CM_int16_rpm -9999.0 9999.0 /end CHARACTERISTIC
/begin CHARACTERISTIC k_TTR_Value_TTRDegThd "" VAL_BLK 0xb0006590 /* @ECU_Address@k_TTR_Value_TTRDegThd@ */ Scalar_SWORD 0 POD_TipToRun_CM_int16 -32768 32767 NUMBER 2 /end CHARACTERISTIC
/begin MEASUREMENT monr_VsTTR_ValueMovInBrkgInitPositionRTTR_deg "" SWORD POD_TipToRun_CM_int16 0 0 -32768 32767 ECU_ADDRESS 0xb005615a /* @ECU_Address@monr_VsTTR_ValueMovInBrkgInitPositionRTTR_deg@ */ /end MEASUREMENT
/begin MEASUREMENT monr_VsTTR_ValueManualCloseMinHallPosRTTR_deg "" SWORD POD_TipToRun_CM_int16 0 0 -32768 32767 ECU_ADDRESS 0xb0056152 /* @ECU_Address@monr_VsTTR_ValueManualCloseMinHallPosRTTR_deg@ */ /end MEASUREMENT
/begin MEASUREMENT monr_VsTTR_ValueMovOutBrkgInitPositionRTTR_deg "" SWORD POD_TipToRun_CM_int16 0 0 -32768 32767 ECU_ADDRESS 0xb005615e /* @ECU_Address@monr_VsTTR_ValueMovOutBrkgInitPositionRTTR_deg@ */ /end MEASUREMENT
/begin MEASUREMENT monr_VsTTR_ValueOriManualOpenMaxHallPosRTTR_deg "" SWORD POD_TipToRun_CM_int16 0 0 -32768 32767 ECU_ADDRESS 0xb0056162 /* @ECU_Address@monr_VsTTR_ValueOriManualOpenMaxHallPosRTTR_deg@ */ /end MEASUREMENT
/begin MEASUREMENT monr_VsTTR_PluseHoldPosRTTR_deg "" SWORD POD_TipToRun_CM_int16 0 0 -32768 32767 ECU_ADDRESS 0xb005614e /* @ECU_Address@monr_VsTTR_PluseHoldPosRTTR_deg@ */ /end MEASUREMENT
/begin MEASUREMENT monr_VsTTR_ValueManualOpenMaxHallPosRTTR_deg "" SWORD POD_TipToRun_CM_int16 0 0 -32768 32767 ECU_ADDRESS 0xb0056156 /* @ECU_Address@monr_VsTTR_ValueManualOpenMaxHallPosRTTR_deg@ */ /end MEASUREMENT
/begin MEASUREMENT monr_VsTTR_PluseHoldPosLTTR_deg "" SWORD POD_TipToRun_CM_int16 0 0 -32768 32767 ECU_ADDRESS 0xb005614c /* @ECU_Address@monr_VsTTR_PluseHoldPosLTTR_deg@ */ /end MEASUREMENT
/begin MEASUREMENT monr_VsTTR_ValueManualCloseMinHallPosLTTR_deg "" SWORD POD_TipToRun_CM_int16 0 0 -32768 32767 ECU_ADDRESS 0xb0056150 /* @ECU_Address@monr_VsTTR_ValueManualCloseMinHallPosLTTR_deg@ */ /end MEASUREMENT
/begin MEASUREMENT monr_VsTTR_ValueMovInBrkgInitPositionLTTR_deg "" SWORD POD_TipToRun_CM_int16 0 0 -32768 32767 ECU_ADDRESS 0xb0056158 /* @ECU_Address@monr_VsTTR_ValueMovInBrkgInitPositionLTTR_deg@ */ /end MEASUREMENT
/begin MEASUREMENT monr_VsTTR_ValueMovOutBrkgInitPositionLTTR_deg "" SWORD POD_TipToRun_CM_int16 0 0 -32768 32767 ECU_ADDRESS 0xb005615c /* @ECU_Address@monr_VsTTR_ValueMovOutBrkgInitPositionLTTR_deg@ */ /end MEASUREMENT
/begin MEASUREMENT monr_VsTTR_ValueOriManualOpenMaxHallPosLTTR_deg "" SWORD POD_TipToRun_CM_int16 0 0 -32768 32767 ECU_ADDRESS 0xb0056160 /* @ECU_Address@monr_VsTTR_ValueOriManualOpenMaxHallPosLTTR_deg@ */ /end MEASUREMENT
/begin MEASUREMENT monr_VsTTR_ValueManualOpenMaxHallPosLTTR_deg "" SWORD POD_TipToRun_CM_int16 0 0 -32768 32767 ECU_ADDRESS 0xb0056154 /* @ECU_Address@monr_VsTTR_ValueManualOpenMaxHallPosLTTR_deg@ */ /end MEASUREMENT
/begin MEASUREMENT monr_VsTTR_VauleManualCloseBaseAngSpdLTTR_degps "" SWORD POD_TipToRun_CM_int16 0 0 -32768 32767 ECU_ADDRESS 0xb0056164 /* @ECU_Address@monr_VsTTR_VauleManualCloseBaseAngSpdLTTR_degps@ */ /end MEASUREMENT
/begin MEASUREMENT monr_VbTTR_MuanBrkgZeroDistanceRTTR_flg "" UBYTE POD_TipToRun_CM_boolean 0 0 0 1 ECU_ADDRESS 0xb00560f1 /* @ECU_Address@monr_VbTTR_MuanBrkgZeroDistanceRTTR_flg@ */ /end MEASUREMENT
/begin MEASUREMENT monr_VbTTR_ManualHallSpeedBackRTTR_flg "" UBYTE POD_TipToRun_CM_boolean 0 0 0 1 ECU_ADDRESS 0xb00560e9 /* @ECU_Address@monr_VbTTR_ManualHallSpeedBackRTTR_flg@ */ /end MEASUREMENT
/begin MEASUREMENT monr_VbTTR_ManualAssistOpenRTTR_flg "" UBYTE POD_TipToRun_CM_boolean 0 0 0 1 ECU_ADDRESS 0xb00560e5 /* @ECU_Address@monr_VbTTR_ManualAssistOpenRTTR_flg@ */ /end MEASUREMENT
/begin MEASUREMENT monr_VbTTR_ElecToAssistOpenSpeedRTTR_flg "" UBYTE POD_TipToRun_CM_boolean 0 0 0 1 ECU_ADDRESS 0xb00560cf /* @ECU_Address@monr_VbTTR_ElecToAssistOpenSpeedRTTR_flg@ */ /end MEASUREMENT
/begin MEASUREMENT monr_VbTTR_BanOpenIMUErrorJudgeRTTR_flg "" UBYTE POD_TipToRun_CM_boolean 0 0 0 1 ECU_ADDRESS 0xb00560c5 /* @ECU_Address@monr_VbTTR_BanOpenIMUErrorJudgeRTTR_flg@ */ /end MEASUREMENT
/begin MEASUREMENT monr_VbTTR_ImuAngSpdOpenAccRTTR_flg "" UBYTE POD_TipToRun_CM_boolean 0 0 0 1 ECU_ADDRESS 0xb00560db /* @ECU_Address@monr_VbTTR_ImuAngSpdOpenAccRTTR_flg@ */ /end MEASUREMENT
/begin MEASUREMENT monr_VbTTR_IMUAngSpdToOpenRTTR_flg "" UBYTE POD_TipToRun_CM_boolean 0 0 0 1 ECU_ADDRESS 0xb00560df /* @ECU_Address@monr_VbTTR_IMUAngSpdToOpenRTTR_flg@ */ /end MEASUREMENT
/begin MEASUREMENT monr_VbTTR_ElecBrkgToAssistOpenRTTR_flg "" UBYTE POD_TipToRun_CM_boolean 0 0 0 1 ECU_ADDRESS 0xb00560c9 /* @ECU_Address@monr_VbTTR_ElecBrkgToAssistOpenRTTR_flg@ */ /end MEASUREMENT
/begin MEASUREMENT monr_VbTTR_ElecToAssistOpen_flg "" UBYTE POD_TipToRun_CM_boolean 0 0 0 1 ECU_ADDRESS 0xb00561b5 /* @ECU_Address@monr_VbTTR_ElecToAssistOpen_flg@ */ /end MEASUREMENT
/begin MEASUREMENT monr_VbTTR_HoldPosExitRTTR_flg "" UBYTE POD_TipToRun_CM_boolean 0 0 0 1 ECU_ADDRESS 0xb00560d3 /* @ECU_Address@monr_VbTTR_HoldPosExitRTTR_flg@ */ /end MEASUREMENT
/begin MEASUREMENT monr_VbTTR_HoldModeManAssistRTTR_flg "" UBYTE POD_TipToRun_CM_boolean 0 0 0 1 ECU_ADDRESS 0xb00560d1 /* @ECU_Address@monr_VbTTR_HoldModeManAssistRTTR_flg@ */ /end MEASUREMENT
/begin MEASUREMENT monr_VbTTR_StopToAssistOpen_flg "" UBYTE POD_TipToRun_CM_boolean 0 0 0 1 ECU_ADDRESS 0xb00561b6 /* @ECU_Address@monr_VbTTR_StopToAssistOpen_flg@ */ /end MEASUREMENT
/begin MEASUREMENT monr_VbTTR_ElecToAssistCloseSpeedRTTR_flg "" UBYTE POD_TipToRun_CM_boolean 0 0 0 1 ECU_ADDRESS 0xb00560cc /* @ECU_Address@monr_VbTTR_ElecToAssistCloseSpeedRTTR_flg@ */ /end MEASUREMENT
/begin MEASUREMENT monr_VbTTR_BanCloseIMUErrorJudgeRTTR_flg "" UBYTE POD_TipToRun_CM_boolean 0 0 0 1 ECU_ADDRESS 0xb00560c3 /* @ECU_Address@monr_VbTTR_BanCloseIMUErrorJudgeRTTR_flg@ */ /end MEASUREMENT
/begin MEASUREMENT monr_VbTTR_IMUAngSpdToCloseRTTR_flg "" UBYTE POD_TipToRun_CM_boolean 0 0 0 1 ECU_ADDRESS 0xb00560dd /* @ECU_Address@monr_VbTTR_IMUAngSpdToCloseRTTR_flg@ */ /end MEASUREMENT
/begin MEASUREMENT monr_VbTTR_ImuAngSpdCloseAccRTTR_flg "" UBYTE POD_TipToRun_CM_boolean 0 0 0 1 ECU_ADDRESS 0xb00560d9 /* @ECU_Address@monr_VbTTR_ImuAngSpdCloseAccRTTR_flg@ */ /end MEASUREMENT
/begin MEASUREMENT monr_VbTTR_ElecBrkgToAssistCloseRTTR_flg "" UBYTE POD_TipToRun_CM_boolean 0 0 0 1 ECU_ADDRESS 0xb00560c7 /* @ECU_Address@monr_VbTTR_ElecBrkgToAssistCloseRTTR_flg@ */ /end MEASUREMENT
/begin MEASUREMENT monr_VbTTR_ElecToAssistClose_flg "" UBYTE POD_TipToRun_CM_boolean 0 0 0 1 ECU_ADDRESS 0xb00561b4 /* @ECU_Address@monr_VbTTR_ElecToAssistClose_flg@ */ /end MEASUREMENT
/begin MEASUREMENT monr_VbTTR_StopToAssistClose_flg "" UBYTE POD_TipToRun_CM_boolean 0 0 0 1 ECU_ADDRESS 0xb00561b7 /* @ECU_Address@monr_VbTTR_StopToAssistClose_flg@ */ /end MEASUREMENT
/begin MEASUREMENT monr_VbTTR_ManualOpenToCloseMaxRangeRTTR_flg "" UBYTE POD_TipToRun_CM_boolean 0 0 0 1 ECU_ADDRESS 0xb00560ef /* @ECU_Address@monr_VbTTR_ManualOpenToCloseMaxRangeRTTR_flg@ */ /end MEASUREMENT
/begin MEASUREMENT monr_VbTTR_ManualOpenMaxHallPosNoWaitRTTR_flg "" UBYTE POD_TipToRun_CM_boolean 0 0 0 1 ECU_ADDRESS 0xb00560ed /* @ECU_Address@monr_VbTTR_ManualOpenMaxHallPosNoWaitRTTR_flg@ */ /end MEASUREMENT
/begin MEASUREMENT monr_VbTTR_ManualOpenMaxHallPosDecRTTR_flg "" UBYTE POD_TipToRun_CM_boolean 0 0 0 1 ECU_ADDRESS 0xb00560eb /* @ECU_Address@monr_VbTTR_ManualOpenMaxHallPosDecRTTR_flg@ */ /end MEASUREMENT
/begin MEASUREMENT monr_VbTTR_IMUToManualCloseRTTR_flg "" UBYTE POD_TipToRun_CM_boolean 0 0 0 1 ECU_ADDRESS 0xb00560e1 /* @ECU_Address@monr_VbTTR_IMUToManualCloseRTTR_flg@ */ /end MEASUREMENT
/begin MEASUREMENT monr_VbTTR_ManualCloseMovMinPosJudgeRTTR_flg "" UBYTE POD_TipToRun_CM_boolean 0 0 0 1 ECU_ADDRESS 0xb00560e7 /* @ECU_Address@monr_VbTTR_ManualCloseMovMinPosJudgeRTTR_flg@ */ /end MEASUREMENT
/begin MEASUREMENT monr_VbTTR_ManualAssistCloseRTTR_flg "" UBYTE POD_TipToRun_CM_boolean 0 0 0 1 ECU_ADDRESS 0xb00560e3 /* @ECU_Address@monr_VbTTR_ManualAssistCloseRTTR_flg@ */ /end MEASUREMENT
/begin MEASUREMENT monr_VbTTR_HoldPosExitLTTR_flg "" UBYTE POD_TipToRun_CM_boolean 0 0 0 1 ECU_ADDRESS 0xb00560d2 /* @ECU_Address@monr_VbTTR_HoldPosExitLTTR_flg@ */ /end MEASUREMENT
/begin MEASUREMENT monr_VbTTR_HoldModeManAssistLTTR_flg "" UBYTE POD_TipToRun_CM_boolean 0 0 0 1 ECU_ADDRESS 0xb00560d0 /* @ECU_Address@monr_VbTTR_HoldModeManAssistLTTR_flg@ */ /end MEASUREMENT
/begin MEASUREMENT monr_VbTTR_StopToAssistOpenLTTR_flg "" UBYTE POD_TipToRun_CM_boolean 0 0 0 1 ECU_ADDRESS 0xb00560f3 /* @ECU_Address@monr_VbTTR_StopToAssistOpenLTTR_flg@ */ /end MEASUREMENT
/begin MEASUREMENT monr_VbTTR_ElecToAssistOpenSpeedLTTR_flg "" UBYTE POD_TipToRun_CM_boolean 0 0 0 1 ECU_ADDRESS 0xb00560ce /* @ECU_Address@monr_VbTTR_ElecToAssistOpenSpeedLTTR_flg@ */ /end MEASUREMENT
/begin MEASUREMENT monr_VbTTR_BanOpenIMUErrorJudgeLTTR_flg "" UBYTE POD_TipToRun_CM_boolean 0 0 0 1 ECU_ADDRESS 0xb00560c4 /* @ECU_Address@monr_VbTTR_BanOpenIMUErrorJudgeLTTR_flg@ */ /end MEASUREMENT
/begin MEASUREMENT monr_VbTTR_ImuAngSpdOpenAccLTTR_flg "" UBYTE POD_TipToRun_CM_boolean 0 0 0 1 ECU_ADDRESS 0xb00560da /* @ECU_Address@monr_VbTTR_ImuAngSpdOpenAccLTTR_flg@ */ /end MEASUREMENT
/begin MEASUREMENT monr_VbTTR_IMUAngSpdToOpenLTTR_flg "" UBYTE POD_TipToRun_CM_boolean 0 0 0 1 ECU_ADDRESS 0xb00560de /* @ECU_Address@monr_VbTTR_IMUAngSpdToOpenLTTR_flg@ */ /end MEASUREMENT
/begin MEASUREMENT monr_VbTTR_ElecBrkgToAssistOpenLTTR_flg "" UBYTE POD_TipToRun_CM_boolean 0 0 0 1 ECU_ADDRESS 0xb00560c8 /* @ECU_Address@monr_VbTTR_ElecBrkgToAssistOpenLTTR_flg@ */ /end MEASUREMENT
/begin MEASUREMENT monr_VbTTR_ElecToAssistOpenLTTR_flg "" UBYTE POD_TipToRun_CM_boolean 0 0 0 1 ECU_ADDRESS 0xb00560cd /* @ECU_Address@monr_VbTTR_ElecToAssistOpenLTTR_flg@ */ /end MEASUREMENT
/begin MEASUREMENT monr_VbTTR_MuanBrkgZeroDistanceLTTR_flg "" UBYTE POD_TipToRun_CM_boolean 0 0 0 1 ECU_ADDRESS 0xb00560f0 /* @ECU_Address@monr_VbTTR_MuanBrkgZeroDistanceLTTR_flg@ */ /end MEASUREMENT
/begin MEASUREMENT monr_VbTTR_ManualHallSpeedBackLTTR_flg "" UBYTE POD_TipToRun_CM_boolean 0 0 0 1 ECU_ADDRESS 0xb00560e8 /* @ECU_Address@monr_VbTTR_ManualHallSpeedBackLTTR_flg@ */ /end MEASUREMENT
/begin MEASUREMENT monr_VbTTR_ManualAssistOpenLTTR_flg "" UBYTE POD_TipToRun_CM_boolean 0 0 0 1 ECU_ADDRESS 0xb00560e4 /* @ECU_Address@monr_VbTTR_ManualAssistOpenLTTR_flg@ */ /end MEASUREMENT
/begin MEASUREMENT monr_VbTTR_ElecToAssistCloseSpeedLTTR_flg "" UBYTE POD_TipToRun_CM_boolean 0 0 0 1 ECU_ADDRESS 0xb00560cb /* @ECU_Address@monr_VbTTR_ElecToAssistCloseSpeedLTTR_flg@ */ /end MEASUREMENT
/begin MEASUREMENT monr_VbTTR_BanCloseIMUErrorJudgeLTTR_flg "" UBYTE POD_TipToRun_CM_boolean 0 0 0 1 ECU_ADDRESS 0xb00560c2 /* @ECU_Address@monr_VbTTR_BanCloseIMUErrorJudgeLTTR_flg@ */ /end MEASUREMENT
/begin MEASUREMENT monr_VbTTR_IMUAngSpdToCloseLTTR_flg "" UBYTE POD_TipToRun_CM_boolean 0 0 0 1 ECU_ADDRESS 0xb00560dc /* @ECU_Address@monr_VbTTR_IMUAngSpdToCloseLTTR_flg@ */ /end MEASUREMENT
/begin MEASUREMENT monr_VbTTR_ImuAngSpdCloseAccLTTR_flg "" UBYTE POD_TipToRun_CM_boolean 0 0 0 1 ECU_ADDRESS 0xb00560d8 /* @ECU_Address@monr_VbTTR_ImuAngSpdCloseAccLTTR_flg@ */ /end MEASUREMENT
/begin MEASUREMENT monr_VbTTR_ElecBrkgToAssistCloseLTTR_flg "" UBYTE POD_TipToRun_CM_boolean 0 0 0 1 ECU_ADDRESS 0xb00560c6 /* @ECU_Address@monr_VbTTR_ElecBrkgToAssistCloseLTTR_flg@ */ /end MEASUREMENT
/begin MEASUREMENT monr_VbTTR_ElecToAssistCloseLTTR_flg "" UBYTE POD_TipToRun_CM_boolean 0 0 0 1 ECU_ADDRESS 0xb00560ca /* @ECU_Address@monr_VbTTR_ElecToAssistCloseLTTR_flg@ */ /end MEASUREMENT
/begin MEASUREMENT monr_VbTTR_StopToAssistCloseLTTR_flg "" UBYTE POD_TipToRun_CM_boolean 0 0 0 1 ECU_ADDRESS 0xb00560f2 /* @ECU_Address@monr_VbTTR_StopToAssistCloseLTTR_flg@ */ /end MEASUREMENT
/begin MEASUREMENT monr_VbTTR_ManualOpenToCloseMaxRangeLTTR_flg "" UBYTE POD_TipToRun_CM_boolean 0 0 0 1 ECU_ADDRESS 0xb00560ee /* @ECU_Address@monr_VbTTR_ManualOpenToCloseMaxRangeLTTR_flg@ */ /end MEASUREMENT
/begin MEASUREMENT monr_VbTTR_ManualOpenMaxHallPosNoWaitLTTR_flg "" UBYTE POD_TipToRun_CM_boolean 0 0 0 1 ECU_ADDRESS 0xb00560ec /* @ECU_Address@monr_VbTTR_ManualOpenMaxHallPosNoWaitLTTR_flg@ */ /end MEASUREMENT
/begin MEASUREMENT monr_VbTTR_IMUAngSpdAccToCloseLTTR_flg "" UBYTE POD_TipToRun_CM_boolean 0 0 0 1 ECU_ADDRESS 0xb00560d4 /* @ECU_Address@monr_VbTTR_IMUAngSpdAccToCloseLTTR_flg@ */ /end MEASUREMENT
/begin MEASUREMENT monr_VbTTR_ManualOpenMaxHallPosDecLTTR_flg "" UBYTE POD_TipToRun_CM_boolean 0 0 0 1 ECU_ADDRESS 0xb00560ea /* @ECU_Address@monr_VbTTR_ManualOpenMaxHallPosDecLTTR_flg@ */ /end MEASUREMENT
/begin MEASUREMENT monr_VbTTR_IMUToManualCloseLTTR_flg "" UBYTE POD_TipToRun_CM_boolean 0 0 0 1 ECU_ADDRESS 0xb00560e0 /* @ECU_Address@monr_VbTTR_IMUToManualCloseLTTR_flg@ */ /end MEASUREMENT
/begin MEASUREMENT monr_VbTTR_ManualCloseMovMinPosJudgeLTTR_flg "" UBYTE POD_TipToRun_CM_boolean 0 0 0 1 ECU_ADDRESS 0xb00560e6 /* @ECU_Address@monr_VbTTR_ManualCloseMovMinPosJudgeLTTR_flg@ */ /end MEASUREMENT
/begin MEASUREMENT monr_VbTTR_ManualAssistCloseLTTR_flg "" UBYTE POD_TipToRun_CM_boolean 0 0 0 1 ECU_ADDRESS 0xb00560e2 /* @ECU_Address@monr_VbTTR_ManualAssistCloseLTTR_flg@ */ /end MEASUREMENT
/begin COMPU_METHOD POD_TipToRun_CM_single "Q = V" RAT_FUNC "%8.6" "" COEFFS 0 1 0 0 0 1 /end COMPU_METHOD
/begin COMPU_METHOD POD_TipToRun_CM_int16 "Q = V" RAT_FUNC "%5.0" "" COEFFS 0 1 0 0 0 1 /end COMPU_METHOD
/begin COMPU_METHOD POD_TipToRun_CM_int16_rpm "Q = V" RAT_FUNC "%5.0" "rpm" COEFFS 0 1 0 0 0 1 /end COMPU_METHOD
/begin COMPU_METHOD POD_TipToRun_CM_boolean "Q = V" RAT_FUNC "%1.0" "" COEFFS 0 1 0 0 0 1 /end COMPU_METHOD
/begin GROUP S7_StopToAssist "POD_TipToRun/POD_TipToRun/TipToRun/TipToRunL/ManAsstRqst/StopToAssist"
 /begin SUB_GROUP S18_Rising_Debounce S18_Rising_Debounce1 S18_Rising_Debounce2 S18_Rising_Debounce3 /end SUB_GROUP
 /begin REF_CHARACTERISTIC k_TTR_Deg_RoadInclnThdAssis k_TTR_Deg_RollAgGlbThdAssis k_TTR_Value_HoldHallPosExit k_TTR_Value_IMUHoldExitMinSpeed k_TTR_Value_SpdLowerThdforAsst k_TTR_Value_SpdUpperThdforAsst /end REF_CHARACTERISTIC
 /begin REF_MEASUREMENT monr_VbTTR_HoldModeManAssistLTTR_flg monr_VbTTR_HoldPosExitLTTR_flg monr_VbTTR_StopToAssistCloseLTTR_flg monr_VbTTR_StopToAssistOpenLTTR_flg monr_VsTTR_PluseHoldPosLTTR_deg /end REF_MEASUREMENT
/end GROUP
/begin GROUP S8_ForR_Para "POD_TipToRun/POD_TipToRun/TipToRun/TipToRunL/TipToRunRqst/ForR_Para"
 /begin REF_CHARACTERISTIC k_TTR_Value_ImuAngAccSpdThdforTTR k_TTR_Value_ImuAngSpdThdforTTR k_TTR_Value_SpdThdforTTR k_TTR_Value_TTRDegThd /end REF_CHARACTERISTIC
/end GROUP
/begin GROUP S175_ElecToAssist "POD_TipToRun/POD_TipToRun/TipToRun/TipToRunR/ManAsstRqst/ElecToAssist"
 /begin SUB_GROUP S183_ElecMovInBrkgIMUSpdJudge S183_ElecMovOutBrkgIMUSpdJudge S183_ElecToAssistCloseJudge S183_ElecToAssistIMUErrorSpdOrAccJudge S183_ElecToAssistIMUSpdJudge S183_ElecToAssistOpenJudge S183_ElecToManualCloseIMUAccJudge S183_ElecToManualOpenIMUAccJudge S183_ForR_Para /end SUB_GROUP
/end GROUP
/begin GROUP S175_ManualSpdBack "POD_TipToRun/POD_TipToRun/TipToRun/TipToRunR/ManAsstRqst/ManualSpdBack"
 /begin SUB_GROUP S185_ForR_Para S185_ManualAssistJudge S185_ManualCloseToOpenJudge S185_ManualOpenOrCloseMaxPos S185_ManualOpenToCloseJudge /end SUB_GROUP
/end GROUP
/begin GROUP S175_StopToAssist "POD_TipToRun/POD_TipToRun/TipToRun/TipToRunR/ManAsstRqst/StopToAssist"
 /begin SUB_GROUP S186_Rising_Debounce S186_Rising_Debounce1 S186_Rising_Debounce2 S186_Rising_Debounce3 /end SUB_GROUP
 /begin REF_CHARACTERISTIC k_TTR_Deg_RoadInclnThdAssis k_TTR_Deg_RollAgGlbThdAssis k_TTR_Value_HoldHallPosExit k_TTR_Value_IMUHoldExitMinSpeed k_TTR_Value_SpdLowerThdforAsst k_TTR_Value_SpdUpperThdforAsst /end REF_CHARACTERISTIC
 /begin REF_MEASUREMENT monr_VbTTR_HoldModeManAssistRTTR_flg monr_VbTTR_HoldPosExitRTTR_flg monr_VbTTR_StopToAssistClose_flg monr_VbTTR_StopToAssistOpen_flg monr_VsTTR_PluseHoldPosRTTR_deg /end REF_MEASUREMENT
/end GROUP
/begin GROUP S176_ForR_Para "POD_TipToRun/POD_TipToRun/TipToRun/TipToRunR/TipToRunRqst/ForR_Para"
 /begin REF_CHARACTERISTIC k_TTR_Value_ImuAngAccSpdThdforTTR k_TTR_Value_ImuAngSpdThdforTTR k_TTR_Value_SpdThdforTTR k_TTR_Value_TTRDegThd /end REF_CHARACTERISTIC
/end GROUP
/begin GROUP S15_ElecMovInBrkgIMUSpdJudge "POD_TipToRun/POD_TipToRun/TipToRun/TipToRunL/ManAsstRqst/ElecToAssist/ElecMovInBrkgIMUSpdJudge" /begin SUB_GROUP S19_RisingDelay /end SUB_GROUP /begin REF_CHARACTERISTIC k_TTR_Value_MovInBrkgToManualCloseOffSetSpeed /end REF_CHARACTERISTIC /begin REF_MEASUREMENT monr_VbTTR_IMUAngSpdToCloseLTTR_flg /end REF_MEASUREMENT /end GROUP
/begin GROUP S15_ElecMovOutBrkgIMUSpdJudge "POD_TipToRun/POD_TipToRun/TipToRun/TipToRunL/ManAsstRqst/ElecToAssist/ElecMovOutBrkgIMUSpdJudge" /begin SUB_GROUP S20_RisingDelay S20_Rising_Debounce1 /end SUB_GROUP /begin REF_MEASUREMENT monr_VbTTR_IMUAngSpdToOpenLTTR_flg /end REF_MEASUREMENT /end GROUP
/begin GROUP S15_ElecToAssistCloseJudge "POD_TipToRun/POD_TipToRun/TipToRun/TipToRunL/ManAsstRqst/ElecToAssist/ElecToAssistCloseJudge" /begin REF_CHARACTERISTIC k_TTR_Value_ElecToManualCloseMinSpeed /end REF_CHARACTERISTIC /begin REF_MEASUREMENT monr_VbTTR_ElecToAssistCloseLTTR_flg /end REF_MEASUREMENT /end GROUP
/begin GROUP S15_ElecToAssistIMUErrorSpdOrAccJudge "POD_TipToRun/POD_TipToRun/TipToRun/TipToRunL/ManAsstRqst/ElecToAssist/ElecToAssistIMUErrorSpdOrAccJudge" /begin SUB_GROUP S23_Falling_Debounce S23_Falling_Debounce1 /end SUB_GROUP
 /begin REF_CHARACTERISTIC k_TTR_Value_ElecCloseDoorMinAcc k_TTR_Value_ElecOpenDoorMinAcc /end REF_CHARACTERISTIC
 /begin REF_MEASUREMENT monr_VbTTR_BanCloseIMUErrorJudgeLTTR_flg monr_VbTTR_BanOpenIMUErrorJudgeLTTR_flg /end REF_MEASUREMENT
/end GROUP
/begin GROUP S15_ElecToAssistIMUSpdJudge "POD_TipToRun/POD_TipToRun/TipToRun/TipToRunL/ManAsstRqst/ElecToAssist/ElecToAssistIMUSpdJudge" /begin SUB_GROUP S24_Rising_Debounce S24_Rising_Debounce1 /end SUB_GROUP
 /begin REF_CHARACTERISTIC k_TTR_Value_ElecToManualCloseMinSpeed k_TTR_Value_ElecToManualOpenMinSpeed /end REF_CHARACTERISTIC
 /begin REF_MEASUREMENT monr_VbTTR_ElecToAssistCloseSpeedLTTR_flg monr_VbTTR_ElecToAssistOpenSpeedLTTR_flg /end REF_MEASUREMENT
/end GROUP
/begin GROUP S15_ElecToAssistOpenJudge "POD_TipToRun/POD_TipToRun/TipToRun/TipToRunL/ManAsstRqst/ElecToAssist/ElecToAssistOpenJudge" /begin REF_CHARACTERISTIC k_TTR_Value_ElecToManualOpenMinSpeed /end REF_CHARACTERISTIC /begin REF_MEASUREMENT monr_VbTTR_ElecToAssistOpenLTTR_flg /end REF_MEASUREMENT /end GROUP
/begin GROUP S15_ElecToManualCloseIMUAccJudge "POD_TipToRun/POD_TipToRun/TipToRun/TipToRunL/ManAsstRqst/ElecToAssist/ElecToManualCloseIMUAccJudge" /begin SUB_GROUP S26_Rising_Debounce2 S26_Rising_Debounce4 /end SUB_GROUP
 /begin REF_CHARACTERISTIC k_TTR_Pluse_ManualAssistMinPos k_TTR_Value_ManualCloseACCDiff k_TTR_Value_ManualCloseMaxAcc k_TTR_Value_ManualCloseMinAcc /end REF_CHARACTERISTIC
 /begin REF_MEASUREMENT monr_VbTTR_ImuAngSpdCloseAccLTTR_flg /end REF_MEASUREMENT
/end GROUP
/begin GROUP S15_ElecToManualOpenIMUAccJudge "POD_TipToRun/POD_TipToRun/TipToRun/TipToRunL/ManAsstRqst/ElecToAssist/ElecToManualOpenIMUAccJudge"
 /begin SUB_GROUP S27_Rising_Debounce1 S27_Rising_Debounce2 S27_Rising_Debounce3 /end SUB_GROUP
 /begin REF_CHARACTERISTIC k_TTR_Deg_RoadInclnThdAssis k_TTR_Deg_RollAgGlbThdAssis k_TTR_Pluse_ManualAssistMinPos k_TTR_Value_ManualMaxAcc k_TTR_Value_ManualMinAcc /end REF_CHARACTERISTIC
 /begin REF_MEASUREMENT monr_VbTTR_ImuAngSpdOpenAccLTTR_flg /end REF_MEASUREMENT
/end GROUP
/begin GROUP S15_ForR_Para "POD_TipToRun/POD_TipToRun/TipToRun/TipToRunL/ManAsstRqst/ElecToAssist/ForR_Para"
 /begin REF_CHARACTERISTIC k_TTR_Ti_DoorBrkgToAssistCloseTi k_TTR_Ti_DoorBrkgToAssistOpenTi k_TTR_Ti_DoorCloseACCDecJudgeTi k_TTR_Ti_DoorCloseACCIncJudgeTi k_TTR_Ti_DoorOpenACCDecJudgeTi k_TTR_Ti_DoorOpenACCIncJudgeTi k_TTR_Value_ManualOpenACCDiff k_TTR_Value_MovInBrkgToManualCloseMinSpeed k_TTR_Value_MovOutBrkgToManualOpenMinSpeed k_TTR_Value_MovOutBrkgToManualOpenOffSetSpeed /end REF_CHARACTERISTIC
/end GROUP
/begin GROUP S17_ForR_Para "POD_TipToRun/POD_TipToRun/TipToRun/TipToRunL/ManAsstRqst/ManualSpdBack/ForR_Para"
 /begin REF_CHARACTERISTIC k_TTR_Value_ManualBrkgCloseMinAcc k_TTR_Value_ManualCloseIMUBaseAngSpd k_TTR_Value_ManualOpenIMUBaseAngSpd /end REF_CHARACTERISTIC
/end GROUP
/begin GROUP S17_ManualAssistJudge "POD_TipToRun/POD_TipToRun/TipToRun/TipToRunL/ManAsstRqst/ManualSpdBack/ManualAssistJudge" /begin REF_CHARACTERISTIC k_TTR_Pluse_ManualAssistMinPos /end REF_CHARACTERISTIC
 /begin REF_MEASUREMENT monr_VbTTR_ManualAssistCloseLTTR_flg monr_VbTTR_ManualAssistOpenLTTR_flg /end REF_MEASUREMENT
/end GROUP
/begin GROUP S17_ManualCloseToOpenJudge "POD_TipToRun/POD_TipToRun/TipToRun/TipToRunL/ManAsstRqst/ManualSpdBack/ManualCloseToOpenJudge" /begin SUB_GROUP S113_Rising_Debounce1 S113_Rising_Debounce2 /end SUB_GROUP
 /begin REF_CHARACTERISTIC K_TTR_Value_RoadManualOpenIMUFactor K_TTR_Value_RollManualOpenIMUFactor k_TTR_Value_IMUAngSpdAccDecRate k_TTR_Value_IMUAngSpdToOpenOffset k_TTR_Value_ManualBrkgOpenMaxAcc k_TTR_Value_ManualBrkgOpenMinAcc k_TTR_Value_ManualBrkgToOpenMinPos k_TTR_Value_ManualOpenMaxSpeed k_TTR_Value_ManualOpenMinSpeed /end REF_CHARACTERISTIC
/end GROUP
/begin GROUP S17_ManualOpenOrCloseMaxPos "POD_TipToRun/POD_TipToRun/TipToRun/TipToRunL/ManAsstRqst/ManualSpdBack/ManualOpenOrCloseMaxPos" /begin SUB_GROUP S114_Rising_Debounce /end SUB_GROUP
 /begin REF_CHARACTERISTIC k_TTR_Value_IMUAngSpdProtectMaxRebound k_TTR_Value_ManualBackMinHallSpeed /end REF_CHARACTERISTIC
 /begin REF_MEASUREMENT monr_VbTTR_ManualHallSpeedBackLTTR_flg monr_VbTTR_ManualOpenMaxHallPosDecLTTR_flg monr_VbTTR_ManualOpenMaxHallPosNoWaitLTTR_flg monr_VbTTR_ManualOpenToCloseMaxRangeLTTR_flg monr_VbTTR_MuanBrkgZeroDistanceLTTR_flg monr_VsTTR_ValueManualCloseMinHallPosLTTR_deg monr_VsTTR_ValueManualOpenMaxHallPosLTTR_deg monr_VsTTR_ValueMovInBrkgInitPositionLTTR_deg monr_VsTTR_ValueMovOutBrkgInitPositionLTTR_deg monr_VsTTR_ValueOriManualOpenMaxHallPosLTTR_deg /end REF_MEASUREMENT
/end GROUP
/begin GROUP S17_ManualOpenToCloseJudge "POD_TipToRun/POD_TipToRun/TipToRun/TipToRunL/ManAsstRqst/ManualSpdBack/ManualOpenToCloseJudge" /begin SUB_GROUP S115_Rising_Debounce1 S115_Rising_Debounce2 /end SUB_GROUP
 /begin REF_CHARACTERISTIC K_TTR_Value_RoadManualCloseIMUFactor K_TTR_Value_RollManualCloseIMUFactor k_TTR_Value_IMUAngSpdAccToCloseDecRate k_TTR_Value_IMUAngSpdToCloseOffset k_TTR_Value_ManualBrkgCloseMaxAcc k_TTR_Value_ManualBrkgToCloseMinPos k_TTR_Value_ManualCloseIMUBaseAngSpdOffset k_TTR_Value_ManualCloseMaxSpeed k_TTR_Value_ManualCloseMinSpeed /end REF_CHARACTERISTIC
 /begin REF_MEASUREMENT monr_VbTTR_IMUAngSpdAccToCloseLTTR_flg monr_VbTTR_IMUToManualCloseLTTR_flg monr_VbTTR_ManualCloseMovMinPosJudgeLTTR_flg monr_VsTTR_VauleManualCloseBaseAngSpdLTTR_degps /end REF_MEASUREMENT
/end GROUP
/begin GROUP S18_Rising_Debounce "POD_TipToRun/POD_TipToRun/TipToRun/TipToRunL/ManAsstRqst/StopToAssist/Rising Debounce" /begin REF_CHARACTERISTIC k_TTR_Value_HoldModeRisTimer /end REF_CHARACTERISTIC /end GROUP
/begin GROUP S18_Rising_Debounce1 "POD_TipToRun/POD_TipToRun/TipToRun/TipToRunL/ManAsstRqst/StopToAssist/Rising Debounce1" /begin REF_CHARACTERISTIC k_TTR_Value_HoldModeIMURisTimer /end REF_CHARACTERISTIC /end GROUP
/begin GROUP S18_Rising_Debounce2 "POD_TipToRun/POD_TipToRun/TipToRun/TipToRunL/ManAsstRqst/StopToAssist/Rising Debounce2" /begin REF_CHARACTERISTIC k_TTR_Value_HoldModePosOnTimer /end REF_CHARACTERISTIC /end GROUP
/begin GROUP S18_Rising_Debounce3 "POD_TipToRun/POD_TipToRun/TipToRun/TipToRunL/ManAsstRqst/StopToAssist/Rising Debounce3" /begin REF_CHARACTERISTIC k_TTR_Ti_ManualAssistJudgeCnt /end REF_CHARACTERISTIC /end GROUP
/begin GROUP S183_ElecMovInBrkgIMUSpdJudge "POD_TipToRun/POD_TipToRun/TipToRun/TipToRunR/ManAsstRqst/ElecToAssist/ElecMovInBrkgIMUSpdJudge" /begin SUB_GROUP S187_RisingDelay /end SUB_GROUP /begin REF_CHARACTERISTIC k_TTR_Value_MovInBrkgToManualCloseOffSetSpeed /end REF_CHARACTERISTIC /begin REF_MEASUREMENT monr_VbTTR_IMUAngSpdToCloseRTTR_flg /end REF_MEASUREMENT /end GROUP
/begin GROUP S183_ElecMovOutBrkgIMUSpdJudge "POD_TipToRun/POD_TipToRun/TipToRun/TipToRunR/ManAsstRqst/ElecToAssist/ElecMovOutBrkgIMUSpdJudge" /begin SUB_GROUP S188_RisingDelay S188_Rising_Debounce1 /end SUB_GROUP /begin REF_MEASUREMENT monr_VbTTR_IMUAngSpdToOpenRTTR_flg /end REF_MEASUREMENT /end GROUP
/begin GROUP S183_ElecToAssistCloseJudge "POD_TipToRun/POD_TipToRun/TipToRun/TipToRunR/ManAsstRqst/ElecToAssist/ElecToAssistCloseJudge" /begin REF_CHARACTERISTIC k_TTR_Value_ElecToManualCloseMinSpeed /end REF_CHARACTERISTIC /begin REF_MEASUREMENT monr_VbTTR_ElecToAssistClose_flg /end REF_MEASUREMENT /end GROUP
/begin GROUP S183_ElecToAssistIMUErrorSpdOrAccJudge "POD_TipToRun/POD_TipToRun/TipToRun/TipToRunR/ManAsstRqst/ElecToAssist/ElecToAssistIMUErrorSpdOrAccJudge" /begin SUB_GROUP S191_Falling_Debounce S191_Falling_Debounce1 /end SUB_GROUP
 /begin REF_CHARACTERISTIC k_TTR_Value_ElecCloseDoorMinAcc k_TTR_Value_ElecOpenDoorMinAcc /end REF_CHARACTERISTIC
 /begin REF_MEASUREMENT monr_VbTTR_BanCloseIMUErrorJudgeRTTR_flg monr_VbTTR_BanOpenIMUErrorJudgeRTTR_flg /end REF_MEASUREMENT
/end GROUP
/begin GROUP S183_ElecToAssistIMUSpdJudge "POD_TipToRun/POD_TipToRun/TipToRun/TipToRunR/ManAsstRqst/ElecToAssist/ElecToAssistIMUSpdJudge" /begin SUB_GROUP S192_Rising_Debounce S192_Rising_Debounce1 /end SUB_GROUP
 /begin REF_CHARACTERISTIC k_TTR_Value_ElecToManualCloseMinSpeed k_TTR_Value_ElecToManualOpenMinSpeed /end REF_CHARACTERISTIC
 /begin REF_MEASUREMENT monr_VbTTR_ElecToAssistCloseSpeedRTTR_flg monr_VbTTR_ElecToAssistOpenSpeedRTTR_flg /end REF_MEASUREMENT
/end GROUP
/begin GROUP S183_ElecToAssistOpenJudge "POD_TipToRun/POD_TipToRun/TipToRun/TipToRunR/ManAsstRqst/ElecToAssist/ElecToAssistOpenJudge" /begin REF_CHARACTERISTIC k_TTR_Value_ElecToManualOpenMinSpeed /end REF_CHARACTERISTIC /begin REF_MEASUREMENT monr_VbTTR_ElecToAssistOpen_flg /end REF_MEASUREMENT /end GROUP
/begin GROUP S183_ElecToManualCloseIMUAccJudge "POD_TipToRun/POD_TipToRun/TipToRun/TipToRunR/ManAsstRqst/ElecToAssist/ElecToManualCloseIMUAccJudge" /begin SUB_GROUP S194_Rising_Debounce2 S194_Rising_Debounce4 /end SUB_GROUP
 /begin REF_CHARACTERISTIC k_TTR_Pluse_ManualAssistMinPos k_TTR_Value_ManualCloseACCDiff k_TTR_Value_ManualCloseMaxAcc k_TTR_Value_ManualCloseMinAcc /end REF_CHARACTERISTIC
 /begin REF_MEASUREMENT monr_VbTTR_ImuAngSpdCloseAccRTTR_flg /end REF_MEASUREMENT
/end GROUP
/begin GROUP S183_ElecToManualOpenIMUAccJudge "POD_TipToRun/POD_TipToRun/TipToRun/TipToRunR/ManAsstRqst/ElecToAssist/ElecToManualOpenIMUAccJudge"
 /begin SUB_GROUP S195_Rising_Debounce1 S195_Rising_Debounce2 S195_Rising_Debounce3 /end SUB_GROUP
 /begin REF_CHARACTERISTIC k_TTR_Deg_RoadInclnThdAssis k_TTR_Deg_RollAgGlbThdAssis k_TTR_Pluse_ManualAssistMinPos k_TTR_Value_ManualMaxAcc k_TTR_Value_ManualMinAcc /end REF_CHARACTERISTIC
 /begin REF_MEASUREMENT monr_VbTTR_ImuAngSpdOpenAccRTTR_flg /end REF_MEASUREMENT
/end GROUP
/begin GROUP S183_ForR_Para "POD_TipToRun/POD_TipToRun/TipToRun/TipToRunR/ManAsstRqst/ElecToAssist/ForR_Para"
 /begin REF_CHARACTERISTIC k_TTR_Ti_DoorBrkgToAssistCloseTi k_TTR_Ti_DoorBrkgToAssistOpenTi k_TTR_Ti_DoorCloseACCDecJudgeTi k_TTR_Ti_DoorCloseACCIncJudgeTi k_TTR_Ti_DoorOpenACCDecJudgeTi k_TTR_Ti_DoorOpenACCIncJudgeTi k_TTR_Value_ManualOpenACCDiff k_TTR_Value_MovInBrkgToManualCloseMinSpeed k_TTR_Value_MovOutBrkgToManualOpenMinSpeed k_TTR_Value_MovOutBrkgToManualOpenOffSetSpeed /end REF_CHARACTERISTIC
/end GROUP
/begin GROUP S185_ForR_Para "POD_TipToRun/POD_TipToRun/TipToRun/TipToRunR/ManAsstRqst/ManualSpdBack/ForR_Para"
 /begin REF_CHARACTERISTIC k_TTR_Value_ManualBrkgCloseMinAcc k_TTR_Value_ManualCloseIMUBaseAngSpd k_TTR_Value_ManualOpenIMUBaseAngSpd /end REF_CHARACTERISTIC
/end GROUP
/begin GROUP S185_ManualAssistJudge "POD_TipToRun/POD_TipToRun/TipToRun/TipToRunR/ManAsstRqst/ManualSpdBack/ManualAssistJudge" /begin REF_CHARACTERISTIC k_TTR_Pluse_ManualAssistMinPos /end REF_CHARACTERISTIC
 /begin REF_MEASUREMENT monr_VbTTR_ManualAssistCloseRTTR_flg monr_VbTTR_ManualAssistOpenRTTR_flg /end REF_MEASUREMENT
/end GROUP
/begin GROUP S185_ManualCloseToOpenJudge "POD_TipToRun/POD_TipToRun/TipToRun/TipToRunR/ManAsstRqst/ManualSpdBack/ManualCloseToOpenJudge" /begin SUB_GROUP S281_Rising_Debounce1 S281_Rising_Debounce2 /end SUB_GROUP
 /begin REF_CHARACTERISTIC K_TTR_Value_RoadManualOpenIMUFactor K_TTR_Value_RollManualOpenIMUFactor k_TTR_Value_IMUAngSpdAccDecRate k_TTR_Value_IMUAngSpdToOpenOffset k_TTR_Value_ManualBrkgOpenMaxAcc k_TTR_Value_ManualBrkgOpenMinAcc k_TTR_Value_ManualBrkgToOpenMinPos k_TTR_Value_ManualOpenMaxSpeed k_TTR_Value_ManualOpenMinSpeed /end REF_CHARACTERISTIC
/end GROUP
/begin GROUP S185_ManualOpenOrCloseMaxPos "POD_TipToRun/POD_TipToRun/TipToRun/TipToRunR/ManAsstRqst/ManualSpdBack/ManualOpenOrCloseMaxPos" /begin SUB_GROUP S282_Rising_Debounce /end SUB_GROUP
 /begin REF_CHARACTERISTIC k_TTR_Value_IMUAngSpdProtectMaxRebound k_TTR_Value_ManualBackMinHallSpeed /end REF_CHARACTERISTIC
 /begin REF_MEASUREMENT monr_VbTTR_ManualHallSpeedBackRTTR_flg monr_VbTTR_ManualOpenMaxHallPosDecRTTR_flg monr_VbTTR_ManualOpenMaxHallPosNoWaitRTTR_flg monr_VbTTR_ManualOpenToCloseMaxRangeRTTR_flg monr_VbTTR_MuanBrkgZeroDistanceRTTR_flg monr_VsTTR_ValueManualCloseMinHallPosRTTR_deg monr_VsTTR_ValueManualOpenMaxHallPosRTTR_deg monr_VsTTR_ValueMovInBrkgInitPositionRTTR_deg monr_VsTTR_ValueMovOutBrkgInitPositionRTTR_deg monr_VsTTR_ValueOriManualOpenMaxHallPosRTTR_deg /end REF_MEASUREMENT
/end GROUP
/begin GROUP S185_ManualOpenToCloseJudge "POD_TipToRun/POD_TipToRun/TipToRun/TipToRunR/ManAsstRqst/ManualSpdBack/ManualOpenToCloseJudge" /begin SUB_GROUP S283_Rising_Debounce1 S283_Rising_Debounce2 /end SUB_GROUP
 /begin REF_CHARACTERISTIC K_TTR_Value_RoadManualCloseIMUFactor K_TTR_Value_RollManualCloseIMUFactor k_TTR_Value_IMUAngSpdAccToCloseDecRate k_TTR_Value_IMUAngSpdToCloseOffset k_TTR_Value_ManualBrkgCloseMaxAcc k_TTR_Value_ManualBrkgToCloseMinPos k_TTR_Value_ManualCloseIMUBaseAngSpdOffset k_TTR_Value_ManualCloseMaxSpeed k_TTR_Value_ManualCloseMinSpeed /end REF_CHARACTERISTIC
 /begin REF_MEASUREMENT monr_VbTTR_IMUToManualCloseRTTR_flg monr_VbTTR_ManualCloseMovMinPosJudgeRTTR_flg /end REF_MEASUREMENT
/end GROUP
/begin GROUP S186_Rising_Debounce "POD_TipToRun/POD_TipToRun/TipToRun/TipToRunR/ManAsstRqst/StopToAssist/Rising Debounce" /begin REF_CHARACTERISTIC k_TTR_Value_HoldModeRisTimer /end REF_CHARACTERISTIC /end GROUP
/begin GROUP S186_Rising_Debounce1 "POD_TipToRun/POD_TipToRun/TipToRun/TipToRunR/ManAsstRqst/StopToAssist/Rising Debounce1" /begin REF_CHARACTERISTIC k_TTR_Value_HoldModeIMURisTimer /end REF_CHARACTERISTIC /end GROUP
/begin GROUP S186_Rising_Debounce2 "POD_TipToRun/POD_TipToRun/TipToRun/TipToRunR/ManAsstRqst/StopToAssist/Rising Debounce2" /begin REF_CHARACTERISTIC k_TTR_Value_HoldModePosOnTimer /end REF_CHARACTERISTIC /end GROUP
/begin GROUP S186_Rising_Debounce3 "POD_TipToRun/POD_TipToRun/TipToRun/TipToRunR/ManAsstRqst/StopToAssist/Rising Debounce3" /begin REF_CHARACTERISTIC k_TTR_Ti_ManualAssistJudgeCnt /end REF_CHARACTERISTIC /end GROUP
/begin GROUP S19_RisingDelay "POD_TipToRun/POD_TipToRun/TipToRun/TipToRunL/ManAsstRqst/ElecToAssist/ElecMovInBrkgIMUSpdJudge/RisingDelay" /begin REF_MEASUREMENT monr_VbTTR_ElecBrkgToAssistCloseLTTR_flg /end REF_MEASUREMENT /end GROUP
/begin GROUP S20_Rising_Debounce1 "POD_TipToRun/POD_TipToRun/TipToRun/TipToRunL/ManAsstRqst/ElecToAssist/ElecMovOutBrkgIMUSpdJudge/Rising Debounce1" /begin REF_CHARACTERISTIC k_TTR_Ti_DoorOpenBrkgToAssistAgSpdDelayTi /end REF_CHARACTERISTIC /end GROUP
/begin GROUP S20_RisingDelay "POD_TipToRun/POD_TipToRun/TipToRun/TipToRunL/ManAsstRqst/ElecToAssist/ElecMovOutBrkgIMUSpdJudge/RisingDelay" /begin REF_MEASUREMENT monr_VbTTR_ElecBrkgToAssistOpenLTTR_flg /end REF_MEASUREMENT /end GROUP
/begin GROUP S23_Falling_Debounce "POD_TipToRun/POD_TipToRun/TipToRun/TipToRunL/ManAsstRqst/ElecToAssist/ElecToAssistIMUErrorSpdOrAccJudge/Falling Debounce" /begin REF_CHARACTERISTIC k_TTR_Ti_ErrorSpeedDelayTi /end REF_CHARACTERISTIC /end GROUP
/begin GROUP S23_Falling_Debounce1 "POD_TipToRun/POD_TipToRun/TipToRun/TipToRunL/ManAsstRqst/ElecToAssist/ElecToAssistIMUErrorSpdOrAccJudge/Falling Debounce1" /begin REF_CHARACTERISTIC k_TTR_Ti_ErrorSpeedDelayTi /end REF_CHARACTERISTIC /end GROUP
/begin GROUP S24_Rising_Debounce "POD_TipToRun/POD_TipToRun/TipToRun/TipToRunL/ManAsstRqst/ElecToAssist/ElecToAssistIMUSpdJudge/Rising Debounce" /begin REF_CHARACTERISTIC k_TTR_Ti_LowSpeedManualOpenTi /end REF_CHARACTERISTIC /end GROUP
/begin GROUP S24_Rising_Debounce1 "POD_TipToRun/POD_TipToRun/TipToRun/TipToRunL/ManAsstRqst/ElecToAssist/ElecToAssistIMUSpdJudge/Rising Debounce1" /begin REF_CHARACTERISTIC k_TTR_Ti_LowSpeedManualCloseTi /end REF_CHARACTERISTIC /end GROUP
/begin GROUP S26_Rising_Debounce2 "POD_TipToRun/POD_TipToRun/TipToRun/TipToRunL/ManAsstRqst/ElecToAssist/ElecToManualCloseIMUAccJudge/Rising Debounce2" /begin REF_CHARACTERISTIC k_TTR_Ti_DoorCloseToAssistAccStateTi /end REF_CHARACTERISTIC /end GROUP
/begin GROUP S26_Rising_Debounce4 "POD_TipToRun/POD_TipToRun/TipToRun/TipToRunL/ManAsstRqst/ElecToAssist/ElecToManualCloseIMUAccJudge/Rising Debounce4" /begin REF_CHARACTERISTIC k_TTR_Ti_DoorCloseInitialTi /end REF_CHARACTERISTIC /end GROUP
/begin GROUP S27_Rising_Debounce1 "POD_TipToRun/POD_TipToRun/TipToRun/TipToRunL/ManAsstRqst/ElecToAssist/ElecToManualOpenIMUAccJudge/Rising Debounce1" /begin REF_CHARACTERISTIC k_TTR_Ti_DoorOpenToAssistAccStateTi /end REF_CHARACTERISTIC /end GROUP
/begin GROUP S27_Rising_Debounce2 "POD_TipToRun/POD_TipToRun/TipToRun/TipToRunL/ManAsstRqst/ElecToAssist/ElecToManualOpenIMUAccJudge/Rising Debounce2" /begin REF_CHARACTERISTIC k_TTR_Ti_DoorOpenDecToAssistAccStateTi /end REF_CHARACTERISTIC /end GROUP
/begin GROUP S27_Rising_Debounce3 "POD_TipToRun/POD_TipToRun/TipToRun/TipToRunL/ManAsstRqst/ElecToAssist/ElecToManualOpenIMUAccJudge/Rising Debounce3" /begin REF_CHARACTERISTIC k_TTR_Ti_DoorOpenInitialTi /end REF_CHARACTERISTIC /end GROUP
/begin GROUP S113_Rising_Debounce1 "POD_TipToRun/POD_TipToRun/TipToRun/TipToRunL/ManAsstRqst/ManualSpdBack/ManualCloseToOpenJudge/Rising Debounce1" /begin REF_CHARACTERISTIC k_TTR_Ti_ManualOpenSpdAccDelayTi /end REF_CHARACTERISTIC /end GROUP
/begin GROUP S113_Rising_Debounce2 "POD_TipToRun/POD_TipToRun/TipToRun/TipToRunL/ManAsstRqst/ManualSpdBack/ManualCloseToOpenJudge/Rising Debounce2" /begin REF_CHARACTERISTIC k_TTR_Ti_ManualCloseDistanceMaxJudgeTi /end REF_CHARACTERISTIC /end GROUP
/begin GROUP S114_Rising_Debounce "POD_TipToRun/POD_TipToRun/TipToRun/TipToRunL/ManAsstRqst/ManualSpdBack/ManualOpenOrCloseMaxPos/Rising Debounce" /begin REF_CHARACTERISTIC k_TTR_Ti_ManualOpenMaxPosJudgeTi /end REF_CHARACTERISTIC /end GROUP
/begin GROUP S115_Rising_Debounce1 "POD_TipToRun/POD_TipToRun/TipToRun/TipToRunL/ManAsstRqst/ManualSpdBack/ManualOpenToCloseJudge/Rising Debounce1" /begin REF_CHARACTERISTIC k_TTR_Ti_ManualCloseSpdAccDelayTi /end REF_CHARACTERISTIC /end GROUP
/begin GROUP S115_Rising_Debounce2 "POD_TipToRun/POD_TipToRun/TipToRun/TipToRunL/ManAsstRqst/ManualSpdBack/ManualOpenToCloseJudge/Rising Debounce2" /begin REF_CHARACTERISTIC k_TTR_Ti_ManualCloseDistanceMaxJudgeTi /end REF_CHARACTERISTIC /end GROUP
/begin GROUP S187_RisingDelay "POD_TipToRun/POD_TipToRun/TipToRun/TipToRunR/ManAsstRqst/ElecToAssist/ElecMovInBrkgIMUSpdJudge/RisingDelay" /begin REF_MEASUREMENT monr_VbTTR_ElecBrkgToAssistCloseRTTR_flg /end REF_MEASUREMENT /end GROUP
/begin GROUP S188_Rising_Debounce1 "POD_TipToRun/POD_TipToRun/TipToRun/TipToRunR/ManAsstRqst/ElecToAssist/ElecMovOutBrkgIMUSpdJudge/Rising Debounce1" /begin REF_CHARACTERISTIC k_TTR_Ti_DoorOpenBrkgToAssistAgSpdDelayTi /end REF_CHARACTERISTIC /end GROUP
/begin GROUP S188_RisingDelay "POD_TipToRun/POD_TipToRun/TipToRun/TipToRunR/ManAsstRqst/ElecToAssist/ElecMovOutBrkgIMUSpdJudge/RisingDelay" /begin REF_MEASUREMENT monr_VbTTR_ElecBrkgToAssistOpenRTTR_flg /end REF_MEASUREMENT /end GROUP
/begin GROUP S191_Falling_Debounce "POD_TipToRun/POD_TipToRun/TipToRun/TipToRunR/ManAsstRqst/ElecToAssist/ElecToAssistIMUErrorSpdOrAccJudge/Falling Debounce" /begin REF_CHARACTERISTIC k_TTR_Ti_ErrorSpeedDelayTi /end REF_CHARACTERISTIC /end GROUP
/begin GROUP S191_Falling_Debounce1 "POD_TipToRun/POD_TipToRun/TipToRun/TipToRunR/ManAsstRqst/ElecToAssist/ElecToAssistIMUErrorSpdOrAccJudge/Falling Debounce1" /begin REF_CHARACTERISTIC k_TTR_Ti_ErrorSpeedDelayTi /end REF_CHARACTERISTIC /end GROUP
/begin GROUP S192_Rising_Debounce "POD_TipToRun/POD_TipToRun/TipToRun/TipToRunR/ManAsstRqst/ElecToAssist/ElecToAssistIMUSpdJudge/Rising Debounce" /begin REF_CHARACTERISTIC k_TTR_Ti_LowSpeedManualOpenTi /end REF_CHARACTERISTIC /end GROUP
/begin GROUP S192_Rising_Debounce1 "POD_TipToRun/POD_TipToRun/TipToRun/TipToRunR/ManAsstRqst/ElecToAssist/ElecToAssistIMUSpdJudge/Rising Debounce1" /begin REF_CHARACTERISTIC k_TTR_Ti_LowSpeedManualCloseTi /end REF_CHARACTERISTIC /end GROUP
/begin GROUP S194_Rising_Debounce2 "POD_TipToRun/POD_TipToRun/TipToRun/TipToRunR/ManAsstRqst/ElecToAssist/ElecToManualCloseIMUAccJudge/Rising Debounce2" /begin REF_CHARACTERISTIC k_TTR_Ti_DoorCloseToAssistAccStateTi /end REF_CHARACTERISTIC /end GROUP
/begin GROUP S194_Rising_Debounce4 "POD_TipToRun/POD_TipToRun/TipToRun/TipToRunR/ManAsstRqst/ElecToAssist/ElecToManualCloseIMUAccJudge/Rising Debounce4" /begin REF_CHARACTERISTIC k_TTR_Ti_DoorCloseInitialTi /end REF_CHARACTERISTIC /end GROUP
/begin GROUP S195_Rising_Debounce1 "POD_TipToRun/POD_TipToRun/TipToRun/TipToRunR/ManAsstRqst/ElecToAssist/ElecToManualOpenIMUAccJudge/Rising Debounce1" /begin REF_CHARACTERISTIC k_TTR_Ti_DoorOpenToAssistAccStateTi /end REF_CHARACTERISTIC /end GROUP
/begin GROUP S195_Rising_Debounce2 "POD_TipToRun/POD_TipToRun/TipToRun/TipToRunR/ManAsstRqst/ElecToAssist/ElecToManualOpenIMUAccJudge/Rising Debounce2" /begin REF_CHARACTERISTIC k_TTR_Ti_DoorOpenDecToAssistAccStateTi /end REF_CHARACTERISTIC /end GROUP
/begin GROUP S195_Rising_Debounce3 "POD_TipToRun/POD_TipToRun/TipToRun/TipToRunR/ManAsstRqst/ElecToAssist/ElecToManualOpenIMUAccJudge/Rising Debounce3" /begin REF_CHARACTERISTIC k_TTR_Ti_DoorOpenInitialTi /end REF_CHARACTERISTIC /end GROUP
/begin GROUP S281_Rising_Debounce1 "POD_TipToRun/POD_TipToRun/TipToRun/TipToRunR/ManAsstRqst/ManualSpdBack/ManualCloseToOpenJudge/Rising Debounce1" /begin REF_CHARACTERISTIC k_TTR_Ti_ManualOpenSpdAccDelayTi /end REF_CHARACTERISTIC /end GROUP
/begin GROUP S281_Rising_Debounce2 "POD_TipToRun/POD_TipToRun/TipToRun/TipToRunR/ManAsstRqst/ManualSpdBack/ManualCloseToOpenJudge/Rising Debounce2" /begin REF_CHARACTERISTIC k_TTR_Ti_ManualCloseDistanceMaxJudgeTi /end REF_CHARACTERISTIC /end GROUP
/begin GROUP S282_Rising_Debounce "POD_TipToRun/POD_TipToRun/TipToRun/TipToRunR/ManAsstRqst/ManualSpdBack/ManualOpenOrCloseMaxPos/Rising Debounce" /begin REF_CHARACTERISTIC k_TTR_Ti_ManualOpenMaxPosJudgeTi /end REF_CHARACTERISTIC /end GROUP
/begin GROUP S283_Rising_Debounce1 "POD_TipToRun/POD_TipToRun/TipToRun/TipToRunR/ManAsstRqst/ManualSpdBack/ManualOpenToCloseJudge/Rising Debounce1" /begin REF_CHARACTERISTIC k_TTR_Ti_ManualCloseSpdAccDelayTi /end REF_CHARACTERISTIC /end GROUP
/begin GROUP S283_Rising_Debounce2 "POD_TipToRun/POD_TipToRun/TipToRun/TipToRunR/ManAsstRqst/ManualSpdBack/ManualOpenToCloseJudge/Rising Debounce2" /begin REF_CHARACTERISTIC k_TTR_Ti_ManualCloseDistanceMaxJudgeTi /end REF_CHARACTERISTIC /end GROUP
/begin CHARACTERISTIC CalC_CinchMotDriveTmMax_ms "" VALUE 0xb00072b4 /* @ECU_Address@CalC_CinchMotDriveTmMax_ms@ */ Scalar_UWORD 0 RDMLatch_DetMotorStall_CM_uint16 0 65535 /end CHARACTERISTIC
/begin CHARACTERISTIC CalC_ExitMotTimesPro_s "" VALUE 0xb00072ca /* @ECU_Address@CalC_ExitMotTimesPro_s@ */ Scalar_UWORD 0 RDMLatch_DetMotorStall_CM_uint16 0 65535 /end CHARACTERISTIC
/begin CHARACTERISTIC CalC_LatchMotStlMax_mA "" VALUE 0xb00072d2 /* @ECU_Address@CalC_LatchMotStlMax_mA@ */ Scalar_UWORD 0 RDMLatch_DetMotorStall_CM_uint16 0 65535 /end CHARACTERISTIC
/begin CHARACTERISTIC CalC_LatchMotStlMin_mA "" VALUE 0xb00072d4 /* @ECU_Address@CalC_LatchMotStlMin_mA@ */ Scalar_UWORD 0 RDMLatch_DetMotorStall_CM_uint16 0 65535 /end CHARACTERISTIC
/begin CHARACTERISTIC CalC_LatchMotStl_ms "" VALUE 0xb00072d6 /* @ECU_Address@CalC_LatchMotStl_ms@ */ Scalar_UWORD 0 RDMLatch_DetMotorStall_CM_uint16 0 65535 /end CHARACTERISTIC
/begin CHARACTERISTIC CalC_LatchNormCurr_mA "" VALUE 0xb00072da /* @ECU_Address@CalC_LatchNormCurr_mA@ */ Scalar_UWORD 0 RDMLatch_DetMotorStall_CM_uint16 0 65535 /end CHARACTERISTIC
/begin CHARACTERISTIC CalC_LatchStlRels_ms "" VALUE 0xb00072de /* @ECU_Address@CalC_LatchStlRels_ms@ */ Scalar_UWORD 0 RDMLatch_DetMotorStall_CM_uint16 0 65535 /end CHARACTERISTIC
/begin CHARACTERISTIC CalC_UnlockMotDriveTmMax_ms "" VALUE 0xb00072ea /* @ECU_Address@CalC_UnlockMotDriveTmMax_ms@ */ Scalar_UWORD 0 RDMLatch_DetMotorStall_CM_uint16 0 65535 /end CHARACTERISTIC
/begin COMPU_METHOD RDMLatch_DetMotorStall_CM_uint16 "Q = V" RAT_FUNC "%5.0" "" COEFFS 0 1 0 0 0 1 /end COMPU_METHOD
/begin GROUP RDMLatch_DetMotorStall "RDMLatch_DetMotorStall" ROOT /begin SUB_GROUP Root_RDMLatch_DetMotorStall_Main_sys /end SUB_GROUP /end GROUP
/begin GROUP Root_RDMLatch_DetMotorStall_Main_sys "RDMLatch_DetMotorStall/RDMLatch_DetMotorStall_Main_sys" /begin SUB_GROUP S3_MotTimesProtect1 /end SUB_GROUP
 /begin REF_CHARACTERISTIC CalC_CinchMotDriveTmMax_ms CalC_LatchMotStlMax_mA CalC_LatchMotStlMin_mA CalC_LatchMotStl_ms CalC_LatchNormCurr_mA CalC_LatchStlRels_ms CalC_UnlockMotDriveTmMax_ms /end REF_CHARACTERISTIC
/end GROUP
/begin GROUP S3_MotTimesProtect1 "RDMLatch_DetMotorStall/RDMLatch_DetMotorStall_Main_sys/MotTimesProtect1" /begin REF_CHARACTERISTIC CalC_ExitMotTimesPro_s /end REF_CHARACTERISTIC /end GROUP
/begin CHARACTERISTIC CalVal_FIN_RDLockCtrFbCur "" VALUE 0xb00072a8 /* @ECU_Address@CalVal_FIN_RDLockCtrFbCur@ */ Scalar_UWORD 0 RDMLatch_FITIn_CM_uint16 0 65535 /end CHARACTERISTIC
/begin CHARACTERISTIC CalVal_FIN_TrnkLatchCurrFb "" VALUE 0xb00072ae /* @ECU_Address@CalVal_FIN_TrnkLatchCurrFb@ */ Scalar_UWORD 0 RDMLatch_FITIn_CM_uint16 0 65535 /end CHARACTERISTIC
/begin CHARACTERISTIC CalEn_FIN_RDLockCtrFbCur "" VALUE 0xb00072a3 /* @ECU_Address@CalEn_FIN_RDLockCtrFbCur@ */ Scalar_UBYTE 0 RDMLatch_FITIn_CM_uint8 0 255 /end CHARACTERISTIC
/begin CHARACTERISTIC CalEn_FIN_RDoorLockPawlSw "" VALUE 0xb00072a4 /* @ECU_Address@CalEn_FIN_RDoorLockPawlSw@ */ Scalar_UBYTE 0 RDMLatch_FITIn_CM_uint8 0 255 /end CHARACTERISTIC
/begin CHARACTERISTIC CalEn_FIN_RDoorLockResetSw "" VALUE 0xb00072a5 /* @ECU_Address@CalEn_FIN_RDoorLockResetSw@ */ Scalar_UBYTE 0 RDMLatch_FITIn_CM_uint8 0 255 /end CHARACTERISTIC
/begin CHARACTERISTIC CalEn_FIN_RDoorLockSecondSw "" VALUE 0xb00072a6 /* @ECU_Address@CalEn_FIN_RDoorLockSecondSw@ */ Scalar_UBYTE 0 RDMLatch_FITIn_CM_uint8 0 255 /end CHARACTERISTIC
/begin CHARACTERISTIC CalEn_FIN_TrnkLatchCurrFb "" VALUE 0xb00072a7 /* @ECU_Address@CalEn_FIN_TrnkLatchCurrFb@ */ Scalar_UBYTE 0 RDMLatch_FITIn_CM_uint8 0 255 /end CHARACTERISTIC
/begin CHARACTERISTIC CalVal_FIN_RDoorLockPawlSw "" VALUE 0xb00072aa /* @ECU_Address@CalVal_FIN_RDoorLockPawlSw@ */ Scalar_UBYTE 0 RDMLatch_FITIn_CM_uint8 0 255 /end CHARACTERISTIC
/begin CHARACTERISTIC CalVal_FIN_RDoorLockResetSw "" VALUE 0xb00072ab /* @ECU_Address@CalVal_FIN_RDoorLockResetSw@ */ Scalar_UBYTE 0 RDMLatch_FITIn_CM_uint8 0 255 /end CHARACTERISTIC
/begin CHARACTERISTIC CalVal_FIN_RDoorLockSecondSw "" VALUE 0xb00072ac /* @ECU_Address@CalVal_FIN_RDoorLockSecondSw@ */ Scalar_UBYTE 0 RDMLatch_FITIn_CM_uint8 0 255 /end CHARACTERISTIC
/begin MEASUREMENT Monr_FIN_RDLockCtrFbCur "" UWORD RDMLatch_FITIn_CM_UINT16 0 0 0 65535 ECU_ADDRESS 0xb0056382 /* @ECU_Address@Monr_FIN_RDLockCtrFbCur@ */ /end MEASUREMENT
/begin MEASUREMENT Monr_FIN_TrnkLatchCurrFb "" UWORD RDMLatch_FITIn_CM_UINT16 0 0 0 65535 ECU_ADDRESS 0xb0056388 /* @ECU_Address@Monr_FIN_TrnkLatchCurrFb@ */ /end MEASUREMENT
/begin MEASUREMENT Monr_FIN_RDoorLockPawlSw "" UBYTE RDMLatch_FITIn_CM_UINT8 0 0 0 255 ECU_ADDRESS 0xb0056384 /* @ECU_Address@Monr_FIN_RDoorLockPawlSw@ */ /end MEASUREMENT
/begin MEASUREMENT Monr_FIN_RDoorLockResetSw "" UBYTE RDMLatch_FITIn_CM_UINT8 0 0 0 255 ECU_ADDRESS 0xb0056385 /* @ECU_Address@Monr_FIN_RDoorLockResetSw@ */ /end MEASUREMENT
/begin MEASUREMENT Monr_FIN_RDoorLockSecondSw "" UBYTE RDMLatch_FITIn_CM_UINT8 0 0 0 255 ECU_ADDRESS 0xb0056386 /* @ECU_Address@Monr_FIN_RDoorLockSecondSw@ */ /end MEASUREMENT
/begin COMPU_METHOD RDMLatch_FITIn_CM_uint16 "Q = V" RAT_FUNC "%5.0" "" COEFFS 0 1 0 0 0 1 /end COMPU_METHOD
/begin COMPU_METHOD RDMLatch_FITIn_CM_uint8 "Q = V" RAT_FUNC "%3.0" "" COEFFS 0 1 0 0 0 1 /end COMPU_METHOD
/begin COMPU_METHOD RDMLatch_FITIn_CM_UINT16 "Q = V" RAT_FUNC "%5.0" "" COEFFS 0 1 0 0 0 1 /end COMPU_METHOD
/begin COMPU_METHOD RDMLatch_FITIn_CM_UINT8 "Q = V" RAT_FUNC "%3.0" "" COEFFS 0 1 0 0 0 1 /end COMPU_METHOD
/begin GROUP RDMLatch_FITIn "RDMLatch_FITIn" ROOT /begin SUB_GROUP Root_RDMLatch_FITIn_Main_sys /end SUB_GROUP /end GROUP
/begin GROUP Root_RDMLatch_FITIn_Main_sys "RDMLatch_FITIn/RDMLatch_FITIn_Main_sys" /begin SUB_GROUP S2_Cal_RDMLatch_FITIn /end SUB_GROUP /end GROUP
/begin GROUP S2_Cal_RDMLatch_FITIn "RDMLatch_FITIn/RDMLatch_FITIn_Main_sys/Cal_RDMLatch_FITIn"
 /begin REF_CHARACTERISTIC CalEn_FIN_RDLockCtrFbCur CalEn_FIN_RDoorLockPawlSw CalEn_FIN_RDoorLockResetSw CalEn_FIN_RDoorLockSecondSw CalEn_FIN_TrnkLatchCurrFb CalVal_FIN_RDLockCtrFbCur CalVal_FIN_RDoorLockPawlSw CalVal_FIN_RDoorLockResetSw CalVal_FIN_RDoorLockSecondSw CalVal_FIN_TrnkLatchCurrFb /end REF_CHARACTERISTIC
 /begin REF_MEASUREMENT Monr_FIN_RDLockCtrFbCur Monr_FIN_RDoorLockPawlSw Monr_FIN_RDoorLockResetSw Monr_FIN_RDoorLockSecondSw Monr_FIN_TrnkLatchCurrFb /end REF_MEASUREMENT
/end GROUP
/begin CHARACTERISTIC CalVal_FITOutRDLockCtr_ms "" VALUE 0xb00072a0 /* @ECU_Address@CalVal_FITOutRDLockCtr_ms@ */ Scalar_UWORD 0 RDMLatch_FITOut_CM_uint16 0 65535 /end CHARACTERISTIC
/begin CHARACTERISTIC CalEn_FITOut_RDLockCtr "" VALUE 0xb00072a2 /* @ECU_Address@CalEn_FITOut_RDLockCtr@ */ Scalar_UBYTE 0 RDMLatch_FITOut_CM_uint8 0 255 /end CHARACTERISTIC
/begin CHARACTERISTIC CalEn_FITOut_RDLockPWMCmd "" VALUE 0xb00072b1 /* @ECU_Address@CalEn_FITOut_RDLockPWMCmd@ */ Scalar_UBYTE 0 RDMLatch_FITOut_CM_uint8 0 255 /end CHARACTERISTIC
/begin CHARACTERISTIC CalEn_FITOut_RDUnLockCmd "" VALUE 0xb00072b2 /* @ECU_Address@CalEn_FITOut_RDUnLockCmd@ */ Scalar_UBYTE 0 RDMLatch_FITOut_CM_uint8 0 255 /end CHARACTERISTIC
/begin CHARACTERISTIC CalVal_FITOut_RDLockCtr "" VALUE 0xb000729e /* @ECU_Address@CalVal_FITOut_RDLockCtr@ */ Scalar_UBYTE 0 RDMLatch_FITOut_CM_uint8 0 255 /end CHARACTERISTIC
/begin CHARACTERISTIC CalVal_FITOut_RDLockPWMCmd "" VALUE 0xb00072b0 /* @ECU_Address@CalVal_FITOut_RDLockPWMCmd@ */ Scalar_UBYTE 0 RDMLatch_FITOut_CM_uint8 0 255 /end CHARACTERISTIC
/begin CHARACTERISTIC CalVal_FITOut_RDUnLockCmd "" VALUE 0xb00072b3 /* @ECU_Address@CalVal_FITOut_RDUnLockCmd@ */ Scalar_UBYTE 0 RDMLatch_FITOut_CM_uint8 0 255 /end CHARACTERISTIC
/begin MEASUREMENT Monr_FITOut_RDLockPWMCmd "" UBYTE RDMLatch_FITOut_CM_UINT8 0 0 0 255 ECU_ADDRESS 0xb005638a /* @ECU_Address@Monr_FITOut_RDLockPWMCmd@ */ /end MEASUREMENT
/begin MEASUREMENT Monr_FITOut_RDLockCtr "" UBYTE RDMLatch_FITOut_CM_uint8 0 0 0 255 ECU_ADDRESS 0xb005638b /* @ECU_Address@Monr_FITOut_RDLockCtr@ */ /end MEASUREMENT
/begin MEASUREMENT Monr_FITOut_RDUnLockCtr "" UBYTE RDMLatch_FITOut_CM_UINT8 0 0 0 255 ECU_ADDRESS 0xb005638c /* @ECU_Address@Monr_FITOut_RDUnLockCtr@ */ /end MEASUREMENT
/begin COMPU_METHOD RDMLatch_FITOut_CM_uint16 "Q = V" RAT_FUNC "%5.0" "" COEFFS 0 1 0 0 0 1 /end COMPU_METHOD
/begin COMPU_METHOD RDMLatch_FITOut_CM_uint8 "Q = V" RAT_FUNC "%3.0" "" COEFFS 0 1 0 0 0 1 /end COMPU_METHOD
/begin COMPU_METHOD RDMLatch_FITOut_CM_UINT8 "Q = V" RAT_FUNC "%3.0" "" COEFFS 0 1 0 0 0 1 /end COMPU_METHOD
/begin GROUP RDMLatch_FITOut "RDMLatch_FITOut" ROOT /begin SUB_GROUP Root_RDMLatch_FITOut_Main_sys /end SUB_GROUP /end GROUP
/begin GROUP Root_RDMLatch_FITOut_Main_sys "RDMLatch_FITOut/RDMLatch_FITOut_Main_sys"
 /begin REF_CHARACTERISTIC CalEn_FITOut_RDLockCtr CalEn_FITOut_RDLockPWMCmd CalEn_FITOut_RDUnLockCmd CalVal_FITOutRDLockCtr_ms CalVal_FITOut_RDLockCtr CalVal_FITOut_RDLockPWMCmd CalVal_FITOut_RDUnLockCmd /end REF_CHARACTERISTIC
 /begin REF_MEASUREMENT Monr_FITOut_RDLockCtr Monr_FITOut_RDLockPWMCmd Monr_FITOut_RDUnLockCtr /end REF_MEASUREMENT
/end GROUP
/begin CHARACTERISTIC CalC_CinchMotDriveTmMax_ms "" VALUE 0xb00072b4 /* @ECU_Address@CalC_CinchMotDriveTmMax_ms@ */ Scalar_UWORD 0 RDMLatch_SetCinchRelsCmd_CM_uint16 0 65535 /end CHARACTERISTIC
/begin CHARACTERISTIC CalC_CinchMotDriveTmMin_ms "" VALUE 0xb00072b6 /* @ECU_Address@CalC_CinchMotDriveTmMin_ms@ */ Scalar_UWORD 0 RDMLatch_SetCinchRelsCmd_CM_uint16 0 65535 /end CHARACTERISTIC
/begin CHARACTERISTIC CalC_CinchStallReverse_ms "" VALUE 0xb00072ba /* @ECU_Address@CalC_CinchStallReverse_ms@ */ Scalar_UWORD 0 RDMLatch_SetCinchRelsCmd_CM_uint16 0 65535 /end CHARACTERISTIC
/begin CHARACTERISTIC CalC_DelayStartCinch_ms "" VALUE 0xb00072bc /* @ECU_Address@CalC_DelayStartCinch_ms@ */ Scalar_UWORD 0 RDMLatch_SetCinchRelsCmd_CM_uint16 0 65535 /end CHARACTERISTIC
/begin CHARACTERISTIC CalC_DelayStopCinRe_ms "" VALUE 0xb00072be /* @ECU_Address@CalC_DelayStopCinRe_ms@ */ Scalar_UWORD 0 RDMLatch_SetCinchRelsCmd_CM_uint16 0 65535 /end CHARACTERISTIC
/begin CHARACTERISTIC CalC_DelayStopCinchStall_ms "" VALUE 0xb00072c0 /* @ECU_Address@CalC_DelayStopCinchStall_ms@ */ Scalar_UWORD 0 RDMLatch_SetCinchRelsCmd_CM_uint16 0 65535 /end CHARACTERISTIC
/begin CHARACTERISTIC CalC_DelayStopCinch_ms "" VALUE 0xb00072c2 /* @ECU_Address@CalC_DelayStopCinch_ms@ */ Scalar_UWORD 0 RDMLatch_SetCinchRelsCmd_CM_uint16 0 65535 /end CHARACTERISTIC
/begin CHARACTERISTIC CalC_DelayStopForPawl_ms "" VALUE 0xb00072c4 /* @ECU_Address@CalC_DelayStopForPawl_ms@ */ Scalar_UWORD 0 RDMLatch_SetCinchRelsCmd_CM_uint16 0 65535 /end CHARACTERISTIC
/begin CHARACTERISTIC CalC_DelayStopForScond_ms "" VALUE 0xb00072c6 /* @ECU_Address@CalC_DelayStopForScond_ms@ */ Scalar_UWORD 0 RDMLatch_SetCinchRelsCmd_CM_uint16 0 65535 /end CHARACTERISTIC
/begin CHARACTERISTIC CalC_DelayStopRelsRe_ms "" VALUE 0x0000 /* @ECU_Address@CalC_DelayStopRelsRe_ms@ */ Scalar_UWORD 0 RDMLatch_SetCinchRelsCmd_CM_uint16 0 65535 /end CHARACTERISTIC
/begin CHARACTERISTIC CalC_DelayUnlockRevs_ms "" VALUE 0xb00072c8 /* @ECU_Address@CalC_DelayUnlockRevs_ms@ */ Scalar_UWORD 0 RDMLatch_SetCinchRelsCmd_CM_uint16 0 65535 /end CHARACTERISTIC
/begin CHARACTERISTIC CalC_LatchMotDynamicBrk_ms "" VALUE 0xb00072d0 /* @ECU_Address@CalC_LatchMotDynamicBrk_ms@ */ Scalar_UWORD 0 RDMLatch_SetCinchRelsCmd_CM_uint16 0 65535 /end CHARACTERISTIC
/begin CHARACTERISTIC CalC_LatchStartUp_ms "" VALUE 0xb00072dc /* @ECU_Address@CalC_LatchStartUp_ms@ */ Scalar_UWORD 0 RDMLatch_SetCinchRelsCmd_CM_uint16 0 65535 /end CHARACTERISTIC
/begin CHARACTERISTIC CalC_TrnkLatchUnlckExitCurrThr_mA "" VALUE 0xb00072e6 /* @ECU_Address@CalC_TrnkLatchUnlckExitCurrThr_mA@ */ Scalar_UWORD 0 RDMLatch_SetCinchRelsCmd_CM_uint16 0 65535 /end CHARACTERISTIC
/begin CHARACTERISTIC CalC_UnlockMotDriveTmMax_ms "" VALUE 0xb00072ea /* @ECU_Address@CalC_UnlockMotDriveTmMax_ms@ */ Scalar_UWORD 0 RDMLatch_SetCinchRelsCmd_CM_uint16 0 65535 /end CHARACTERISTIC
/begin CHARACTERISTIC CalC_UnlockMotDriveTmMin_ms "" VALUE 0xb00072ec /* @ECU_Address@CalC_UnlockMotDriveTmMin_ms@ */ Scalar_UWORD 0 RDMLatch_SetCinchRelsCmd_CM_uint16 0 65535 /end CHARACTERISTIC
/begin CHARACTERISTIC CalC_tIPLGLatchRvrsMax_ms "" VALUE 0xb00072ee /* @ECU_Address@CalC_tIPLGLatchRvrsMax_ms@ */ Scalar_UWORD 0 RDMLatch_SetCinchRelsCmd_CM_uint16 0 65535 /end CHARACTERISTIC
/begin CHARACTERISTIC CDD_CARTYPE_VEEA_MEB31_INLAND "Macros definition used for State, Movement State." VALUE 0x0000 /* @ECU_Address@CDD_CARTYPE_VEEA_MEB31_INLAND@ */ Scalar_UBYTE 0 RDMLatch_SetCinchRelsCmd_CM_uint8 0 255 /end CHARACTERISTIC
/begin CHARACTERISTIC CDD_CARTYPE_VEEA_MY26_INLAND "Macros definition used for State, Movement State." VALUE 0x0000 /* @ECU_Address@CDD_CARTYPE_VEEA_MY26_INLAND@ */ Scalar_UBYTE 0 RDMLatch_SetCinchRelsCmd_CM_uint8 0 255 /end CHARACTERISTIC
/begin CHARACTERISTIC CalC_TrnkLatchCinchPWM "" VALUE 0xb00072e4 /* @ECU_Address@CalC_TrnkLatchCinchPWM@ */ Scalar_UBYTE 0 RDMLatch_SetCinchRelsCmd_CM_uint8 0 255 /end CHARACTERISTIC
/begin CHARACTERISTIC CalEn_TrnkUnlckLatchReq "" VALUE 0xb000729c /* @ECU_Address@CalEn_TrnkUnlckLatchReq@ */ Scalar_UBYTE 0 RDMLatch_SetCinchRelsCmd_CM_uint8 0 255 /end CHARACTERISTIC
/begin CHARACTERISTIC CalVal_TrnkUnlckLatchReq "" VALUE 0xb000729d /* @ECU_Address@CalVal_TrnkUnlckLatchReq@ */ Scalar_UBYTE 0 RDMLatch_SetCinchRelsCmd_CM_uint8 0 255 /end CHARACTERISTIC
/begin COMPU_METHOD RDMLatch_SetCinchRelsCmd_CM_uint16 "Q = V" RAT_FUNC "%5.0" "" COEFFS 0 1 0 0 0 1 /end COMPU_METHOD
/begin COMPU_METHOD RDMLatch_SetCinchRelsCmd_CM_uint8 "Q = V" RAT_FUNC "%3.0" "" COEFFS 0 1 0 0 0 1 /end COMPU_METHOD
/begin GROUP RDMLatch_SetCinchRelsCmd "RDMLatch_SetCinchRelsCmd" ROOT /begin SUB_GROUP Root_RDMLatch_SetCinchRelsCmd_Main_sys /end SUB_GROUP /end GROUP
/begin GROUP Root_RDMLatch_SetCinchRelsCmd_Main_sys "RDMLatch_SetCinchRelsCmd/RDMLatch_SetCinchRelsCmd_Main_sys"
 /begin REF_CHARACTERISTIC CDD_CARTYPE_VEEA_MEB31_INLAND CDD_CARTYPE_VEEA_MY26_INLAND CalC_CinchMotDriveTmMax_ms CalC_CinchMotDriveTmMin_ms CalC_CinchStallReverse_ms CalC_DelayStartCinch_ms CalC_DelayStopCinRe_ms CalC_DelayStopCinchStall_ms CalC_DelayStopCinch_ms CalC_DelayStopForPawl_ms CalC_DelayStopForScond_ms CalC_DelayStopRelsRe_ms CalC_DelayUnlockRevs_ms CalC_LatchMotDynamicBrk_ms CalC_LatchStartUp_ms CalC_TrnkLatchCinchPWM CalC_TrnkLatchUnlckExitCurrThr_mA CalC_UnlockMotDriveTmMax_ms CalC_UnlockMotDriveTmMin_ms CalC_tIPLGLatchRvrsMax_ms CalEn_TrnkUnlckLatchReq CalVal_TrnkUnlckLatchReq /end REF_CHARACTERISTIC
/end GROUP
/begin CHARACTERISTIC Cal_SlopePatch "" VAL_BLK 0xb000721c /* @ECU_Address@Cal_SlopePatch@ */ Scalar_FLOAT32_IEEE 0 RDM_AntiPinch_CM_single -3.4E+38 3.4E+38 NUMBER 7 /end CHARACTERISTIC
/begin CHARACTERISTIC CalC_TrnkClsAPThrTblPosArr "" VAL_BLK 0xb00070da /* @ECU_Address@CalC_TrnkClsAPThrTblPosArr@ */ Scalar_SWORD 0 RDM_AntiPinch_CM_int16 -32768 32767 NUMBER 5 /end CHARACTERISTIC
/begin CHARACTERISTIC CalC_TrnkClsAdpCurrNmMvAddPat_HT "" VAL_BLK 0xb00070e4 /* @ECU_Address@CalC_TrnkClsAdpCurrNmMvAddPat_HT@ */ Scalar_SWORD 0 RDM_AntiPinch_CM_int16 -32768 32767 NUMBER 3 /end CHARACTERISTIC
/begin CHARACTERISTIC CalC_TrnkClsAdpCurrNmMvAddPat_LT "" VAL_BLK 0xb00070ea /* @ECU_Address@CalC_TrnkClsAdpCurrNmMvAddPat_LT@ */ Scalar_SWORD 0 RDM_AntiPinch_CM_int16 -32768 32767 NUMBER 3 /end CHARACTERISTIC
/begin CHARACTERISTIC CalC_TrnkClsAdpCurrNmMvAddPat_NT "" VAL_BLK 0xb00070f0 /* @ECU_Address@CalC_TrnkClsAdpCurrNmMvAddPat_NT@ */ Scalar_SWORD 0 RDM_AntiPinch_CM_int16 -32768 32767 NUMBER 3 /end CHARACTERISTIC
/begin CHARACTERISTIC CalC_TrnkClsAdpCurrSlwStpSubPat_HT "" VAL_BLK 0xb00070f6 /* @ECU_Address@CalC_TrnkClsAdpCurrSlwStpSubPat_HT@ */ Scalar_SWORD 0 RDM_AntiPinch_CM_int16 -32768 32767 NUMBER 3 /end CHARACTERISTIC
/begin CHARACTERISTIC CalC_TrnkClsAdpCurrSlwStpSubPat_LT "" VAL_BLK 0xb00070fc /* @ECU_Address@CalC_TrnkClsAdpCurrSlwStpSubPat_LT@ */ Scalar_SWORD 0 RDM_AntiPinch_CM_int16 -32768 32767 NUMBER 3 /end CHARACTERISTIC
/begin CHARACTERISTIC CalC_TrnkClsAdpCurrSlwStpSubPat_NT "" VAL_BLK 0xb0007102 /* @ECU_Address@CalC_TrnkClsAdpCurrSlwStpSubPat_NT@ */ Scalar_SWORD 0 RDM_AntiPinch_CM_int16 -32768 32767 NUMBER 3 /end CHARACTERISTIC
/begin CHARACTERISTIC CalC_TrnkClsAntiPinchEnableEndPos "" VALUE 0xb000710a /* @ECU_Address@CalC_TrnkClsAntiPinchEnableEndPos@ */ Scalar_SWORD 0 RDM_AntiPinch_CM_int16 -32768 32767 /end CHARACTERISTIC
/begin CHARACTERISTIC CalC_TrnkClsAntiPinchEnableStartPos "" VALUE 0xb000710c /* @ECU_Address@CalC_TrnkClsAntiPinchEnableStartPos@ */ Scalar_SWORD 0 RDM_AntiPinch_CM_int16 -32768 32767 /end CHARACTERISTIC
/begin CHARACTERISTIC CalC_TrnkHallZone_HalfClosed_H "" VALUE 0xb000716c /* @ECU_Address@CalC_TrnkHallZone_HalfClosed_H@ */ Scalar_SWORD 0 RDM_AntiPinch_CM_int16 -32768 32767 /end CHARACTERISTIC
/begin CHARACTERISTIC CalC_TrnkOpenAntiPinchEnableEndPosOffset "" VALUE 0xb000718c /* @ECU_Address@CalC_TrnkOpenAntiPinchEnableEndPosOffset@ */ Scalar_SWORD 0 RDM_AntiPinch_CM_int16 -32768 32767 /end CHARACTERISTIC
/begin CHARACTERISTIC CalC_TrnkOpenAntiPinchEnableStartPos "" VALUE 0xb000718e /* @ECU_Address@CalC_TrnkOpenAntiPinchEnableStartPos@ */ Scalar_SWORD 0 RDM_AntiPinch_CM_int16 -32768 32767 /end CHARACTERISTIC
/begin CHARACTERISTIC CalC_TrnkClsExitRefSpdAPThrPat1 "" VALUE 0xb000710e /* @ECU_Address@CalC_TrnkClsExitRefSpdAPThrPat1@ */ Scalar_UWORD 0 RDM_AntiPinch_CM_uint16 0 65535 /end CHARACTERISTIC
/begin CHARACTERISTIC CalC_TrnkClsExitRefSpdAPThrPat2 "" VALUE 0xb0007110 /* @ECU_Address@CalC_TrnkClsExitRefSpdAPThrPat2@ */ Scalar_UWORD 0 RDM_AntiPinch_CM_uint16 0 65535 /end CHARACTERISTIC
/begin CHARACTERISTIC CalC_TrnkClsExitRefSpdCurrThrPat1 "" VALUE 0xb0007112 /* @ECU_Address@CalC_TrnkClsExitRefSpdCurrThrPat1@ */ Scalar_UWORD 0 RDM_AntiPinch_CM_uint16 0 65535 /end CHARACTERISTIC
/begin CHARACTERISTIC CalC_TrnkClsExitRefSpdCurrThrPat2 "" VALUE 0xb0007114 /* @ECU_Address@CalC_TrnkClsExitRefSpdCurrThrPat2@ */ Scalar_UWORD 0 RDM_AntiPinch_CM_uint16 0 65535 /end CHARACTERISTIC
/begin CHARACTERISTIC CalC_TrnkClsFallBackAPMtrSpdThr "" VALUE 0xb0007118 /* @ECU_Address@CalC_TrnkClsFallBackAPMtrSpdThr@ */ Scalar_UWORD 0 RDM_AntiPinch_CM_uint16 0 65535 /end CHARACTERISTIC
/begin CHARACTERISTIC CalC_TrnkClsFallBackAPTmThr "" VALUE 0xb000711a /* @ECU_Address@CalC_TrnkClsFallBackAPTmThr@ */ Scalar_UWORD 0 RDM_AntiPinch_CM_uint16 0 65535 /end CHARACTERISTIC
/begin CHARACTERISTIC CalC_TrnkClsMtrNormSpd "" VALUE 0xb000711e /* @ECU_Address@CalC_TrnkClsMtrNormSpd@ */ Scalar_UWORD 0 RDM_AntiPinch_CM_uint16 0 65535 /end CHARACTERISTIC
/begin CHARACTERISTIC CalC_TrnkClsMtrStopDist "" VALUE 0xb0007124 /* @ECU_Address@CalC_TrnkClsMtrStopDist@ */ Scalar_UWORD 0 RDM_AntiPinch_CM_uint16 0 65535 /end CHARACTERISTIC
/begin CHARACTERISTIC CalC_TrnkClsPauseStopThreshPatch "" VALUE 0xb0007128 /* @ECU_Address@CalC_TrnkClsPauseStopThreshPatch@ */ Scalar_UWORD 0 RDM_AntiPinch_CM_uint16 0 65535 /end CHARACTERISTIC
/begin CHARACTERISTIC CalC_TrnkClsRFCurStepThr "" VALUE 0xb000712a /* @ECU_Address@CalC_TrnkClsRFCurStepThr@ */ Scalar_UWORD 0 RDM_AntiPinch_CM_uint16 0 65535 /end CHARACTERISTIC
/begin CHARACTERISTIC CalC_TrnkClsRefAPSoftRefSpdBias "" VALUE 0xb000712e /* @ECU_Address@CalC_TrnkClsRefAPSoftRefSpdBias@ */ Scalar_UWORD 0 RDM_AntiPinch_CM_uint16 0 65535 /end CHARACTERISTIC
/begin CHARACTERISTIC CalC_TrnkClsSlowStopThreshPatch "" VALUE 0xb0007130 /* @ECU_Address@CalC_TrnkClsSlowStopThreshPatch@ */ Scalar_UWORD 0 RDM_AntiPinch_CM_uint16 0 65535 /end CHARACTERISTIC
/begin CHARACTERISTIC CalC_TrnkFallBackAPCurrThresh "" VALUE 0xb000715c /* @ECU_Address@CalC_TrnkFallBackAPCurrThresh@ */ Scalar_UWORD 0 RDM_AntiPinch_CM_uint16 0 65535 /end CHARACTERISTIC
/begin CHARACTERISTIC CalC_TrnkManualAssistThreshPatch "" VALUE 0xb0007174 /* @ECU_Address@CalC_TrnkManualAssistThreshPatch@ */ Scalar_UWORD 0 RDM_AntiPinch_CM_uint16 0 65535 /end CHARACTERISTIC
/begin CHARACTERISTIC CalC_TrnkMvAbnMtrSpdRiseTol "" VALUE 0xb0007182 /* @ECU_Address@CalC_TrnkMvAbnMtrSpdRiseTol@ */ Scalar_UWORD 0 RDM_AntiPinch_CM_uint16 0 65535 /end CHARACTERISTIC
/begin CHARACTERISTIC CalC_TrnkOpnAPMinCurrThr "" VALUE 0xb0007190 /* @ECU_Address@CalC_TrnkOpnAPMinCurrThr@ */ Scalar_UWORD 0 RDM_AntiPinch_CM_uint16 0 65535 /end CHARACTERISTIC
/begin CHARACTERISTIC CalC_TrnkOpnFallBackAPMtrSpdThr "" VALUE 0xb0007194 /* @ECU_Address@CalC_TrnkOpnFallBackAPMtrSpdThr@ */ Scalar_UWORD 0 RDM_AntiPinch_CM_uint16 0 65535 /end CHARACTERISTIC
/begin CHARACTERISTIC CalC_TrnkOpnFallBackAPTmThr "" VALUE 0xb0007196 /* @ECU_Address@CalC_TrnkOpnFallBackAPTmThr@ */ Scalar_UWORD 0 RDM_AntiPinch_CM_uint16 0 65535 /end CHARACTERISTIC
/begin CHARACTERISTIC CalC_TrnkOpnMtrNormSpd "" VALUE 0xb000719c /* @ECU_Address@CalC_TrnkOpnMtrNormSpd@ */ Scalar_UWORD 0 RDM_AntiPinch_CM_uint16 0 65535 /end CHARACTERISTIC
/begin CHARACTERISTIC CalC_TrnkOpnPauseStopTraceAPEnTol "" VALUE 0xb00071b0 /* @ECU_Address@CalC_TrnkOpnPauseStopTraceAPEnTol@ */ Scalar_UWORD 0 RDM_AntiPinch_CM_uint16 0 65535 /end CHARACTERISTIC
/begin CHARACTERISTIC CalC_TrnkOpnSlowStopTraceAPEnTol "" VALUE 0xb00071b6 /* @ECU_Address@CalC_TrnkOpnSlowStopTraceAPEnTol@ */ Scalar_UWORD 0 RDM_AntiPinch_CM_uint16 0 65535 /end CHARACTERISTIC
/begin CHARACTERISTIC CalC_TrnkOpnTraceAPMtrSpdThr "" VALUE 0xb00071c8 /* @ECU_Address@CalC_TrnkOpnTraceAPMtrSpdThr@ */ Scalar_UWORD 0 RDM_AntiPinch_CM_uint16 0 65535 /end CHARACTERISTIC
/begin CHARACTERISTIC CalC_hIPLGMechHighHall_cnt "" VALUE 0xb00071ec Scalar_UWORD 0 RDM_AntiPinch_CM_uint16 0 65535 /end CHARACTERISTIC
/begin CHARACTERISTIC Cal_SlopeCurPatch "" VAL_BLK 0xb000720c /* @ECU_Address@Cal_SlopeCurPatch@ */ Scalar_UWORD 0 RDM_AntiPinch_CM_uint16 0 65535 NUMBER 7 /end CHARACTERISTIC
/begin CHARACTERISTIC CalC_TrnkClsAPMtrSpdThrTbl_200mm "" VAL_BLK 0xb000709e /* @ECU_Address@CalC_TrnkClsAPMtrSpdThrTbl_200mm@ */ Scalar_UBYTE 0 RDM_AntiPinch_CM_uint8 0 255 NUMBER 20 /end CHARACTERISTIC
/begin CHARACTERISTIC CalC_TrnkClsAPMtrSpdThrTbl_20mm "" VAL_BLK 0xb00070b2 /* @ECU_Address@CalC_TrnkClsAPMtrSpdThrTbl_20mm@ */ Scalar_UBYTE 0 RDM_AntiPinch_CM_uint8 0 255 NUMBER 20 /end CHARACTERISTIC
/begin CHARACTERISTIC CalC_TrnkClsAPMtrSpdThrTbl_50mm "" VAL_BLK 0xb00070c6 /* @ECU_Address@CalC_TrnkClsAPMtrSpdThrTbl_50mm@ */ Scalar_UBYTE 0 RDM_AntiPinch_CM_uint8 0 255 NUMBER 20 /end CHARACTERISTIC
/begin CHARACTERISTIC CalC_TrnkClsAntiPinchCfgEnable "" VALUE 0xb0007108 /* @ECU_Address@CalC_TrnkClsAntiPinchCfgEnable@ */ Scalar_UBYTE 0 RDM_AntiPinch_CM_uint8 0 255 /end CHARACTERISTIC
/begin CHARACTERISTIC CalC_TrnkClsFallBackAPCfgEnable "" VALUE 0xb0007116 /* @ECU_Address@CalC_TrnkClsFallBackAPCfgEnable@ */ Scalar_UBYTE 0 RDM_AntiPinch_CM_uint8 0 255 /end CHARACTERISTIC
/begin CHARACTERISTIC CalC_TrnkClsRefAPCfgEnable "" VALUE 0xb000712c /* @ECU_Address@CalC_TrnkClsRefAPCfgEnable@ */ Scalar_UBYTE 0 RDM_AntiPinch_CM_uint8 0 255 /end CHARACTERISTIC
/begin CHARACTERISTIC CalC_TrnkClsTraceAPCfgEnable "" VALUE 0xb0007150 /* @ECU_Address@CalC_TrnkClsTraceAPCfgEnable@ */ Scalar_UBYTE 0 RDM_AntiPinch_CM_uint8 0 255 /end CHARACTERISTIC
/begin CHARACTERISTIC CalC_TrnkClsTraceAPMtrSpdThr "" VALUE 0xb0007151 /* @ECU_Address@CalC_TrnkClsTraceAPMtrSpdThr@ */ Scalar_UBYTE 0 RDM_AntiPinch_CM_uint8 0 255 /end CHARACTERISTIC
/begin CHARACTERISTIC CalC_TrnkMvAbnPWMThr "" VALUE 0xb0007184 /* @ECU_Address@CalC_TrnkMvAbnPWMThr@ */ Scalar_UBYTE 0 RDM_AntiPinch_CM_uint8 0 255 /end CHARACTERISTIC
/begin CHARACTERISTIC CalC_TrnkOpnAntiPinchCfgEnable "" VALUE 0xb0007192 /* @ECU_Address@CalC_TrnkOpnAntiPinchCfgEnable@ */ Scalar_UBYTE 0 RDM_AntiPinch_CM_uint8 0 255 /end CHARACTERISTIC
/begin CHARACTERISTIC CalC_TrnkOpnFallBackAPCfgEnable "" VALUE 0xb0007193 /* @ECU_Address@CalC_TrnkOpnFallBackAPCfgEnable@ */ Scalar_UBYTE 0 RDM_AntiPinch_CM_uint8 0 255 /end CHARACTERISTIC
/begin CHARACTERISTIC CalC_TrnkOpnRefAPCfgEnable "" VALUE 0xb00071b4 /* @ECU_Address@CalC_TrnkOpnRefAPCfgEnable@ */ Scalar_UBYTE 0 RDM_AntiPinch_CM_uint8 0 255 /end CHARACTERISTIC
/begin CHARACTERISTIC CalC_TrnkOpnTraceAPCfgEnable "" VALUE 0xb00071c6 /* @ECU_Address@CalC_TrnkOpnTraceAPCfgEnable@ */ Scalar_UBYTE 0 RDM_AntiPinch_CM_uint8 0 255 /end CHARACTERISTIC
/begin CHARACTERISTIC Cal_SlopePatchEnable "" VALUE 0xb0007238 /* @ECU_Address@Cal_SlopePatchEnable@ */ Scalar_UBYTE 0 RDM_AntiPinch_CM_uint8 0 255 /end CHARACTERISTIC
/begin CHARACTERISTIC Cal_SlopeSpdPatch "" VAL_BLK 0xb0007239 /* @ECU_Address@Cal_SlopeSpdPatch@ */ Scalar_UBYTE 0 RDM_AntiPinch_CM_uint8 0 255 NUMBER 35 /end CHARACTERISTIC
/begin MEASUREMENT Monr_TrnkOpnCurAPThresh "" FLOAT32_IEEE RDM_AntiPinch_CM_single 0 0 -3.4E+38 3.4E+38 ECU_ADDRESS 0xb005624c /* @ECU_Address@Monr_TrnkOpnCurAPThresh@ */ /end MEASUREMENT
/begin MEASUREMENT Monr_TrnkClsCurAPThresh "" FLOAT32_IEEE RDM_AntiPinch_CM_single 0 0 -3.4E+38 3.4E+38 ECU_ADDRESS 0xb0056240 /* @ECU_Address@Monr_TrnkClsCurAPThresh@ */ /end MEASUREMENT
/begin MEASUREMENT Monr_TrnkClsAPCurrThr "" UWORD RDM_AntiPinch_CM_uint16 0 0 0 65535 ECU_ADDRESS 0xb005634c /* @ECU_Address@Monr_TrnkClsAPCurrThr@ */ /end MEASUREMENT
/begin MEASUREMENT Monr_TrnkOpnTraceAPRefSpd "" UWORD RDM_AntiPinch_CM_uint16 0 0 0 65535 ECU_ADDRESS 0xb0056244 /* @ECU_Address@Monr_TrnkOpnTraceAPRefSpd@ */ /end MEASUREMENT
/begin MEASUREMENT Monr_TrnkClsSftAPRefSpd "" UWORD RDM_AntiPinch_CM_uint16 0 0 0 65535 ECU_ADDRESS 0xb005623c /* @ECU_Address@Monr_TrnkClsSftAPRefSpd@ */ /end MEASUREMENT
/begin MEASUREMENT Monr_TrnkClsHrdAPRefSpd "" UWORD RDM_AntiPinch_CM_uint16 0 0 0 65535 ECU_ADDRESS 0xb005623a /* @ECU_Address@Monr_TrnkClsHrdAPRefSpd@ */ /end MEASUREMENT
/begin MEASUREMENT Monr_TrnkClsTraceAPRefSpd "" UWORD RDM_AntiPinch_CM_uint16 0 0 0 65535 ECU_ADDRESS 0xb0056236 /* @ECU_Address@Monr_TrnkClsTraceAPRefSpd@ */ /end MEASUREMENT
/begin MEASUREMENT Monr_TrnkOpnAPSpdGap "" SWORD RDM_AntiPinch_CM_int16 0 0 -32768 32767 ECU_ADDRESS 0xb0056246 /* @ECU_Address@Monr_TrnkOpnAPSpdGap@ */ /end MEASUREMENT
/begin MEASUREMENT Monr_TrnkClsAPSpdGap "" SWORD RDM_AntiPinch_CM_int16 0 0 -32768 32767 ECU_ADDRESS 0xb0056238 /* @ECU_Address@Monr_TrnkClsAPSpdGap@ */ /end MEASUREMENT
/begin MEASUREMENT Monr_TrnkAntiPinchSt "" UBYTE RDM_AntiPinch_CM_uint8 0 0 0 255 ECU_ADDRESS 0xb0056250 /* @ECU_Address@Monr_TrnkAntiPinchSt@ */ /end MEASUREMENT
/begin MEASUREMENT Monr_TrnkAbnEnvFlag "" UBYTE RDM_AntiPinch_CM_uint8 0 0 0 255 ECU_ADDRESS 0xb0056274 /* @ECU_Address@Monr_TrnkAbnEnvFlag@ */ /end MEASUREMENT
/begin MEASUREMENT Monr_TrnkBatVoltPlungeFlag "" UBYTE RDM_AntiPinch_CM_uint8 0 0 0 255 ECU_ADDRESS 0xb005625a /* @ECU_Address@Monr_TrnkBatVoltPlungeFlag@ */ /end MEASUREMENT
/begin MEASUREMENT Monr_TrnkExitRefSpdProcFlag "" UBYTE RDM_AntiPinch_CM_uint8 0 0 0 255 ECU_ADDRESS 0xb005634e /* @ECU_Address@Monr_TrnkExitRefSpdProcFlag@ */ /end MEASUREMENT
/begin MEASUREMENT Monr_TrnkAPOverRideErrSt "" UBYTE RDM_AntiPinch_CM_uint8 0 0 0 255 ECU_ADDRESS 0xb0056261 /* @ECU_Address@Monr_TrnkAPOverRideErrSt@ */ /end MEASUREMENT
/begin COMPU_METHOD RDM_AntiPinch_CM_single "Q = V" RAT_FUNC "%8.6" "" COEFFS 0 1 0 0 0 1 /end COMPU_METHOD
/begin COMPU_METHOD RDM_AntiPinch_CM_int16 "Q = V" RAT_FUNC "%5.0" "" COEFFS 0 1 0 0 0 1 /end COMPU_METHOD
/begin COMPU_METHOD RDM_AntiPinch_CM_uint16 "Q = V" RAT_FUNC "%5.0" "" COEFFS 0 1 0 0 0 1 /end COMPU_METHOD
/begin COMPU_METHOD RDM_AntiPinch_CM_uint8 "Q = V" RAT_FUNC "%3.0" "" COEFFS 0 1 0 0 0 1 /end COMPU_METHOD
/begin GROUP RDM_AntiPinch "RDM_AntiPinch" ROOT /begin SUB_GROUP Root_RDM_AntiPinch_Main_sys /end SUB_GROUP /end GROUP
/begin GROUP Root_RDM_AntiPinch_Main_sys "RDM_AntiPinch/RDM_AntiPinch_Main_sys"
 /begin SUB_GROUP S3_AntiPinchMainAlgo1 S3_AntiPinchMainAlgo4 S3_AntiPinchThresh S3_DetClsTraceAPTol S3_DetOpnAPThresh S3_DetTraceAPTol S3_For_Each_Subsystem S3_SendCurAPThr S3_Subsystem1 S3_Subsystem2 S3_Subsystem3 /end SUB_GROUP
 /begin REF_CHARACTERISTIC CalC_TrnkClsMtrNormSpd CalC_TrnkClsTraceAPMtrSpdThr CalC_TrnkOpnMtrNormSpd /end REF_CHARACTERISTIC
 /begin REF_MEASUREMENT Monr_TrnkAPOverRideErrSt Monr_TrnkAbnEnvFlag Monr_TrnkAntiPinchSt Monr_TrnkBatVoltPlungeFlag Monr_TrnkClsAPCurrThr Monr_TrnkClsAPSpdGap Monr_TrnkClsCurAPThresh Monr_TrnkClsHrdAPRefSpd Monr_TrnkClsSftAPRefSpd Monr_TrnkClsTraceAPRefSpd Monr_TrnkExitRefSpdProcFlag Monr_TrnkOpnAPSpdGap Monr_TrnkOpnCurAPThresh Monr_TrnkOpnTraceAPRefSpd /end REF_MEASUREMENT
/end GROUP
/begin GROUP S3_AntiPinchMainAlgo1 "RDM_AntiPinch/RDM_AntiPinch_Main_sys/AntiPinchMainAlgo1" /begin SUB_GROUP S4_EnableAntiPinch S4_MainAlgorithm /end SUB_GROUP
 /begin REF_CHARACTERISTIC CalC_TrnkClsAntiPinchEnableEndPos CalC_TrnkClsAntiPinchEnableStartPos CalC_TrnkClsFallBackAPCfgEnable CalC_TrnkClsFallBackAPMtrSpdThr CalC_TrnkClsFallBackAPTmThr CalC_TrnkFallBackAPCurrThresh /end REF_CHARACTERISTIC
/end GROUP
/begin GROUP S3_AntiPinchMainAlgo4 "RDM_AntiPinch/RDM_AntiPinch_Main_sys/AntiPinchMainAlgo4" /begin SUB_GROUP S5_EnableAntiPinch S5_MainAlgorithm /end SUB_GROUP
 /begin REF_CHARACTERISTIC CalC_TrnkFallBackAPCurrThresh CalC_TrnkOpenAntiPinchEnableStartPos CalC_TrnkOpnAPMinCurrThr CalC_TrnkOpnFallBackAPCfgEnable CalC_TrnkOpnFallBackAPMtrSpdThr CalC_TrnkOpnFallBackAPTmThr /end REF_CHARACTERISTIC
/end GROUP
/begin GROUP S3_AntiPinchThresh "RDM_AntiPinch/RDM_AntiPinch_Main_sys/AntiPinchThresh" /begin SUB_GROUP S6_ThreshPatch /end SUB_GROUP /end GROUP
/begin GROUP S3_DetClsTraceAPTol "RDM_AntiPinch/RDM_AntiPinch_Main_sys/DetClsTraceAPTol"
 /begin REF_CHARACTERISTIC CalC_TrnkOpnPauseStopTraceAPEnTol CalC_TrnkOpnSlowStopTraceAPEnTol /end REF_CHARACTERISTIC
/end GROUP
/begin GROUP S3_DetOpnAPThresh "RDM_AntiPinch/RDM_AntiPinch_Main_sys/DetOpnAPThresh"
 /begin REF_CHARACTERISTIC CalC_TrnkManualAssistThreshPatch CalC_TrnkOpnTraceAPMtrSpdThr /end REF_CHARACTERISTIC
/end GROUP
/begin GROUP S3_DetTraceAPTol "RDM_AntiPinch/RDM_AntiPinch_Main_sys/DetTraceAPTol"
 /begin REF_CHARACTERISTIC CalC_TrnkOpnPauseStopTraceAPEnTol CalC_TrnkOpnSlowStopTraceAPEnTol /end REF_CHARACTERISTIC
/end GROUP
/begin GROUP S3_For_Each_Subsystem "RDM_AntiPinch/RDM_AntiPinch_Main_sys/For Each Subsystem" /begin REF_CHARACTERISTIC CalC_TrnkMvAbnMtrSpdRiseTol CalC_TrnkMvAbnPWMThr /end REF_CHARACTERISTIC /end GROUP
/begin GROUP S3_SendCurAPThr "RDM_AntiPinch/RDM_AntiPinch_Main_sys/SendCurAPThr" /begin REF_CHARACTERISTIC CalC_TrnkClsTraceAPMtrSpdThr /end REF_CHARACTERISTIC /end GROUP
/begin GROUP S3_Subsystem1 "RDM_AntiPinch/RDM_AntiPinch_Main_sys/Subsystem1"
 /begin REF_CHARACTERISTIC CalC_TrnkClsExitRefSpdAPThrPat1 CalC_TrnkClsExitRefSpdAPThrPat2 CalC_TrnkClsPauseStopThreshPatch CalC_TrnkClsSlowStopThreshPatch /end REF_CHARACTERISTIC
/end GROUP
/begin GROUP S3_Subsystem2 "RDM_AntiPinch/RDM_AntiPinch_Main_sys/Subsystem2"
 /begin REF_CHARACTERISTIC CalC_TrnkOpenAntiPinchEnableEndPosOffset CalC_hIPLGMechHighHall_cnt /end REF_CHARACTERISTIC
/end GROUP
/begin GROUP S3_Subsystem3 "RDM_AntiPinch/RDM_AntiPinch_Main_sys/Subsystem3" /begin SUB_GROUP S30_Subsystem S30_Subsystem1 /end SUB_GROUP
 /begin REF_CHARACTERISTIC CalC_TrnkClsExitRefSpdCurrThrPat1 CalC_TrnkClsExitRefSpdCurrThrPat2 CalC_TrnkClsRefAPSoftRefSpdBias /end REF_CHARACTERISTIC
/end GROUP
/begin GROUP S4_EnableAntiPinch "RDM_AntiPinch/RDM_AntiPinch_Main_sys/AntiPinchMainAlgo1/EnableAntiPinch" /begin REF_CHARACTERISTIC CalC_TrnkClsAntiPinchCfgEnable /end REF_CHARACTERISTIC /end GROUP
/begin GROUP S4_MainAlgorithm "RDM_AntiPinch/RDM_AntiPinch_Main_sys/AntiPinchMainAlgo1/MainAlgorithm" /begin SUB_GROUP S39_RFAP /end SUB_GROUP /begin REF_CHARACTERISTIC CalC_TrnkClsRefAPCfgEnable CalC_TrnkClsTraceAPCfgEnable /end REF_CHARACTERISTIC /end GROUP
/begin GROUP S5_EnableAntiPinch "RDM_AntiPinch/RDM_AntiPinch_Main_sys/AntiPinchMainAlgo4/EnableAntiPinch" /begin REF_CHARACTERISTIC CalC_TrnkOpnAntiPinchCfgEnable /end REF_CHARACTERISTIC /end GROUP
/begin GROUP S5_MainAlgorithm "RDM_AntiPinch/RDM_AntiPinch_Main_sys/AntiPinchMainAlgo4/MainAlgorithm" /begin REF_CHARACTERISTIC CalC_TrnkOpnRefAPCfgEnable CalC_TrnkOpnTraceAPCfgEnable /end REF_CHARACTERISTIC /end GROUP
/begin GROUP S6_ThreshPatch "RDM_AntiPinch/RDM_AntiPinch_Main_sys/AntiPinchThresh/ThreshPatch" /begin SUB_GROUP S87_BaseThreshold S87_SlopePatch /end SUB_GROUP /begin REF_CHARACTERISTIC Cal_SlopePatchEnable /end REF_CHARACTERISTIC /end GROUP
/begin GROUP S30_Subsystem "RDM_AntiPinch/RDM_AntiPinch_Main_sys/Subsystem3/Subsystem"
 /begin REF_CHARACTERISTIC CalC_TrnkClsAdpCurrNmMvAddPat_HT CalC_TrnkClsAdpCurrNmMvAddPat_LT CalC_TrnkClsAdpCurrNmMvAddPat_NT CalC_TrnkClsAdpCurrSlwStpSubPat_HT CalC_TrnkClsAdpCurrSlwStpSubPat_LT CalC_TrnkClsAdpCurrSlwStpSubPat_NT Cal_SlopeCurPatch Cal_SlopePatch /end REF_CHARACTERISTIC
/end GROUP
/begin GROUP S30_Subsystem1 "RDM_AntiPinch/RDM_AntiPinch_Main_sys/Subsystem3/Subsystem1" /begin REF_CHARACTERISTIC CalC_TrnkClsMtrStopDist CalC_TrnkHallZone_HalfClosed_H /end REF_CHARACTERISTIC /end GROUP
/begin GROUP S39_RFAP "RDM_AntiPinch/RDM_AntiPinch_Main_sys/AntiPinchMainAlgo1/MainAlgorithm/RFAP" /begin REF_CHARACTERISTIC CalC_TrnkClsRFCurStepThr /end REF_CHARACTERISTIC /end GROUP
/begin GROUP S87_BaseThreshold "RDM_AntiPinch/RDM_AntiPinch_Main_sys/AntiPinchThresh/ThreshPatch/BaseThreshold"
 /begin REF_CHARACTERISTIC CalC_TrnkClsAPMtrSpdThrTbl_200mm CalC_TrnkClsAPMtrSpdThrTbl_20mm CalC_TrnkClsAPMtrSpdThrTbl_50mm CalC_TrnkClsAPThrTblPosArr /end REF_CHARACTERISTIC
/end GROUP
/begin GROUP S87_SlopePatch "RDM_AntiPinch/RDM_AntiPinch_Main_sys/AntiPinchThresh/ThreshPatch/SlopePatch"
 /begin REF_CHARACTERISTIC CalC_TrnkClsAPThrTblPosArr Cal_SlopePatch Cal_SlopeSpdPatch /end REF_CHARACTERISTIC
/end GROUP
/begin CHARACTERISTIC CalC_TrnkOpnStlStpMaxPosTol "" VALUE 0xb00071c4 /* @ECU_Address@CalC_TrnkOpnStlStpMaxPosTol@ */ Scalar_SWORD 0 RDM_CtrlLeverMtr_CM_int16 -32768 32767 /end CHARACTERISTIC
/begin CHARACTERISTIC CalC_TrnkAntiPinchBrakeTm_msec "" VALUE 0xb000709c /* @ECU_Address@CalC_TrnkAntiPinchBrakeTm_msec@ */ Scalar_UWORD 0 RDM_CtrlLeverMtr_CM_uint16 0 65535 /end CHARACTERISTIC
/begin CHARACTERISTIC CalC_TrnkClsStlStpMaxTmTol_ms "" VALUE 0xb0007140 /* @ECU_Address@CalC_TrnkClsStlStpMaxTmTol_ms@ */ Scalar_UWORD 0 RDM_CtrlLeverMtr_CM_uint16 0 65535 /end CHARACTERISTIC
/begin CHARACTERISTIC CalC_TrnkLvrMtrStpBrkTm_ms "" VALUE 0xb0007172 /* @ECU_Address@CalC_TrnkLvrMtrStpBrkTm_ms@ */ Scalar_UWORD 0 RDM_CtrlLeverMtr_CM_uint16 0 65535 /end CHARACTERISTIC
/begin CHARACTERISTIC CalC_TrnkAntiDriveMaxPosTol "" VALUE 0xb000709a /* @ECU_Address@CalC_TrnkAntiDriveMaxPosTol@ */ Scalar_UBYTE 0 RDM_CtrlLeverMtr_CM_uint8 0 255 /end CHARACTERISTIC
/begin CHARACTERISTIC CalC_TrnkAntiDrivePwm "" VALUE 0xb000709b /* @ECU_Address@CalC_TrnkAntiDrivePwm@ */ Scalar_UBYTE 0 RDM_CtrlLeverMtr_CM_uint8 0 255 /end CHARACTERISTIC
/begin CHARACTERISTIC CalC_TrnkRLvrCfgEnable "" VALUE 0xb00071d2 /* @ECU_Address@CalC_TrnkRLvrCfgEnable@ */ Scalar_UBYTE 0 RDM_CtrlLeverMtr_CM_uint8 0 255 /end CHARACTERISTIC
/begin MEASUREMENT Monr_TrnkLLvrMtrPWMCmd "" UBYTE RDM_CtrlLeverMtr_CM_uint8 0 0 0 255 ECU_ADDRESS 0xb0056228 /* @ECU_Address@Monr_TrnkLLvrMtrPWMCmd@ */ /end MEASUREMENT
/begin MEASUREMENT Monr_TrnkRLvrMtrPWMCmd "" UBYTE RDM_CtrlLeverMtr_CM_uint8 0 0 0 255 ECU_ADDRESS 0xb0056229 /* @ECU_Address@Monr_TrnkRLvrMtrPWMCmd@ */ /end MEASUREMENT
/begin MEASUREMENT Monr_TrnkLLvrMtrCtrlCmd "" UBYTE RDM_CtrlLeverMtr_CM_uint8 0 0 0 255 ECU_ADDRESS 0xb0056226 /* @ECU_Address@Monr_TrnkLLvrMtrCtrlCmd@ */ /end MEASUREMENT
/begin MEASUREMENT Monr_TrnkRLvrMtrCtrlCmd "" UBYTE RDM_CtrlLeverMtr_CM_uint8 0 0 0 255 ECU_ADDRESS 0xb0056227 /* @ECU_Address@Monr_TrnkRLvrMtrCtrlCmd@ */ /end MEASUREMENT
/begin MEASUREMENT Monr_TrnkAllActnSts "" UBYTE RDM_CtrlLeverMtr_CM_uint8 0 0 0 255 ECU_ADDRESS 0xb0056260 /* @ECU_Address@Monr_TrnkAllActnSts@ */ /end MEASUREMENT
/begin MEASUREMENT Monr_TrnkDiagResetFlag "" UBYTE RDM_CtrlLeverMtr_CM_UINT8 0 0 0 255 ECU_ADDRESS 0xb0056262 /* @ECU_Address@Monr_TrnkDiagResetFlag@ */ /end MEASUREMENT
/begin MEASUREMENT Monr_AntiDriveTrig "" UBYTE RDM_CtrlLeverMtr_CM_boolean 0 0 0 1 ECU_ADDRESS 0xb0056355 /* @ECU_Address@Monr_AntiDriveTrig@ */ /end MEASUREMENT
/begin COMPU_METHOD RDM_CtrlLeverMtr_CM_int16 "Q = V" RAT_FUNC "%5.0" "" COEFFS 0 1 0 0 0 1 /end COMPU_METHOD
/begin COMPU_METHOD RDM_CtrlLeverMtr_CM_uint16 "Q = V" RAT_FUNC "%5.0" "" COEFFS 0 1 0 0 0 1 /end COMPU_METHOD
/begin COMPU_METHOD RDM_CtrlLeverMtr_CM_uint8 "Q = V" RAT_FUNC "%3.0" "" COEFFS 0 1 0 0 0 1 /end COMPU_METHOD
/begin COMPU_METHOD RDM_CtrlLeverMtr_CM_UINT8 "Q = V" RAT_FUNC "%3.0" "" COEFFS 0 1 0 0 0 1 /end COMPU_METHOD
/begin COMPU_METHOD RDM_CtrlLeverMtr_CM_boolean "Q = V" RAT_FUNC "%1.0" "" COEFFS 0 1 0 0 0 1 /end COMPU_METHOD
/begin GROUP RDM_CtrlLeverMtr "RDM_CtrlLeverMtr" ROOT /begin SUB_GROUP Root_RDM_CtrlLeverMtr_Main_sys /end SUB_GROUP /end GROUP
/begin GROUP Root_RDM_CtrlLeverMtr_Main_sys "RDM_CtrlLeverMtr/RDM_CtrlLeverMtr_Main_sys" /begin SUB_GROUP S3_DetStallStopCond S3_For_Each_Subsystem /end SUB_GROUP
 /begin REF_CHARACTERISTIC CalC_TrnkAntiDriveMaxPosTol CalC_TrnkAntiDrivePwm CalC_TrnkRLvrCfgEnable /end REF_CHARACTERISTIC
 /begin REF_MEASUREMENT Monr_AntiDriveTrig Monr_TrnkAllActnSts Monr_TrnkDiagResetFlag Monr_TrnkLLvrMtrCtrlCmd Monr_TrnkLLvrMtrPWMCmd Monr_TrnkRLvrMtrCtrlCmd Monr_TrnkRLvrMtrPWMCmd /end REF_MEASUREMENT
/end GROUP
/begin GROUP S3_DetStallStopCond "RDM_CtrlLeverMtr/RDM_CtrlLeverMtr_Main_sys/DetStallStopCond" /begin SUB_GROUP S7_DualLeverStallStop /end SUB_GROUP /begin REF_CHARACTERISTIC CalC_TrnkRLvrCfgEnable /end REF_CHARACTERISTIC /end GROUP
/begin GROUP S3_For_Each_Subsystem "RDM_CtrlLeverMtr/RDM_CtrlLeverMtr_Main_sys/For Each Subsystem" /begin SUB_GROUP S8_Subsystem /end SUB_GROUP /end GROUP
/begin GROUP S7_DualLeverStallStop "RDM_CtrlLeverMtr/RDM_CtrlLeverMtr_Main_sys/DetStallStopCond/DualLeverStallStop" /begin REF_CHARACTERISTIC CalC_TrnkClsStlStpMaxTmTol_ms CalC_TrnkOpnStlStpMaxPosTol /end REF_CHARACTERISTIC /end GROUP
/begin GROUP S8_Subsystem "RDM_CtrlLeverMtr/RDM_CtrlLeverMtr_Main_sys/For Each Subsystem/Subsystem" /begin REF_CHARACTERISTIC CalC_TrnkAntiPinchBrakeTm_msec CalC_TrnkLvrMtrStpBrkTm_ms /end REF_CHARACTERISTIC /end GROUP
/begin CHARACTERISTIC CalC_TrnkLvrMtrStlCurr "" VALUE 0xb000716e /* @ECU_Address@CalC_TrnkLvrMtrStlCurr@ */ Scalar_UWORD 0 RDM_DetLeverMtrStallSt_CM_uint16 0 65535 /end CHARACTERISTIC
/begin CHARACTERISTIC CalC_TrnkLvrMtrStlTm_msec "" VALUE 0xb0007170 /* @ECU_Address@CalC_TrnkLvrMtrStlTm_msec@ */ Scalar_UWORD 0 RDM_DetLeverMtrStallSt_CM_uint16 0 65535 /end CHARACTERISTIC
/begin CHARACTERISTIC CalEn_Debug_TrnkStlSt "" VALUE 0xb0007281 /* @ECU_Address@CalEn_Debug_TrnkStlSt@ */ Scalar_UBYTE 0 RDM_DetLeverMtrStallSt_CM_uint8 0 255 /end CHARACTERISTIC
/begin CHARACTERISTIC CalVal_Debug_TrnkStlSt "" VALUE 0xb0007288 /* @ECU_Address@CalVal_Debug_TrnkStlSt@ */ Scalar_UBYTE 0 RDM_DetLeverMtrStallSt_CM_uint8 0 255 /end CHARACTERISTIC
/begin MEASUREMENT Monr_TrnkLLvrMtrStlSt "" UBYTE RDM_DetLeverMtrStallSt_CM_uint8 0 0 0 255 ECU_ADDRESS 0xb005622a /* @ECU_Address@Monr_TrnkLLvrMtrStlSt@ */ /end MEASUREMENT
/begin MEASUREMENT Monr_TrnkRLvrMtrStlSt "" UBYTE RDM_DetLeverMtrStallSt_CM_uint8 0 0 0 255 ECU_ADDRESS 0xb005622b /* @ECU_Address@Monr_TrnkRLvrMtrStlSt@ */ /end MEASUREMENT
/begin COMPU_METHOD RDM_DetLeverMtrStallSt_CM_uint16 "Q = V" RAT_FUNC "%5.0" "" COEFFS 0 1 0 0 0 1 /end COMPU_METHOD
/begin COMPU_METHOD RDM_DetLeverMtrStallSt_CM_uint8 "Q = V" RAT_FUNC "%3.0" "" COEFFS 0 1 0 0 0 1 /end COMPU_METHOD
/begin GROUP RDM_DetLeverMtrStallSt "RDM_DetLeverMtrStallSt" ROOT /begin SUB_GROUP Root_RDM_DetLeverMtrStallSt_Main_sys /end SUB_GROUP /end GROUP
/begin GROUP Root_RDM_DetLeverMtrStallSt_Main_sys "RDM_DetLeverMtrStallSt/RDM_DetLeverMtrStallSt_Main_sys" /begin SUB_GROUP S3_For_Each_Subsystem /end SUB_GROUP /begin REF_CHARACTERISTIC CalEn_Debug_TrnkStlSt CalVal_Debug_TrnkStlSt /end REF_CHARACTERISTIC /begin REF_MEASUREMENT Monr_TrnkLLvrMtrStlSt Monr_TrnkRLvrMtrStlSt /end REF_MEASUREMENT /end GROUP
/begin GROUP S3_For_Each_Subsystem "RDM_DetLeverMtrStallSt/RDM_DetLeverMtrStallSt_Main_sys/For Each Subsystem" /begin SUB_GROUP S9_Subsystem /end SUB_GROUP /end GROUP
/begin GROUP S9_Subsystem "RDM_DetLeverMtrStallSt/RDM_DetLeverMtrStallSt_Main_sys/For Each Subsystem/Subsystem" /begin REF_CHARACTERISTIC CalC_TrnkLvrMtrStlCurr CalC_TrnkLvrMtrStlTm_msec /end REF_CHARACTERISTIC /end GROUP
/begin CHARACTERISTIC CalC_TrnkThermProtCfgEnable "" VALUE 0xb00071e2 /* @ECU_Address@CalC_TrnkThermProtCfgEnable@ */ Scalar_UBYTE 0 RDM_DetThermProtSt_CM_uint8 0 255 /end CHARACTERISTIC
/begin CHARACTERISTIC CalC_TrnkThermProtCntAccumTmSlot_s "" VALUE 0xb00071e3 /* @ECU_Address@CalC_TrnkThermProtCntAccumTmSlot_s@ */ Scalar_UBYTE 0 RDM_DetThermProtSt_CM_uint8 0 255 /end CHARACTERISTIC
/begin CHARACTERISTIC CalC_TrnkThermProtCntThresh "" VALUE 0xb00071e4 /* @ECU_Address@CalC_TrnkThermProtCntThresh@ */ Scalar_UBYTE 0 RDM_DetThermProtSt_CM_uint8 0 255 /end CHARACTERISTIC
/begin CHARACTERISTIC CalC_TrnkThermProtMdCntDecTmSlot_s "" VALUE 0xb00071e5 /* @ECU_Address@CalC_TrnkThermProtMdCntDecTmSlot_s@ */ Scalar_UBYTE 0 RDM_DetThermProtSt_CM_uint8 0 255 /end CHARACTERISTIC
/begin MEASUREMENT Monr_TrnkThermProtCnt "" UBYTE RDM_DetThermProtSt_CM_uint8 0 0 0 255 ECU_ADDRESS 0xb0056253 /* @ECU_Address@Monr_TrnkThermProtCnt@ */ /end MEASUREMENT
/begin MEASUREMENT Monr_TrnkThermProtMd "" UBYTE RDM_DetThermProtSt_CM_uint8 0 0 0 255 ECU_ADDRESS 0xb0056254 /* @ECU_Address@Monr_TrnkThermProtMd@ */ /end MEASUREMENT
/begin COMPU_METHOD RDM_DetThermProtSt_CM_uint8 "Q = V" RAT_FUNC "%3.0" "" COEFFS 0 1 0 0 0 1 /end COMPU_METHOD
/begin GROUP RDM_DetThermProtSt "RDM_DetThermProtSt" ROOT /begin SUB_GROUP Root_RDM_DetThermProtSt_Main_sys /end SUB_GROUP /end GROUP
/begin GROUP Root_RDM_DetThermProtSt_Main_sys "RDM_DetThermProtSt/RDM_DetThermProtSt_Main_sys" /begin SUB_GROUP S3_Subsystem /end SUB_GROUP /begin REF_CHARACTERISTIC CalC_TrnkThermProtCfgEnable /end REF_CHARACTERISTIC /begin REF_MEASUREMENT Monr_TrnkThermProtCnt Monr_TrnkThermProtMd /end REF_MEASUREMENT /end GROUP
/begin GROUP S3_Subsystem "RDM_DetThermProtSt/RDM_DetThermProtSt_Main_sys/Subsystem"
 /begin REF_CHARACTERISTIC CalC_TrnkThermProtCntAccumTmSlot_s CalC_TrnkThermProtCntThresh CalC_TrnkThermProtMdCntDecTmSlot_s /end REF_CHARACTERISTIC
/end GROUP
/begin CHARACTERISTIC Cal_SlopeCloseSpdPatch "" CURVE 0xb00071fe /* @ECU_Address@Cal_SlopeCloseSpdPatch@ */ Lookup1D_UWORD 0 RDM_DetTrunkMoveReq_CM_uint16 0 65535
 /begin AXIS_DESCR COM_AXIS NO_INPUT_QUANTITY RDM_DetTrunkMoveReq_CM_single 7 -3.4E+38 3.4E+38 AXIS_PTS_REF Cal_SlopePatch /end AXIS_DESCR
/end CHARACTERISTIC
/begin AXIS_PTS Cal_SlopePatch "" 0x8077421c /* @ECU_Address@Cal_SlopePatch@ */ NO_INPUT_QUANTITY Lookup1D_X_FLOAT32_IEEE 0 RDM_DetTrunkMoveReq_CM_single 7 -3.4E+38 3.4E+38 /end AXIS_PTS
/begin CHARACTERISTIC CalC_TrnkClsSpdCtrKd "" VALUE 0xb0007134 /* @ECU_Address@CalC_TrnkClsSpdCtrKd@ */ Scalar_FLOAT32_IEEE 0 RDM_DetTrunkMoveReq_CM_single -3.4E+38 3.4E+38 /end CHARACTERISTIC
/begin CHARACTERISTIC CalC_TrnkClsSpdCtrKi "" VALUE 0xb0007138 /* @ECU_Address@CalC_TrnkClsSpdCtrKi@ */ Scalar_FLOAT32_IEEE 0 RDM_DetTrunkMoveReq_CM_single -3.4E+38 3.4E+38 /end CHARACTERISTIC
/begin CHARACTERISTIC CalC_TrnkClsSpdCtrKp "" VALUE 0xb000713c /* @ECU_Address@CalC_TrnkClsSpdCtrKp@ */ Scalar_FLOAT32_IEEE 0 RDM_DetTrunkMoveReq_CM_single -3.4E+38 3.4E+38 /end CHARACTERISTIC
/begin CHARACTERISTIC CalC_TrnkClsTmpSpd "" VAL_BLK 0xb0007144 /* @ECU_Address@CalC_TrnkClsTmpSpd@ */ Scalar_FLOAT32_IEEE 0 RDM_DetTrunkMoveReq_CM_single -3.4E+38 3.4E+38 NUMBER 3 /end CHARACTERISTIC
/begin CHARACTERISTIC CalC_TrnkOpnSpdCtrKd "" VALUE 0xb00071b8 /* @ECU_Address@CalC_TrnkOpnSpdCtrKd@ */ Scalar_FLOAT32_IEEE 0 RDM_DetTrunkMoveReq_CM_single -3.4E+38 3.4E+38 /end CHARACTERISTIC
/begin CHARACTERISTIC CalC_TrnkOpnSpdCtrKi "" VALUE 0xb00071bc /* @ECU_Address@CalC_TrnkOpnSpdCtrKi@ */ Scalar_FLOAT32_IEEE 0 RDM_DetTrunkMoveReq_CM_single -3.4E+38 3.4E+38 /end CHARACTERISTIC
/begin CHARACTERISTIC CalC_TrnkOpnSpdCtrKp "" VALUE 0xb00071c0 /* @ECU_Address@CalC_TrnkOpnSpdCtrKp@ */ Scalar_FLOAT32_IEEE 0 RDM_DetTrunkMoveReq_CM_single -3.4E+38 3.4E+38 /end CHARACTERISTIC
/begin CHARACTERISTIC CalC_TrnkClsVldMinHallPos "" VALUE 0xb0007152 /* @ECU_Address@CalC_TrnkClsVldMinHallPos@ */ Scalar_SWORD 0 RDM_DetTrunkMoveReq_CM_int16 -32768 32767 /end CHARACTERISTIC
/begin CHARACTERISTIC CalC_TrnkFullClsdTgtPos "" VALUE 0xb000715e /* @ECU_Address@CalC_TrnkFullClsdTgtPos@ */ Scalar_SWORD 0 RDM_DetTrunkMoveReq_CM_int16 -32768 32767 /end CHARACTERISTIC
/begin CHARACTERISTIC CalC_TrnkHallZone_HalfClosed_H "" VALUE 0xb000716c /* @ECU_Address@CalC_TrnkHallZone_HalfClosed_H@ */ Scalar_SWORD 0 RDM_DetTrunkMoveReq_CM_int16 -32768 32767 /end CHARACTERISTIC
/begin CHARACTERISTIC CalC_TrnkOpnMtrBtmStartPosThr "" VALUE 0xb0007198 /* @ECU_Address@CalC_TrnkOpnMtrBtmStartPosThr@ */ Scalar_SWORD 0 RDM_DetTrunkMoveReq_CM_int16 -32768 32767 /end CHARACTERISTIC
/begin CHARACTERISTIC CalC_TrnkOpnMtrStartStepPos "" VALUE 0xb00071a6 /* @ECU_Address@CalC_TrnkOpnMtrStartStepPos@ */ Scalar_SWORD 0 RDM_DetTrunkMoveReq_CM_int16 -32768 32767 /end CHARACTERISTIC
/begin CHARACTERISTIC CalC_TrnkOpnVldMaxHallPos "" VALUE 0xb00071ca /* @ECU_Address@CalC_TrnkOpnVldMaxHallPos@ */ Scalar_SWORD 0 RDM_DetTrunkMoveReq_CM_int16 -32768 32767 /end CHARACTERISTIC
/begin CHARACTERISTIC CalC_hIPLGOpenOnlyHall_cnt "" VALUE 0xb00071ee /* @ECU_Address@CalC_hIPLGOpenOnlyHall_cnt@ */ Scalar_SWORD 0 RDM_DetTrunkMoveReq_CM_int16 -32768 32767 /end CHARACTERISTIC
/begin CHARACTERISTIC CalC_TrnkAPRevsMtrSpd "" VALUE 0xb0007098 /* @ECU_Address@CalC_TrnkAPRevsMtrSpd@ */ Scalar_UWORD 0 RDM_DetTrunkMoveReq_CM_uint16 0 65535 /end CHARACTERISTIC
/begin CHARACTERISTIC CalC_TrnkClsMtrNormSpd "" VALUE 0xb000711e /* @ECU_Address@CalC_TrnkClsMtrNormSpd@ */ Scalar_UWORD 0 RDM_DetTrunkMoveReq_CM_uint16 0 65535 /end CHARACTERISTIC
/begin CHARACTERISTIC CalC_TrnkClsMtrStartSpd "" VALUE 0xb0007120 /* @ECU_Address@CalC_TrnkClsMtrStartSpd@ */ Scalar_UWORD 0 RDM_DetTrunkMoveReq_CM_uint16 0 65535 /end CHARACTERISTIC
/begin CHARACTERISTIC CalC_TrnkClsMtrStartTm "" VALUE 0xb0007122 /* @ECU_Address@CalC_TrnkClsMtrStartTm@ */ Scalar_UWORD 0 RDM_DetTrunkMoveReq_CM_uint16 0 65535 /end CHARACTERISTIC
/begin CHARACTERISTIC CalC_TrnkClsMtrStopDist "" VALUE 0xb0007124 /* @ECU_Address@CalC_TrnkClsMtrStopDist@ */ Scalar_UWORD 0 RDM_DetTrunkMoveReq_CM_uint16 0 65535 /end CHARACTERISTIC
/begin CHARACTERISTIC CalC_TrnkClsMtrStopSpd "" VALUE 0xb0007126 /* @ECU_Address@CalC_TrnkClsMtrStopSpd@ */ Scalar_UWORD 0 RDM_DetTrunkMoveReq_CM_uint16 0 65535 /end CHARACTERISTIC
/begin CHARACTERISTIC CalC_TrnkMinSftStpOpnHallPosOffset "" VALUE 0xb0007176 /* @ECU_Address@CalC_TrnkMinSftStpOpnHallPosOffset@ */ Scalar_UWORD 0 RDM_DetTrunkMoveReq_CM_uint16 0 65535 /end CHARACTERISTIC
/begin CHARACTERISTIC CalC_TrnkNormMvHallPosTol "" VALUE 0xb000718a /* @ECU_Address@CalC_TrnkNormMvHallPosTol@ */ Scalar_UWORD 0 RDM_DetTrunkMoveReq_CM_uint16 0 65535 /end CHARACTERISTIC
/begin CHARACTERISTIC CalC_TrnkOpnMtrBtmStartTm_ms "" VALUE 0xb000719a /* @ECU_Address@CalC_TrnkOpnMtrBtmStartTm_ms@ */ Scalar_UWORD 0 RDM_DetTrunkMoveReq_CM_uint16 0 65535 /end CHARACTERISTIC
/begin CHARACTERISTIC CalC_TrnkOpnMtrNormSpd "" VALUE 0xb000719c /* @ECU_Address@CalC_TrnkOpnMtrNormSpd@ */ Scalar_UWORD 0 RDM_DetTrunkMoveReq_CM_uint16 0 65535 /end CHARACTERISTIC
/begin CHARACTERISTIC CalC_TrnkOpnMtrStartSpd "" VAL_BLK 0xb000719e /* @ECU_Address@CalC_TrnkOpnMtrStartSpd@ */ Scalar_UWORD 0 RDM_DetTrunkMoveReq_CM_uint16 0 65535 NUMBER 3 /end CHARACTERISTIC
/begin CHARACTERISTIC CalC_TrnkOpnMtrStartStepTgtSpd "" VALUE 0xb00071a8 /* @ECU_Address@CalC_TrnkOpnMtrStartStepTgtSpd@ */ Scalar_UWORD 0 RDM_DetTrunkMoveReq_CM_uint16 0 65535 /end CHARACTERISTIC
/begin CHARACTERISTIC CalC_TrnkOpnMtrStartTm "" VALUE 0xb00071aa /* @ECU_Address@CalC_TrnkOpnMtrStartTm@ */ Scalar_UWORD 0 RDM_DetTrunkMoveReq_CM_uint16 0 65535 /end CHARACTERISTIC
/begin CHARACTERISTIC CalC_TrnkOpnMtrStopDist "" VALUE 0xb00071ac /* @ECU_Address@CalC_TrnkOpnMtrStopDist@ */ Scalar_UWORD 0 RDM_DetTrunkMoveReq_CM_uint16 0 65535 /end CHARACTERISTIC
/begin CHARACTERISTIC CalC_TrnkOpnMtrStopSpd "" VALUE 0xb00071ae /* @ECU_Address@CalC_TrnkOpnMtrStopSpd@ */ Scalar_UWORD 0 RDM_DetTrunkMoveReq_CM_uint16 0 65535 /end CHARACTERISTIC
/begin CHARACTERISTIC CalC_TrnkOpnPawlSwOnWaitTm_ms "" VALUE 0xb00071b2 /* @ECU_Address@CalC_TrnkOpnPawlSwOnWaitTm_ms@ */ Scalar_UWORD 0 RDM_DetTrunkMoveReq_CM_uint16 0 65535 /end CHARACTERISTIC
/begin CHARACTERISTIC CalC_TrnkPauseMtrStopDist "" VALUE 0xb00071cc /* @ECU_Address@CalC_TrnkPauseMtrStopDist@ */ Scalar_UWORD 0 RDM_DetTrunkMoveReq_CM_uint16 0 65535 /end CHARACTERISTIC
/begin CHARACTERISTIC CalC_TrnkPshMvStMinPosDist "" VALUE 0xb00071ce /* @ECU_Address@CalC_TrnkPshMvStMinPosDist@ */ Scalar_UWORD 0 RDM_DetTrunkMoveReq_CM_uint16 0 65535 /end CHARACTERISTIC
/begin CHARACTERISTIC CalC_hIPLGClsRvrsHall_cnt "" VALUE 0xb00071e8 /* @ECU_Address@CalC_hIPLGClsRvrsHall_cnt@ */ Scalar_UWORD 0 RDM_DetTrunkMoveReq_CM_uint16 0 65535 /end CHARACTERISTIC
/begin CHARACTERISTIC CalC_hIPLGMechHighHall_cnt "" VALUE 0xb00071ec Scalar_UWORD 0 RDM_DetTrunkMoveReq_CM_uint16 0 65535 /end CHARACTERISTIC
/begin CHARACTERISTIC CalC_hIPLGOpenRvrsHall_cnt "" VALUE 0xb00071f0 /* @ECU_Address@CalC_hIPLGOpenRvrsHall_cnt@ */ Scalar_UWORD 0 RDM_DetTrunkMoveReq_CM_uint16 0 65535 /end CHARACTERISTIC
/begin CHARACTERISTIC CalC_hIPLGServoTrig_cnt "" VALUE 0xb00071f2 /* @ECU_Address@CalC_hIPLGServoTrig_cnt@ */ Scalar_UWORD 0 RDM_DetTrunkMoveReq_CM_uint16 0 65535 /end CHARACTERISTIC
/begin CHARACTERISTIC CalC_tIPLGLatchRelsTimeout_ms "" VALUE 0xb00071f6 /* @ECU_Address@CalC_tIPLGLatchRelsTimeout_ms@ */ Scalar_UWORD 0 RDM_DetTrunkMoveReq_CM_uint16 0 65535 /end CHARACTERISTIC
/begin CHARACTERISTIC CalC_tIPLGSpindleStpDly_ms "" VALUE 0xb00071f8 /* @ECU_Address@CalC_tIPLGSpindleStpDly_ms@ */ Scalar_UWORD 0 RDM_DetTrunkMoveReq_CM_uint16 0 65535 /end CHARACTERISTIC
/begin CHARACTERISTIC Cal_TempTrnkOpnMtrStartSpdAdd "" VAL_BLK 0xb000725c /* @ECU_Address@Cal_TempTrnkOpnMtrStartSpdAdd@ */ Scalar_UWORD 0 RDM_DetTrunkMoveReq_CM_uint16 0 65535 NUMBER 3 /end CHARACTERISTIC
/begin CHARACTERISTIC Cal_TrnkClsTmpThd "" VAL_BLK 0xb0007262 /* @ECU_Address@Cal_TrnkClsTmpThd@ */ Scalar_BYTE 0 RDM_DetTrunkMoveReq_CM_int8 -128 127 NUMBER 3 /end CHARACTERISTIC
/begin CHARACTERISTIC CalC_Debug_TrnkGrOrSpdCond "" VALUE 0xb000727c Scalar_UBYTE 0 RDM_DetTrunkMoveReq_CM_uint8 0 255 /end CHARACTERISTIC
/begin CHARACTERISTIC CalC_TrnkClsManAsstMinPWM "" VALUE 0xb000711c /* @ECU_Address@CalC_TrnkClsManAsstMinPWM@ */ Scalar_UBYTE 0 RDM_DetTrunkMoveReq_CM_uint8 0 255 /end CHARACTERISTIC
/begin CHARACTERISTIC CalC_TrnkHalfClsDecPWM_pct "" VALUE 0xb0007160 /* @ECU_Address@CalC_TrnkHalfClsDecPWM_pct@ */ Scalar_UBYTE 0 RDM_DetTrunkMoveReq_CM_uint8 0 255 /end CHARACTERISTIC
/begin CHARACTERISTIC CalC_TrnkMtrPWMDwnLim "" VALUE 0xb000717c /* @ECU_Address@CalC_TrnkMtrPWMDwnLim@ */ Scalar_UBYTE 0 RDM_DetTrunkMoveReq_CM_uint8 0 255 /end CHARACTERISTIC
/begin CHARACTERISTIC CalC_TrnkMtrPWMUpLim "" VALUE 0xb000717d /* @ECU_Address@CalC_TrnkMtrPWMUpLim@ */ Scalar_UBYTE 0 RDM_DetTrunkMoveReq_CM_uint8 0 255 /end CHARACTERISTIC
/begin CHARACTERISTIC CalC_TrnkMtrSlowStartCfg "" VALUE 0xb000717e /* @ECU_Address@CalC_TrnkMtrSlowStartCfg@ */ Scalar_UBYTE 0 RDM_DetTrunkMoveReq_CM_uint8 0 255 /end CHARACTERISTIC
/begin CHARACTERISTIC CalC_TrnkMtrSlowStopCfg "" VALUE 0xb000717f /* @ECU_Address@CalC_TrnkMtrSlowStopCfg@ */ Scalar_UBYTE 0 RDM_DetTrunkMoveReq_CM_uint8 0 255 /end CHARACTERISTIC
/begin CHARACTERISTIC CalC_TrnkMtrSpdCtrClsLpCfg "" VALUE 0xb0007180 /* @ECU_Address@CalC_TrnkMtrSpdCtrClsLpCfg@ */ Scalar_UBYTE 0 RDM_DetTrunkMoveReq_CM_uint8 0 255 /end CHARACTERISTIC
/begin CHARACTERISTIC CalC_TrnkOpnMtrStartStepCfg "" VALUE 0xb00071a4 /* @ECU_Address@CalC_TrnkOpnMtrStartStepCfg@ */ Scalar_UBYTE 0 RDM_DetTrunkMoveReq_CM_uint8 0 255 /end CHARACTERISTIC
/begin CHARACTERISTIC CalC_TrnkScanKeyPosTm_sec "" VALUE 0xb00071d4 /* @ECU_Address@CalC_TrnkScanKeyPosTm_sec@ */ Scalar_UBYTE 0 RDM_DetTrunkMoveReq_CM_uint8 0 255 /end CHARACTERISTIC
/begin CHARACTERISTIC CalC_pctIPLGSpindleDtcy_pct "" VALUE 0xb00071f4 /* @ECU_Address@CalC_pctIPLGSpindleDtcy_pct@ */ Scalar_UBYTE 0 RDM_DetTrunkMoveReq_CM_uint8 0 255 /end CHARACTERISTIC
/begin CHARACTERISTIC CalEn_Debug_TrnkLatchSt "" VALUE 0xb0007280 /* @ECU_Address@CalEn_Debug_TrnkLatchSt@ */ Scalar_UBYTE 0 RDM_DetTrunkMoveReq_CM_uint8 0 255 /end CHARACTERISTIC
/begin CHARACTERISTIC CalVal_Debug_TrnkLatchSt "" VALUE 0xb0007287 /* @ECU_Address@CalVal_Debug_TrnkLatchSt@ */ Scalar_UBYTE 0 RDM_DetTrunkMoveReq_CM_uint8 0 255 /end CHARACTERISTIC
/begin MEASUREMENT Monr_TrnkMvTgtMtrSpd "" UWORD RDM_DetTrunkMoveReq_CM_uint16 0 0 0 65535 ECU_ADDRESS 0xb005627c /* @ECU_Address@Monr_TrnkMvTgtMtrSpd@ */ /end MEASUREMENT
/begin MEASUREMENT Monr_TrnkLatchSt "" UBYTE RDM_DetTrunkMoveReq_CM_UINT8 0 0 0 255 ECU_ADDRESS 0xb005625d /* @ECU_Address@Monr_TrnkLatchSt@ */ /end MEASUREMENT
/begin MEASUREMENT Monr_TrnkMvSrc "" UBYTE RDM_DetTrunkMoveReq_CM_uint8 0 0 0 255 ECU_ADDRESS 0xb005622d /* @ECU_Address@Monr_TrnkMvSrc@ */ /end MEASUREMENT
/begin MEASUREMENT Monr_TrnkOpnUnlckLatchRqst "" UBYTE RDM_DetTrunkMoveReq_CM_uint8 0 0 0 255 ECU_ADDRESS 0xb005625c /* @ECU_Address@Monr_TrnkOpnUnlckLatchRqst@ */ /end MEASUREMENT
/begin MEASUREMENT Monr_TrnkMvSt "" UBYTE RDM_DetTrunkMoveReq_CM_uint8 0 0 0 255 ECU_ADDRESS 0xb005622c /* @ECU_Address@Monr_TrnkMvSt@ */ /end MEASUREMENT
/begin MEASUREMENT Monr_TrnkMtrSpdRqstAdjSt "" UBYTE RDM_DetTrunkMoveReq_CM_uint8 0 0 0 255 ECU_ADDRESS 0xb005627e /* @ECU_Address@Monr_TrnkMtrSpdRqstAdjSt@ */ /end MEASUREMENT
/begin MEASUREMENT Monr_CurState "" UBYTE RDM_DetTrunkMoveReq_CM_uint8 0 0 0 255 ECU_ADDRESS 0xb0056357 /* @ECU_Address@Monr_CurState@ */ /end MEASUREMENT
/begin COMPU_METHOD RDM_DetTrunkMoveReq_CM_uint16 "Q = V" RAT_FUNC "%5.0" "" COEFFS 0 1 0 0 0 1 /end COMPU_METHOD
/begin COMPU_METHOD RDM_DetTrunkMoveReq_CM_single "Q = V" RAT_FUNC "%8.6" "" COEFFS 0 1 0 0 0 1 /end COMPU_METHOD
/begin COMPU_METHOD RDM_DetTrunkMoveReq_CM_int16 "Q = V" RAT_FUNC "%5.0" "" COEFFS 0 1 0 0 0 1 /end COMPU_METHOD
/begin COMPU_METHOD RDM_DetTrunkMoveReq_CM_int8 "Q = V" RAT_FUNC "%3.0" "" COEFFS 0 1 0 0 0 1 /end COMPU_METHOD
/begin COMPU_METHOD RDM_DetTrunkMoveReq_CM_uint8 "Q = V" RAT_FUNC "%3.0" "" COEFFS 0 1 0 0 0 1 /end COMPU_METHOD
/begin COMPU_METHOD RDM_DetTrunkMoveReq_CM_UINT8 "Q = V" RAT_FUNC "%3.0" "" COEFFS 0 1 0 0 0 1 /end COMPU_METHOD
/begin GROUP RDM_DetTrunkMoveReq "RDM_DetTrunkMoveReq" ROOT /begin SUB_GROUP Root_RDM_DetTrunkMoveReq_Main_sys /end SUB_GROUP /end GROUP
/begin GROUP Root_RDM_DetTrunkMoveReq_Main_sys "RDM_DetTrunkMoveReq/RDM_DetTrunkMoveReq_Main_sys"
 /begin SUB_GROUP S3_DetAutoInitExctCond S3_DetAutoInitPreCond S3_DetOpnStartStepTgtSpd S3_DetPWMRqst S3_RqstPreProcess /end SUB_GROUP
 /begin REF_CHARACTERISTIC CalC_Debug_TrnkGrOrSpdCond CalC_TrnkAPRevsMtrSpd CalC_TrnkClsManAsstMinPWM CalC_TrnkClsMtrNormSpd CalC_TrnkClsMtrStartSpd CalC_TrnkClsMtrStartTm CalC_TrnkClsMtrStopDist CalC_TrnkClsMtrStopSpd CalC_TrnkClsTmpSpd CalC_TrnkFullClsdTgtPos CalC_TrnkHalfClsDecPWM_pct CalC_TrnkHallZone_HalfClosed_H CalC_TrnkMinSftStpOpnHallPosOffset CalC_TrnkMtrPWMDwnLim CalC_TrnkMtrSlowStartCfg CalC_TrnkMtrSlowStopCfg CalC_TrnkMtrSpdCtrClsLpCfg CalC_TrnkNormMvHallPosTol CalC_TrnkOpnMtrBtmStartPosThr CalC_TrnkOpnMtrBtmStartTm_ms CalC_TrnkOpnMtrNormSpd CalC_TrnkOpnMtrStartSpd CalC_TrnkOpnMtrStartTm CalC_TrnkOpnMtrStopDist CalC_TrnkOpnMtrStopSpd CalC_TrnkOpnPawlSwOnWaitTm_ms CalC_TrnkPauseMtrStopDist CalC_hIPLGClsRvrsHall_cnt CalC_hIPLGOpenOnlyHall_cnt CalC_hIPLGOpenRvrsHall_cnt CalC_pctIPLGSpindleDtcy_pct CalC_tIPLGLatchRelsTimeout_ms CalC_tIPLGSpindleStpDly_ms CalEn_Debug_TrnkLatchSt CalVal_Debug_TrnkLatchSt Cal_SlopeCloseSpdPatch Cal_TempTrnkOpnMtrStartSpdAdd Cal_TrnkClsTmpThd /end REF_CHARACTERISTIC
 /begin REF_MEASUREMENT Monr_CurState Monr_TrnkLatchSt Monr_TrnkMtrSpdRqstAdjSt Monr_TrnkMvSrc Monr_TrnkMvSt Monr_TrnkMvTgtMtrSpd Monr_TrnkOpnUnlckLatchRqst /end REF_MEASUREMENT
/end GROUP
/begin GROUP S3_DetAutoInitExctCond "RDM_DetTrunkMoveReq/RDM_DetTrunkMoveReq_Main_sys/DetAutoInitExctCond"
 /begin REF_CHARACTERISTIC CalC_TrnkClsVldMinHallPos CalC_TrnkOpnVldMaxHallPos CalC_hIPLGMechHighHall_cnt /end REF_CHARACTERISTIC
/end GROUP
/begin GROUP S3_DetAutoInitPreCond "RDM_DetTrunkMoveReq/RDM_DetTrunkMoveReq_Main_sys/DetAutoInitPreCond" /begin REF_CHARACTERISTIC CalC_hIPLGOpenOnlyHall_cnt /end REF_CHARACTERISTIC /end GROUP
/begin GROUP S3_DetOpnStartStepTgtSpd "RDM_DetTrunkMoveReq/RDM_DetTrunkMoveReq_Main_sys/DetOpnStartStepTgtSpd"
 /begin REF_CHARACTERISTIC CalC_TrnkOpnMtrNormSpd CalC_TrnkOpnMtrStartStepCfg CalC_TrnkOpnMtrStartStepPos CalC_TrnkOpnMtrStartStepTgtSpd /end REF_CHARACTERISTIC
/end GROUP
/begin GROUP S3_DetPWMRqst "RDM_DetTrunkMoveReq/RDM_DetTrunkMoveReq_Main_sys/DetPWMRqst" /begin SUB_GROUP S19_DetClsPWMLim S19_DetOpnStartStepTgtSpd /end SUB_GROUP
 /begin REF_CHARACTERISTIC CalC_TrnkClsSpdCtrKd CalC_TrnkClsSpdCtrKi CalC_TrnkClsSpdCtrKp CalC_TrnkMtrPWMDwnLim CalC_TrnkMtrPWMUpLim CalC_TrnkMtrSpdCtrClsLpCfg /end REF_CHARACTERISTIC
/end GROUP
/begin GROUP S3_RqstPreProcess "RDM_DetTrunkMoveReq/RDM_DetTrunkMoveReq_Main_sys/RqstPreProcess" /begin SUB_GROUP S28_DetManualPushTrig /end SUB_GROUP /begin REF_CHARACTERISTIC CalC_TrnkScanKeyPosTm_sec /end REF_CHARACTERISTIC /end GROUP
/begin GROUP S19_DetClsPWMLim "RDM_DetTrunkMoveReq/RDM_DetTrunkMoveReq_Main_sys/DetPWMRqst/DetClsPWMLim"
 /begin REF_CHARACTERISTIC CalC_TrnkClsManAsstMinPWM CalC_TrnkMtrPWMDwnLim CalC_TrnkMtrPWMUpLim /end REF_CHARACTERISTIC
/end GROUP
/begin GROUP S19_DetOpnStartStepTgtSpd "RDM_DetTrunkMoveReq/RDM_DetTrunkMoveReq_Main_sys/DetPWMRqst/DetOpnStartStepTgtSpd"
 /begin REF_CHARACTERISTIC CalC_TrnkOpnMtrStartStepCfg CalC_TrnkOpnSpdCtrKd CalC_TrnkOpnSpdCtrKi CalC_TrnkOpnSpdCtrKp /end REF_CHARACTERISTIC
/end GROUP
/begin GROUP S28_DetManualPushTrig "RDM_DetTrunkMoveReq/RDM_DetTrunkMoveReq_Main_sys/RqstPreProcess/DetManualPushTrig" /begin SUB_GROUP S237_Enabled_Subsystem /end SUB_GROUP /end GROUP
/begin GROUP S237_Enabled_Subsystem "RDM_DetTrunkMoveReq/RDM_DetTrunkMoveReq_Main_sys/RqstPreProcess/DetManualPushTrig/Enabled Subsystem" /begin REF_CHARACTERISTIC CalC_TrnkPshMvStMinPosDist CalC_hIPLGServoTrig_cnt /end REF_CHARACTERISTIC /end GROUP
/begin CHARACTERISTIC CalC_TrnkCurrFilterStartNum "" VALUE 0xb0007154 /* @ECU_Address@CalC_TrnkCurrFilterStartNum@ */ Scalar_UBYTE 0 RDM_FITIn_CM_uint8 0 255 /end CHARACTERISTIC
/begin CHARACTERISTIC CalC_TrnkCurrFilterWinSize "" VALUE 0xb0007155 /* @ECU_Address@CalC_TrnkCurrFilterWinSize@ */ Scalar_UBYTE 0 RDM_FITIn_CM_uint8 0 255 /end CHARACTERISTIC
/begin CHARACTERISTIC CalEn_FIN_KeyTrnkRqst "" VALUE 0xb0007289 /* @ECU_Address@CalEn_FIN_KeyTrnkRqst@ */ Scalar_UBYTE 0 RDM_FITIn_CM_uint8 0 255 /end CHARACTERISTIC
/begin CHARACTERISTIC CalEn_FIN_TrnkRelsDrvSw "" VALUE 0xb000728a /* @ECU_Address@CalEn_FIN_TrnkRelsDrvSw@ */ Scalar_UBYTE 0 RDM_FITIn_CM_uint8 0 255 /end CHARACTERISTIC
/begin CHARACTERISTIC CalEn_FIN_TrnkRelsExtSw "" VALUE 0xb000728b /* @ECU_Address@CalEn_FIN_TrnkRelsExtSw@ */ Scalar_UBYTE 0 RDM_FITIn_CM_uint8 0 255 /end CHARACTERISTIC
/begin CHARACTERISTIC CalEn_FIN_TrnkRelsIntSw "" VALUE 0xb000728c /* @ECU_Address@CalEn_FIN_TrnkRelsIntSw@ */ Scalar_UBYTE 0 RDM_FITIn_CM_uint8 0 255 /end CHARACTERISTIC
/begin CHARACTERISTIC CalVal_FIN_KeyTrnkRqst "" VALUE 0xb000728d /* @ECU_Address@CalVal_FIN_KeyTrnkRqst@ */ Scalar_UBYTE 0 RDM_FITIn_CM_uint8 0 255 /end CHARACTERISTIC
/begin CHARACTERISTIC CalVal_FIN_TrnkRelsDrvSw "" VALUE 0xb000728e /* @ECU_Address@CalVal_FIN_TrnkRelsDrvSw@ */ Scalar_UBYTE 0 RDM_FITIn_CM_uint8 0 255 /end CHARACTERISTIC
/begin CHARACTERISTIC CalVal_FIN_TrnkRelsExtSw "" VALUE 0xb000728f /* @ECU_Address@CalVal_FIN_TrnkRelsExtSw@ */ Scalar_UBYTE 0 RDM_FITIn_CM_uint8 0 255 /end CHARACTERISTIC
/begin CHARACTERISTIC CalVal_FIN_TrnkRelsIntSw "" VALUE 0xb0007290 /* @ECU_Address@CalVal_FIN_TrnkRelsIntSw@ */ Scalar_UBYTE 0 RDM_FITIn_CM_uint8 0 255 /end CHARACTERISTIC
/begin MEASUREMENT Monr_TrnkLLvrSortedCurrFBArr "" UWORD RDM_FITIn_CM_UINT16 0 0 0 65535 ARRAY_SIZE 100 ECU_ADDRESS 0xb0056284 /* @ECU_Address@Monr_TrnkLLvrSortedCurrFBArr@ */ /end MEASUREMENT
/begin MEASUREMENT Monr_FIN_TrnkLLvrCurrFB "" UWORD RDM_FITIn_CM_uint16 0 0 0 65535 ECU_ADDRESS 0xb005635a /* @ECU_Address@Monr_FIN_TrnkLLvrCurrFB@ */ /end MEASUREMENT
/begin MEASUREMENT Monr_FIN_TrnkRLvrCurrFB "" UWORD RDM_FITIn_CM_uint16 0 0 0 65535 ECU_ADDRESS 0xb0056358 /* @ECU_Address@Monr_FIN_TrnkRLvrCurrFB@ */ /end MEASUREMENT
/begin MEASUREMENT Monr_FIN_KeyTrnkRqst "" UBYTE RDM_FITIn_CM_UINT8 0 0 0 255 ECU_ADDRESS 0xb005635c /* @ECU_Address@Monr_FIN_KeyTrnkRqst@ */ /end MEASUREMENT
/begin MEASUREMENT Monr_FIN_TrnkRelsExtSw "" UBYTE RDM_FITIn_CM_UINT8 0 0 0 255 ECU_ADDRESS 0xb005635e /* @ECU_Address@Monr_FIN_TrnkRelsExtSw@ */ /end MEASUREMENT
/begin MEASUREMENT Monr_FIN_TrnkRelsIntSw "" UBYTE RDM_FITIn_CM_UINT8 0 0 0 255 ECU_ADDRESS 0xb005635f /* @ECU_Address@Monr_FIN_TrnkRelsIntSw@ */ /end MEASUREMENT
/begin MEASUREMENT Monr_FIN_TrnkRelsDrvSw "" UBYTE RDM_FITIn_CM_UINT8 0 0 0 255 ECU_ADDRESS 0xb005635d /* @ECU_Address@Monr_FIN_TrnkRelsDrvSw@ */ /end MEASUREMENT
/begin COMPU_METHOD RDM_FITIn_CM_uint8 "Q = V" RAT_FUNC "%3.0" "" COEFFS 0 1 0 0 0 1 /end COMPU_METHOD
/begin COMPU_METHOD RDM_FITIn_CM_UINT16 "Q = V" RAT_FUNC "%5.0" "" COEFFS 0 1 0 0 0 1 /end COMPU_METHOD
/begin COMPU_METHOD RDM_FITIn_CM_uint16 "Q = V" RAT_FUNC "%5.0" "" COEFFS 0 1 0 0 0 1 /end COMPU_METHOD
/begin COMPU_METHOD RDM_FITIn_CM_UINT8 "Q = V" RAT_FUNC "%3.0" "" COEFFS 0 1 0 0 0 1 /end COMPU_METHOD
/begin GROUP RDM_FITIn "RDM_FITIn" ROOT /begin SUB_GROUP Root_RDM_FITIn_Main_sys /end SUB_GROUP /end GROUP
/begin GROUP Root_RDM_FITIn_Main_sys "RDM_FITIn/RDM_FITIn_Main_sys" /begin SUB_GROUP S2_Cal_RDM_FITIn /end SUB_GROUP /end GROUP
/begin GROUP S2_Cal_RDM_FITIn "RDM_FITIn/RDM_FITIn_Main_sys/Cal_RDM_FITIn" /begin SUB_GROUP S3_Subsystem S3_Subsystem1 /end SUB_GROUP
 /begin REF_CHARACTERISTIC CalEn_FIN_KeyTrnkRqst CalEn_FIN_TrnkRelsDrvSw CalEn_FIN_TrnkRelsExtSw CalEn_FIN_TrnkRelsIntSw CalVal_FIN_KeyTrnkRqst CalVal_FIN_TrnkRelsDrvSw CalVal_FIN_TrnkRelsExtSw CalVal_FIN_TrnkRelsIntSw /end REF_CHARACTERISTIC
 /begin REF_MEASUREMENT Monr_FIN_KeyTrnkRqst Monr_FIN_TrnkRelsDrvSw Monr_FIN_TrnkRelsExtSw Monr_FIN_TrnkRelsIntSw /end REF_MEASUREMENT
/end GROUP
/begin GROUP S3_Subsystem "RDM_FITIn/RDM_FITIn_Main_sys/Cal_RDM_FITIn/Subsystem" /begin REF_MEASUREMENT Monr_FIN_TrnkRLvrCurrFB /end REF_MEASUREMENT /end GROUP
/begin GROUP S3_Subsystem1 "RDM_FITIn/RDM_FITIn_Main_sys/Cal_RDM_FITIn/Subsystem1" /begin REF_CHARACTERISTIC CalC_TrnkCurrFilterStartNum CalC_TrnkCurrFilterWinSize /end REF_CHARACTERISTIC /begin REF_MEASUREMENT Monr_FIN_TrnkLLvrCurrFB Monr_TrnkLLvrSortedCurrFBArr /end REF_MEASUREMENT /end GROUP
/begin CHARACTERISTIC CalEn_FITOut_TgateBuzBepSts "" VALUE 0xb0007291 /* @ECU_Address@CalEn_FITOut_TgateBuzBepSts@ */ Scalar_UBYTE 0 RDM_FITOut_CM_uint8 0 255 /end CHARACTERISTIC
/begin CHARACTERISTIC CalEn_FITOut_TrnkLLvrMtrCmd "" VALUE 0xb0007292 /* @ECU_Address@CalEn_FITOut_TrnkLLvrMtrCmd@ */ Scalar_UBYTE 0 RDM_FITOut_CM_uint8 0 255 /end CHARACTERISTIC
/begin CHARACTERISTIC CalEn_FITOut_TrnkLLvrMtrPWM "" VALUE 0xb0007293 /* @ECU_Address@CalEn_FITOut_TrnkLLvrMtrPWM@ */ Scalar_UBYTE 0 RDM_FITOut_CM_uint8 0 255 /end CHARACTERISTIC
/begin CHARACTERISTIC CalEn_FITOut_TrnkRLvrMtrCmd "" VALUE 0xb0007294 /* @ECU_Address@CalEn_FITOut_TrnkRLvrMtrCmd@ */ Scalar_UBYTE 0 RDM_FITOut_CM_uint8 0 255 /end CHARACTERISTIC
/begin CHARACTERISTIC CalEn_FITOut_TrnkRLvrMtrPWM "" VALUE 0xb0007295 /* @ECU_Address@CalEn_FITOut_TrnkRLvrMtrPWM@ */ Scalar_UBYTE 0 RDM_FITOut_CM_uint8 0 255 /end CHARACTERISTIC
/begin CHARACTERISTIC CalVal_FITOut_TgateBuzBepSts "" VALUE 0xb0007296 /* @ECU_Address@CalVal_FITOut_TgateBuzBepSts@ */ Scalar_UBYTE 0 RDM_FITOut_CM_uint8 0 255 /end CHARACTERISTIC
/begin CHARACTERISTIC CalVal_FITOut_TrnkLLvrMtrCmd "" VALUE 0xb0007297 /* @ECU_Address@CalVal_FITOut_TrnkLLvrMtrCmd@ */ Scalar_UBYTE 0 RDM_FITOut_CM_uint8 0 255 /end CHARACTERISTIC
/begin CHARACTERISTIC CalVal_FITOut_TrnkLLvrMtrPWM "" VALUE 0xb0007298 /* @ECU_Address@CalVal_FITOut_TrnkLLvrMtrPWM@ */ Scalar_UBYTE 0 RDM_FITOut_CM_uint8 0 255 /end CHARACTERISTIC
/begin CHARACTERISTIC CalVal_FITOut_TrnkRLvrMtrCmd "" VALUE 0xb0007299 /* @ECU_Address@CalVal_FITOut_TrnkRLvrMtrCmd@ */ Scalar_UBYTE 0 RDM_FITOut_CM_uint8 0 255 /end CHARACTERISTIC
/begin CHARACTERISTIC CalVal_FITOut_TrnkRLvrMtrPWM "" VALUE 0xb000729a /* @ECU_Address@CalVal_FITOut_TrnkRLvrMtrPWM@ */ Scalar_UBYTE 0 RDM_FITOut_CM_uint8 0 255 /end CHARACTERISTIC
/begin MEASUREMENT Monr_FITOut_TrnkLLvrMtrCmd "" UBYTE RDM_FITOut_CM_UINT8 0 0 0 255 ECU_ADDRESS 0xb0056360 /* @ECU_Address@Monr_FITOut_TrnkLLvrMtrCmd@ */ /end MEASUREMENT
/begin MEASUREMENT Monr_FITOut_TrnkLLvrMtrPWM "" UBYTE RDM_FITOut_CM_UINT8 0 0 0 255 ECU_ADDRESS 0xb0056361 /* @ECU_Address@Monr_FITOut_TrnkLLvrMtrPWM@ */ /end MEASUREMENT
/begin MEASUREMENT Monr_FITOut_TrnkRLvrMtrCmd "" UBYTE RDM_FITOut_CM_UINT8 0 0 0 255 ECU_ADDRESS 0xb0056362 /* @ECU_Address@Monr_FITOut_TrnkRLvrMtrCmd@ */ /end MEASUREMENT
/begin MEASUREMENT Monr_FITOut_TrnkRLvrMtrPWM "" UBYTE RDM_FITOut_CM_UINT8 0 0 0 255 ECU_ADDRESS 0xb0056363 /* @ECU_Address@Monr_FITOut_TrnkRLvrMtrPWM@ */ /end MEASUREMENT
/begin COMPU_METHOD RDM_FITOut_CM_uint8 "Q = V" RAT_FUNC "%3.0" "" COEFFS 0 1 0 0 0 1 /end COMPU_METHOD
/begin COMPU_METHOD RDM_FITOut_CM_UINT8 "Q = V" RAT_FUNC "%3.0" "" COEFFS 0 1 0 0 0 1 /end COMPU_METHOD
/begin GROUP RDM_FITOut "RDM_FITOut" ROOT /begin SUB_GROUP Root_RDM_FITOut_Main_sys /end SUB_GROUP /end GROUP
/begin GROUP Root_RDM_FITOut_Main_sys "RDM_FITOut/RDM_FITOut_Main_sys" /begin SUB_GROUP S2_FITOutCS /end SUB_GROUP /end GROUP
/begin GROUP S2_FITOutCS "RDM_FITOut/RDM_FITOut_Main_sys/FITOutCS"
 /begin REF_CHARACTERISTIC CalEn_FITOut_TgateBuzBepSts CalEn_FITOut_TrnkLLvrMtrCmd CalEn_FITOut_TrnkLLvrMtrPWM CalEn_FITOut_TrnkRLvrMtrCmd CalEn_FITOut_TrnkRLvrMtrPWM CalVal_FITOut_TgateBuzBepSts CalVal_FITOut_TrnkLLvrMtrCmd CalVal_FITOut_TrnkLLvrMtrPWM CalVal_FITOut_TrnkRLvrMtrCmd CalVal_FITOut_TrnkRLvrMtrPWM /end REF_CHARACTERISTIC
 /begin REF_MEASUREMENT Monr_FITOut_TrnkLLvrMtrCmd Monr_FITOut_TrnkLLvrMtrPWM Monr_FITOut_TrnkRLvrMtrCmd Monr_FITOut_TrnkRLvrMtrPWM /end REF_MEASUREMENT
/end GROUP
/begin CHARACTERISTIC CalC_TrnkClsVldMinHallPos "" VALUE 0xb0007152 /* @ECU_Address@CalC_TrnkClsVldMinHallPos@ */ Scalar_SWORD 0 RDM_GetTrunkPos_CM_int16 -32768 32767 /end CHARACTERISTIC
/begin CHARACTERISTIC CalC_TrnkDualLvrMaxPosTol "" VALUE 0xb0007156 /* @ECU_Address@CalC_TrnkDualLvrMaxPosTol@ */ Scalar_SWORD 0 RDM_GetTrunkPos_CM_int16 -32768 32767 /end CHARACTERISTIC
/begin CHARACTERISTIC CalC_TrnkOpnVldMaxHallPos "" VALUE 0xb00071ca /* @ECU_Address@CalC_TrnkOpnVldMaxHallPos@ */ Scalar_SWORD 0 RDM_GetTrunkPos_CM_int16 -32768 32767 /end CHARACTERISTIC
/begin CHARACTERISTIC CalC_TrnkSftStpClsHallPos "" VALUE 0xb00071d6 /* @ECU_Address@CalC_TrnkSftStpClsHallPos@ */ Scalar_SWORD 0 RDM_GetTrunkPos_CM_int16 -32768 32767 /end CHARACTERISTIC
/begin CHARACTERISTIC CalC_hIPLGOpenOnlyHall_cnt "" VALUE 0xb00071ee /* @ECU_Address@CalC_hIPLGOpenOnlyHall_cnt@ */ Scalar_SWORD 0 RDM_GetTrunkPos_CM_int16 -32768 32767 /end CHARACTERISTIC
/begin CHARACTERISTIC CalVal_Debug_TrnkCurHallPos "" VALUE 0xb0007284 /* @ECU_Address@CalVal_Debug_TrnkCurHallPos@ */ Scalar_SWORD 0 RDM_GetTrunkPos_CM_int16 -32768 32767 /end CHARACTERISTIC
/begin CHARACTERISTIC CalC_TrnkMinSftStpOpnHallPosOffset "" VALUE 0xb0007176 /* @ECU_Address@CalC_TrnkMinSftStpOpnHallPosOffset@ */ Scalar_UWORD 0 RDM_GetTrunkPos_CM_uint16 0 65535 /end CHARACTERISTIC
/begin CHARACTERISTIC CalC_TrnkMtrClsStartUpDist "" VALUE 0xb0007178 /* @ECU_Address@CalC_TrnkMtrClsStartUpDist@ */ Scalar_UWORD 0 RDM_GetTrunkPos_CM_uint16 0 65535 /end CHARACTERISTIC
/begin CHARACTERISTIC CalC_TrnkMtrOpnStartUpDist "" VALUE 0xb000717a /* @ECU_Address@CalC_TrnkMtrOpnStartUpDist@ */ Scalar_UWORD 0 RDM_GetTrunkPos_CM_uint16 0 65535 /end CHARACTERISTIC
/begin CHARACTERISTIC CalC_TrnkNormMvHallPosTol "" VALUE 0xb000718a /* @ECU_Address@CalC_TrnkNormMvHallPosTol@ */ Scalar_UWORD 0 RDM_GetTrunkPos_CM_uint16 0 65535 /end CHARACTERISTIC
/begin CHARACTERISTIC CalC_TrnkRFAPBlockIntv "" VALUE 0xb00071d0 /* @ECU_Address@CalC_TrnkRFAPBlockIntv@ */ Scalar_UWORD 0 RDM_GetTrunkPos_CM_uint16 0 65535 /end CHARACTERISTIC
/begin CHARACTERISTIC CalC_hIPLGCloseOnlyHallTol_cnt "" VALUE 0xb00071e6 /* @ECU_Address@CalC_hIPLGCloseOnlyHallTol_cnt@ */ Scalar_UWORD 0 RDM_GetTrunkPos_CM_uint16 0 65535 /end CHARACTERISTIC
/begin CHARACTERISTIC CalC_hIPLGMechHighHall_cnt "" VALUE 0xb00071ec Scalar_UWORD 0 RDM_GetTrunkPos_CM_uint16 0 65535 /end CHARACTERISTIC
/begin CHARACTERISTIC CalC_Debug_TrnkGrOrSpdCond "" VALUE 0xb000727c Scalar_UBYTE 0 RDM_GetTrunkPos_CM_uint8 0 255 /end CHARACTERISTIC
/begin CHARACTERISTIC CalC_TrnkHallSeriesDir "" VALUE 0xb0007168 /* @ECU_Address@CalC_TrnkHallSeriesDir@ */ Scalar_UBYTE 0 RDM_GetTrunkPos_CM_uint8 0 255 /end CHARACTERISTIC
/begin CHARACTERISTIC CalC_TrnkRelsSwLstInitHdTm_sec "" VALUE 0xb00071d3 /* @ECU_Address@CalC_TrnkRelsSwLstInitHdTm_sec@ */ Scalar_UBYTE 0 RDM_GetTrunkPos_CM_uint8 0 255 /end CHARACTERISTIC
/begin CHARACTERISTIC CalEn_Debug_TgatePosSts "" VALUE 0xb000727d /* @ECU_Address@CalEn_Debug_TgatePosSts@ */ Scalar_UBYTE 0 RDM_GetTrunkPos_CM_uint8 0 255 /end CHARACTERISTIC
/begin CHARACTERISTIC CalEn_Debug_TrnkCurHallPos "" VALUE 0xb000727e /* @ECU_Address@CalEn_Debug_TrnkCurHallPos@ */ Scalar_UBYTE 0 RDM_GetTrunkPos_CM_uint8 0 255 /end CHARACTERISTIC
/begin CHARACTERISTIC CalEn_Debug_TrnkInitSt "" VALUE 0xb000727f /* @ECU_Address@CalEn_Debug_TrnkInitSt@ */ Scalar_UBYTE 0 RDM_GetTrunkPos_CM_uint8 0 255 /end CHARACTERISTIC
/begin CHARACTERISTIC CalEn_Debug_TrnkLatchSt "" VALUE 0xb0007280 /* @ECU_Address@CalEn_Debug_TrnkLatchSt@ */ Scalar_UBYTE 0 RDM_GetTrunkPos_CM_uint8 0 255 /end CHARACTERISTIC
/begin CHARACTERISTIC CalVal_Debug_TgatePosSts "" VALUE 0xb0007282 /* @ECU_Address@CalVal_Debug_TgatePosSts@ */ Scalar_UBYTE 0 RDM_GetTrunkPos_CM_uint8 0 255 /end CHARACTERISTIC
/begin CHARACTERISTIC CalVal_Debug_TrnkInitSt "" VALUE 0xb0007286 /* @ECU_Address@CalVal_Debug_TrnkInitSt@ */ Scalar_UBYTE 0 RDM_GetTrunkPos_CM_uint8 0 255 /end CHARACTERISTIC
/begin CHARACTERISTIC CalVal_Debug_TrnkLatchSt "" VALUE 0xb0007287 /* @ECU_Address@CalVal_Debug_TrnkLatchSt@ */ Scalar_UBYTE 0 RDM_GetTrunkPos_CM_uint8 0 255 /end CHARACTERISTIC
/begin MEASUREMENT Monr_TrnkMaxBlockNum "" UWORD RDM_GetTrunkPos_CM_uint16 0 0 0 65535 ECU_ADDRESS 0xb0056258 /* @ECU_Address@Monr_TrnkMaxBlockNum@ */ /end MEASUREMENT
/begin MEASUREMENT Monr_TrnkCurBlockNum "" UWORD RDM_GetTrunkPos_CM_uint16 0 0 0 65535 ECU_ADDRESS 0xb0056256 /* @ECU_Address@Monr_TrnkCurBlockNum@ */ /end MEASUREMENT
/begin MEASUREMENT Monr_TrnkLLvrCurPos "" SWORD RDM_GetTrunkPos_CM_int16 0 0 -32768 32767 ECU_ADDRESS 0xb005622e /* @ECU_Address@Monr_TrnkLLvrCurPos@ */ /end MEASUREMENT
/begin MEASUREMENT Monr_TrnkRLvrCurPos "" SWORD RDM_GetTrunkPos_CM_int16 0 0 -32768 32767 ECU_ADDRESS 0xb0056230 /* @ECU_Address@Monr_TrnkRLvrCurPos@ */ /end MEASUREMENT
/begin MEASUREMENT Monr_TrnkMemMaxOpnPos "" SWORD RDM_GetTrunkPos_CM_int16 0 0 -32768 32767 ECU_ADDRESS 0xb0056278 /* @ECU_Address@Monr_TrnkMemMaxOpnPos@ */ /end MEASUREMENT
/begin MEASUREMENT Monr_TrnkHrdOpnPos "" SWORD RDM_GetTrunkPos_CM_int16 0 0 -32768 32767 ECU_ADDRESS 0xb005627a /* @ECU_Address@Monr_TrnkHrdOpnPos@ */ /end MEASUREMENT
/begin MEASUREMENT Monr_TrnkInitSt "" UBYTE RDM_GetTrunkPos_CM_uint8 0 0 0 255 ECU_ADDRESS 0xb0056224 /* @ECU_Address@Monr_TrnkInitSt@ */ /end MEASUREMENT
/begin MEASUREMENT Monr_TrnkNotInitRes "" UBYTE RDM_GetTrunkPos_CM_uint8 0 0 0 255 ECU_ADDRESS 0xb0056225 /* @ECU_Address@Monr_TrnkNotInitRes@ */ /end MEASUREMENT
/begin MEASUREMENT Monr_TrnkLLvrClsStartUpFlag "" UBYTE RDM_GetTrunkPos_CM_uint8 0 0 0 255 ECU_ADDRESS 0xb0056272 /* @ECU_Address@Monr_TrnkLLvrClsStartUpFlag@ */ /end MEASUREMENT
/begin MEASUREMENT Monr_TrnkLLvrOpnStartUpFlag "" UBYTE RDM_GetTrunkPos_CM_uint8 0 0 0 255 ECU_ADDRESS 0xb0056273 /* @ECU_Address@Monr_TrnkLLvrOpnStartUpFlag@ */ /end MEASUREMENT
/begin COMPU_METHOD RDM_GetTrunkPos_CM_int16 "Q = V" RAT_FUNC "%5.0" "" COEFFS 0 1 0 0 0 1 /end COMPU_METHOD
/begin COMPU_METHOD RDM_GetTrunkPos_CM_uint16 "Q = V" RAT_FUNC "%5.0" "" COEFFS 0 1 0 0 0 1 /end COMPU_METHOD
/begin COMPU_METHOD RDM_GetTrunkPos_CM_uint8 "Q = V" RAT_FUNC "%3.0" "" COEFFS 0 1 0 0 0 1 /end COMPU_METHOD
/begin GROUP RDM_GetTrunkPos "RDM_GetTrunkPos" ROOT /begin SUB_GROUP Root_RDM_GetTrunkPos_Main_sys /end SUB_GROUP /end GROUP
/begin GROUP Root_RDM_GetTrunkPos_Main_sys "RDM_GetTrunkPos/RDM_GetTrunkPos_Main_sys"
 /begin SUB_GROUP S3_AntiPinchHallBlockDivide S3_DetInitMode S3_DivideTrunkZone S3_LearnPos /end SUB_GROUP
 /begin REF_CHARACTERISTIC CalC_TrnkMtrOpnStartUpDist CalC_TrnkSftStpClsHallPos CalEn_Debug_TrnkLatchSt CalVal_Debug_TrnkLatchSt /end REF_CHARACTERISTIC
 /begin REF_MEASUREMENT Monr_TrnkCurBlockNum Monr_TrnkHrdOpnPos Monr_TrnkInitSt Monr_TrnkLLvrClsStartUpFlag Monr_TrnkLLvrCurPos Monr_TrnkLLvrOpnStartUpFlag Monr_TrnkMaxBlockNum Monr_TrnkMemMaxOpnPos Monr_TrnkNotInitRes Monr_TrnkRLvrCurPos /end REF_MEASUREMENT
/end GROUP
/begin GROUP S3_AntiPinchHallBlockDivide "RDM_GetTrunkPos/RDM_GetTrunkPos_Main_sys/AntiPinchHallBlockDivide" /begin SUB_GROUP S4_DetStartUp S4_DivideBlock /end SUB_GROUP /end GROUP
/begin GROUP S3_DetInitMode "RDM_GetTrunkPos/RDM_GetTrunkPos_Main_sys/DetInitMode" /begin SUB_GROUP S7_DetQuitInitSrc /end SUB_GROUP /end GROUP
/begin GROUP S3_DivideTrunkZone "RDM_GetTrunkPos/RDM_GetTrunkPos_Main_sys/DivideTrunkZone" /begin SUB_GROUP S8_DetPct S8_DetPosZone /end SUB_GROUP /end GROUP
/begin GROUP S3_LearnPos "RDM_GetTrunkPos/RDM_GetTrunkPos_Main_sys/LearnPos" /begin SUB_GROUP S9_DetLvrPos S9_DetSftStpOpnHallPos /end SUB_GROUP
 /begin REF_CHARACTERISTIC CalEn_Debug_TrnkCurHallPos CalEn_Debug_TrnkInitSt CalVal_Debug_TrnkCurHallPos CalVal_Debug_TrnkInitSt /end REF_CHARACTERISTIC
/end GROUP
/begin GROUP S4_DetStartUp "RDM_GetTrunkPos/RDM_GetTrunkPos_Main_sys/AntiPinchHallBlockDivide/DetStartUp" /begin REF_CHARACTERISTIC CalC_TrnkMtrClsStartUpDist /end REF_CHARACTERISTIC /end GROUP
/begin GROUP S4_DivideBlock "RDM_GetTrunkPos/RDM_GetTrunkPos_Main_sys/AntiPinchHallBlockDivide/DivideBlock" /begin REF_CHARACTERISTIC CalC_TrnkRFAPBlockIntv /end REF_CHARACTERISTIC /end GROUP
/begin GROUP S7_DetQuitInitSrc "RDM_GetTrunkPos/RDM_GetTrunkPos_Main_sys/DetInitMode/DetQuitInitSrc"
 /begin REF_CHARACTERISTIC CalC_TrnkClsVldMinHallPos CalC_TrnkDualLvrMaxPosTol CalC_TrnkOpnVldMaxHallPos CalC_TrnkRelsSwLstInitHdTm_sec /end REF_CHARACTERISTIC
/end GROUP
/begin GROUP S8_DetPct "RDM_GetTrunkPos/RDM_GetTrunkPos_Main_sys/DivideTrunkZone/DetPct"
 /begin REF_CHARACTERISTIC CalC_TrnkMinSftStpOpnHallPosOffset CalC_hIPLGMechHighHall_cnt /end REF_CHARACTERISTIC
/end GROUP
/begin GROUP S8_DetPosZone "RDM_GetTrunkPos/RDM_GetTrunkPos_Main_sys/DivideTrunkZone/DetPosZone"
 /begin REF_CHARACTERISTIC CalC_hIPLGCloseOnlyHallTol_cnt CalC_hIPLGOpenOnlyHall_cnt CalEn_Debug_TgatePosSts CalVal_Debug_TgatePosSts /end REF_CHARACTERISTIC
/end GROUP
/begin GROUP S9_DetLvrPos "RDM_GetTrunkPos/RDM_GetTrunkPos_Main_sys/LearnPos/DetLvrPos" /begin SUB_GROUP S109_DetLvrPos /end SUB_GROUP /end GROUP
/begin GROUP S9_DetSftStpOpnHallPos "RDM_GetTrunkPos/RDM_GetTrunkPos_Main_sys/LearnPos/DetSftStpOpnHallPos" /begin SUB_GROUP S110_Subsystem /end SUB_GROUP /begin REF_CHARACTERISTIC CalC_TrnkMinSftStpOpnHallPosOffset /end REF_CHARACTERISTIC /end GROUP
/begin GROUP S109_DetLvrPos "RDM_GetTrunkPos/RDM_GetTrunkPos_Main_sys/LearnPos/DetLvrPos/DetLvrPos" /begin SUB_GROUP S124_CalPos S124_DetVldStlHallPosRange /end SUB_GROUP /end GROUP
/begin GROUP S110_Subsystem "RDM_GetTrunkPos/RDM_GetTrunkPos_Main_sys/LearnPos/DetSftStpOpnHallPos/Subsystem" /begin REF_CHARACTERISTIC CalC_Debug_TrnkGrOrSpdCond CalC_TrnkNormMvHallPosTol /end REF_CHARACTERISTIC /end GROUP
/begin GROUP S124_CalPos "RDM_GetTrunkPos/RDM_GetTrunkPos_Main_sys/LearnPos/DetLvrPos/DetLvrPos/CalPos" /begin REF_CHARACTERISTIC CalC_TrnkHallSeriesDir /end REF_CHARACTERISTIC /end GROUP
/begin GROUP S124_DetVldStlHallPosRange "RDM_GetTrunkPos/RDM_GetTrunkPos_Main_sys/LearnPos/DetLvrPos/DetLvrPos/DetVldStlHallPosRange" /begin REF_CHARACTERISTIC CalC_TrnkOpnVldMaxHallPos CalC_hIPLGMechHighHall_cnt /end REF_CHARACTERISTIC /end GROUP
/begin CHARACTERISTIC CalC_TrnkHallOffsetErrExitMinHallTol "" VALUE 0xb0007164 /* @ECU_Address@CalC_TrnkHallOffsetErrExitMinHallTol@ */ Scalar_UWORD 0 RDM_HallDeco_CM_uint16 0 65535 /end CHARACTERISTIC
/begin CHARACTERISTIC CalC_TrnkHallOffsetErrMaxHallTol "" VALUE 0xb0007166 /* @ECU_Address@CalC_TrnkHallOffsetErrMaxHallTol@ */ Scalar_UWORD 0 RDM_HallDeco_CM_uint16 0 65535 /end CHARACTERISTIC
/begin CHARACTERISTIC CalC_TrnkHallSnsrLostDetTm_ms "" VALUE 0xb000716a /* @ECU_Address@CalC_TrnkHallSnsrLostDetTm_ms@ */ Scalar_UWORD 0 RDM_HallDeco_CM_uint16 0 65535 /end CHARACTERISTIC
/begin CHARACTERISTIC CalC_TrnkSingleMvHallOffsetMaxTol "" VALUE 0xb00071d8 /* @ECU_Address@CalC_TrnkSingleMvHallOffsetMaxTol@ */ Scalar_UWORD 0 RDM_HallDeco_CM_uint16 0 65535 /end CHARACTERISTIC
/begin CHARACTERISTIC CalC_TrnkRLvrCfgEnable "" VALUE 0xb00071d2 /* @ECU_Address@CalC_TrnkRLvrCfgEnable@ */ Scalar_UBYTE 0 RDM_HallDeco_CM_uint8 0 255 /end CHARACTERISTIC
/begin MEASUREMENT Monr_TrnkLLvrMtrSpd "" UWORD RDM_HallDeco_CM_uint16 0 0 0 65535 ECU_ADDRESS 0xb0056232 /* @ECU_Address@Monr_TrnkLLvrMtrSpd@ */ /end MEASUREMENT
/begin MEASUREMENT Monr_TrnkLLvrHall1Cnt "" UWORD RDM_HallDeco_CM_uint16 0 0 0 65535 ECU_ADDRESS 0xb0056264 /* @ECU_Address@Monr_TrnkLLvrHall1Cnt@ */ /end MEASUREMENT
/begin MEASUREMENT Monr_TrnkLLvrHall2Cnt "" UWORD RDM_HallDeco_CM_uint16 0 0 0 65535 ECU_ADDRESS 0xb0056266 /* @ECU_Address@Monr_TrnkLLvrHall2Cnt@ */ /end MEASUREMENT
/begin MEASUREMENT Monr_TrnkRLvrHall1Cnt "" UWORD RDM_HallDeco_CM_uint16 0 0 0 65535 ECU_ADDRESS 0xb0056268 /* @ECU_Address@Monr_TrnkRLvrHall1Cnt@ */ /end MEASUREMENT
/begin MEASUREMENT Monr_TrnkRLvrHall2Cnt "" UWORD RDM_HallDeco_CM_uint16 0 0 0 65535 ECU_ADDRESS 0xb005626a /* @ECU_Address@Monr_TrnkRLvrHall2Cnt@ */ /end MEASUREMENT
/begin MEASUREMENT Monr_TrnkRLvrMtrSpd "" UWORD RDM_HallDeco_CM_uint16 0 0 0 65535 ECU_ADDRESS 0xb0056234 /* @ECU_Address@Monr_TrnkRLvrMtrSpd@ */ /end MEASUREMENT
/begin MEASUREMENT Monr_TrnkLLvrHallOffsetErrSt "" UBYTE RDM_HallDeco_CM_uint8 0 0 0 255 ECU_ADDRESS 0xb005626e /* @ECU_Address@Monr_TrnkLLvrHallOffsetErrSt@ */ /end MEASUREMENT
/begin MEASUREMENT Monr_TrnkRLvrHallOffsetErrSt "" UBYTE RDM_HallDeco_CM_uint8 0 0 0 255 ECU_ADDRESS 0xb0056271 /* @ECU_Address@Monr_TrnkRLvrHallOffsetErrSt@ */ /end MEASUREMENT
/begin MEASUREMENT Monr_TrnkRLvrHall2ErrSt "" UBYTE RDM_HallDeco_CM_uint8 0 0 0 255 ECU_ADDRESS 0xb0056270 /* @ECU_Address@Monr_TrnkRLvrHall2ErrSt@ */ /end MEASUREMENT
/begin MEASUREMENT Monr_TrnkRLvrHall1ErrSt "" UBYTE RDM_HallDeco_CM_uint8 0 0 0 255 ECU_ADDRESS 0xb005626f /* @ECU_Address@Monr_TrnkRLvrHall1ErrSt@ */ /end MEASUREMENT
/begin MEASUREMENT Monr_TrnkLLvrHall2ErrSt "" UBYTE RDM_HallDeco_CM_uint8 0 0 0 255 ECU_ADDRESS 0xb005626d /* @ECU_Address@Monr_TrnkLLvrHall2ErrSt@ */ /end MEASUREMENT
/begin MEASUREMENT Monr_TrnkLLvrHall1ErrSt "" UBYTE RDM_HallDeco_CM_uint8 0 0 0 255 ECU_ADDRESS 0xb005626c /* @ECU_Address@Monr_TrnkLLvrHall1ErrSt@ */ /end MEASUREMENT
/begin COMPU_METHOD RDM_HallDeco_CM_uint16 "Q = V" RAT_FUNC "%5.0" "" COEFFS 0 1 0 0 0 1 /end COMPU_METHOD
/begin COMPU_METHOD RDM_HallDeco_CM_uint8 "Q = V" RAT_FUNC "%3.0" "" COEFFS 0 1 0 0 0 1 /end COMPU_METHOD
/begin GROUP RDM_HallDeco "RDM_HallDeco" ROOT
 /begin SUB_GROUP Root_NotificationRightLeverHallCnt_ISR_sys Root_RDM_HallDeco_Main_sys /end SUB_GROUP
/end GROUP
/begin GROUP Root_NotificationRightLeverHallCnt_ISR_sys "RDM_HallDeco/NotificationRightLeverHallCnt_ISR_sys" /begin REF_CHARACTERISTIC CalC_TrnkRLvrCfgEnable /end REF_CHARACTERISTIC /end GROUP
/begin GROUP Root_RDM_HallDeco_Main_sys "RDM_HallDeco/RDM_HallDeco_Main_sys"
 /begin SUB_GROUP S5_DetLvrHallErr S5_Hall_Based_Motor_Speed_Calculator S5_Subsystem /end SUB_GROUP
 /begin REF_CHARACTERISTIC CalC_TrnkRLvrCfgEnable /end REF_CHARACTERISTIC
 /begin REF_MEASUREMENT Monr_TrnkLLvrHall1Cnt Monr_TrnkLLvrHall1ErrSt Monr_TrnkLLvrHall2Cnt Monr_TrnkLLvrHall2ErrSt Monr_TrnkLLvrHallOffsetErrSt Monr_TrnkRLvrHall1Cnt Monr_TrnkRLvrHall1ErrSt Monr_TrnkRLvrHall2Cnt Monr_TrnkRLvrHall2ErrSt Monr_TrnkRLvrHallOffsetErrSt /end REF_MEASUREMENT
/end GROUP
/begin GROUP S5_DetLvrHallErr "RDM_HallDeco/RDM_HallDeco_Main_sys/DetLvrHallErr" /begin SUB_GROUP S38_DetLvrHallErr /end SUB_GROUP /end GROUP
/begin GROUP S5_Hall_Based_Motor_Speed_Calculator "RDM_HallDeco/RDM_HallDeco_Main_sys/Hall-Based Motor Speed Calculator" /begin REF_MEASUREMENT Monr_TrnkLLvrMtrSpd /end REF_MEASUREMENT /end GROUP
/begin GROUP S5_Subsystem "RDM_HallDeco/RDM_HallDeco_Main_sys/Subsystem" /begin SUB_GROUP S47_Hall_Based_Motor_Speed_Calculator /end SUB_GROUP /end GROUP
/begin GROUP S38_DetLvrHallErr "RDM_HallDeco/RDM_HallDeco_Main_sys/DetLvrHallErr/DetLvrHallErr"
 /begin REF_CHARACTERISTIC CalC_TrnkHallOffsetErrExitMinHallTol CalC_TrnkHallOffsetErrMaxHallTol CalC_TrnkHallSnsrLostDetTm_ms CalC_TrnkSingleMvHallOffsetMaxTol /end REF_CHARACTERISTIC
/end GROUP
/begin GROUP S47_Hall_Based_Motor_Speed_Calculator "RDM_HallDeco/RDM_HallDeco_Main_sys/Subsystem/Hall-Based Motor Speed Calculator" /begin REF_MEASUREMENT Monr_TrnkRLvrMtrSpd /end REF_MEASUREMENT /end GROUP
/begin CHARACTERISTIC Cal_CurAvgMax_mA "" VALUE 0xb00071fa /* @ECU_Address@Cal_CurAvgMax_mA@ */ Scalar_SWORD 0 RDM_LearnRF_CM_int16 -32768 32767 /end CHARACTERISTIC
/begin CHARACTERISTIC Cal_CurAvgMin_mA "" VALUE 0xb00071fc /* @ECU_Address@Cal_CurAvgMin_mA@ */ Scalar_SWORD 0 RDM_LearnRF_CM_int16 -32768 32767 /end CHARACTERISTIC
/begin CHARACTERISTIC CalC_Debug_TrnkGrOrSpdCond "" VALUE 0xb000727c Scalar_UBYTE 0 RDM_LearnRF_CM_uint8 0 255 /end CHARACTERISTIC
/begin MEASUREMENT Monr_TrnkClsApdAvgCurr "" UWORD RDM_LearnRF_CM_uint16 0 0 0 65535 ECU_ADDRESS 0xb0056350 /* @ECU_Address@Monr_TrnkClsApdAvgCurr@ */ /end MEASUREMENT
/begin MEASUREMENT Monr_TrnkRFTblVld "" UBYTE RDM_LearnRF_CM_uint8 0 0 0 255 ECU_ADDRESS 0xb0056252 /* @ECU_Address@Monr_TrnkRFTblVld@ */ /end MEASUREMENT
/begin MEASUREMENT Monr_TrnkCurRF "" SBYTE RDM_LearnRF_CM_int8 0 0 -128 127 ECU_ADDRESS 0xb0056251 /* @ECU_Address@Monr_TrnkCurRF@ */ /end MEASUREMENT
/begin COMPU_METHOD RDM_LearnRF_CM_int16 "Q = V" RAT_FUNC "%5.0" "" COEFFS 0 1 0 0 0 1 /end COMPU_METHOD
/begin COMPU_METHOD RDM_LearnRF_CM_uint8 "Q = V" RAT_FUNC "%3.0" "" COEFFS 0 1 0 0 0 1 /end COMPU_METHOD
/begin COMPU_METHOD RDM_LearnRF_CM_uint16 "Q = V" RAT_FUNC "%5.0" "" COEFFS 0 1 0 0 0 1 /end COMPU_METHOD
/begin COMPU_METHOD RDM_LearnRF_CM_int8 "Q = V" RAT_FUNC "%3.0" "" COEFFS 0 1 0 0 0 1 /end COMPU_METHOD
/begin GROUP RDM_LearnRF "RDM_LearnRF" ROOT /begin SUB_GROUP Root_RDM_LearnRF_Main_sys /end SUB_GROUP /end GROUP
/begin GROUP Root_RDM_LearnRF_Main_sys "RDM_LearnRF/RDM_LearnRF_Main_sys" /begin SUB_GROUP S3_Enabled_Subsystem2 S3_Subsystem /end SUB_GROUP /begin REF_MEASUREMENT Monr_TrnkClsApdAvgCurr Monr_TrnkCurRF Monr_TrnkRFTblVld /end REF_MEASUREMENT /end GROUP
/begin GROUP S3_Enabled_Subsystem2 "RDM_LearnRF/RDM_LearnRF_Main_sys/Enabled Subsystem2" /begin REF_CHARACTERISTIC Cal_CurAvgMax_mA Cal_CurAvgMin_mA /end REF_CHARACTERISTIC /end GROUP
/begin GROUP S3_Subsystem "RDM_LearnRF/RDM_LearnRF_Main_sys/Subsystem" /begin REF_CHARACTERISTIC CalC_Debug_TrnkGrOrSpdCond /end REF_CHARACTERISTIC /end GROUP
/begin CHARACTERISTIC CalC_TrnkSwLongPrsdTm_msec "" VALUE 0xb00071e0 /* @ECU_Address@CalC_TrnkSwLongPrsdTm_msec@ */ Scalar_UWORD 0 RDM_SetSwSt_CM_uint16 0 65535 /end CHARACTERISTIC
/begin CHARACTERISTIC CalC_TrnkSwAdhesTm_sec "" VALUE 0xb00071de /* @ECU_Address@CalC_TrnkSwAdhesTm_sec@ */ Scalar_UBYTE 0 RDM_SetSwSt_CM_uint8 0 255 /end CHARACTERISTIC
/begin MEASUREMENT Monr_TrnkExtSwSt "" UBYTE RDM_SetSwSt_CM_uint8 0 0 0 255 ECU_ADDRESS 0xb005625f /* @ECU_Address@Monr_TrnkExtSwSt@ */ /end MEASUREMENT
/begin MEASUREMENT Monr_TrnkIntSwSt "" UBYTE RDM_SetSwSt_CM_uint8 0 0 0 255 ECU_ADDRESS 0xb005625e /* @ECU_Address@Monr_TrnkIntSwSt@ */ /end MEASUREMENT
/begin COMPU_METHOD RDM_SetSwSt_CM_uint16 "Q = V" RAT_FUNC "%5.0" "" COEFFS 0 1 0 0 0 1 /end COMPU_METHOD
/begin COMPU_METHOD RDM_SetSwSt_CM_uint8 "Q = V" RAT_FUNC "%3.0" "" COEFFS 0 1 0 0 0 1 /end COMPU_METHOD
/begin GROUP RDM_SetSwSt "RDM_SetSwSt" ROOT /begin SUB_GROUP Root_RDM_SetSwSt_Main_sys /end SUB_GROUP /end GROUP
/begin GROUP Root_RDM_SetSwSt_Main_sys "RDM_SetSwSt/RDM_SetSwSt_Main_sys" /begin SUB_GROUP S3_For_Each_Subsystem /end SUB_GROUP /begin REF_MEASUREMENT Monr_TrnkExtSwSt Monr_TrnkIntSwSt /end REF_MEASUREMENT /end GROUP
/begin GROUP S3_For_Each_Subsystem "RDM_SetSwSt/RDM_SetSwSt_Main_sys/For Each Subsystem" /begin REF_CHARACTERISTIC CalC_TrnkSwAdhesTm_sec CalC_TrnkSwLongPrsdTm_msec /end REF_CHARACTERISTIC /end GROUP
/begin MEASUREMENT Monr_SOASetTgateMemHtPos "" UBYTE RDM_SOARx_CM_uint8 0 0 0 255 ECU_ADDRESS 0xb0056276 /* @ECU_Address@Monr_SOASetTgateMemHtPos@ */ /end MEASUREMENT
/begin MEASUREMENT Monr_SOATgateMvtReq "" UBYTE RDM_SOARx_CM_uint8 0 0 0 255 ECU_ADDRESS 0xb0056275 /* @ECU_Address@Monr_SOATgateMvtReq@ */ /end MEASUREMENT
/begin COMPU_METHOD RDM_SOARx_CM_uint8 "Q = V" RAT_FUNC "%3.0" "" COEFFS 0 1 0 0 0 1 /end COMPU_METHOD
/begin GROUP RDM_SOARx "RDM_SOARx" ROOT /begin SUB_GROUP Root_RDM_SOARx_Main_sys /end SUB_GROUP /end GROUP
/begin GROUP Root_RDM_SOARx_Main_sys "RDM_SOARx/RDM_SOARx_Main_sys" /begin REF_MEASUREMENT Monr_SOASetTgateMemHtPos Monr_SOATgateMvtReq /end REF_MEASUREMENT /end GROUP
/begin CHARACTERISTIC CIL_3rModFlapMotCtr_BypS "" VALUE 0xb00073d4 /* @ECU_Address@CIL_3rModFlapMotCtr_BypS@ */ Record_UBYTE 0 TMS_CM_uint8 0 255 /end CHARACTERISTIC
/begin CHARACTERISTIC CIL_3rModFlapMotCtr_BypV "" VALUE 0xb00073d5 /* @ECU_Address@CIL_3rModFlapMotCtr_BypV@ */ Record_UBYTE 0 TMS_CM_uint8 0 255 /end CHARACTERISTIC
/begin CHARACTERISTIC CIL_3rTempFlapMotCtr_BypS "" VALUE 0xb00073d6 /* @ECU_Address@CIL_3rTempFlapMotCtr_BypS@ */ Record_UBYTE 0 TMS_CM_uint8 0 255 /end CHARACTERISTIC
/begin CHARACTERISTIC CIL_3rTempFlapMotCtr_BypV "" VALUE 0xb00073d7 /* @ECU_Address@CIL_3rTempFlapMotCtr_BypV@ */ Record_UBYTE 0 TMS_CM_uint8 0 255 /end CHARACTERISTIC
/begin CHARACTERISTIC CIL_ICanNmRxInd_BypS "" VALUE 0xb00073d8 /* @ECU_Address@CIL_ICanNmRxInd_BypS@ */ Record_UBYTE 0 TMS_CM_uint8 0 255 /end CHARACTERISTIC
/begin CHARACTERISTIC CIL_ICanNmRxInd_BypV "" VALUE 0xb00073d9 /* @ECU_Address@CIL_ICanNmRxInd_BypV@ */ Record_UBYTE 0 TMS_CM_uint8 0 255 /end CHARACTERISTIC
/begin CHARACTERISTIC CIL_TMCCanComReq_BypS "" VALUE 0xb00073da /* @ECU_Address@CIL_TMCCanComReq_BypS@ */ Record_UBYTE 0 TMS_CM_uint8 0 255 /end CHARACTERISTIC
/begin CHARACTERISTIC CIL_TMCCanComReq_BypV "" VALUE 0xb00073db /* @ECU_Address@CIL_TMCCanComReq_BypV@ */ Record_UBYTE 0 TMS_CM_uint8 0 255 /end CHARACTERISTIC
/begin CHARACTERISTIC COL_3rEvapDuctTempRaw_BypS "" VALUE 0xb00073dc /* @ECU_Address@COL_3rEvapDuctTempRaw_BypS@ */ Record_UBYTE 0 TMS_CM_uint8 0 255 /end CHARACTERISTIC
/begin CHARACTERISTIC COL_3rEvapDuctTempRaw_BypV "" VALUE 0xb00073de /* @ECU_Address@COL_3rEvapDuctTempRaw_BypV@ */ Record_UWORD 0 TMS_CM_uint16 0 65535 /end CHARACTERISTIC
/begin CHARACTERISTIC COL_3rFaceDuctTempRaw_BypS "" VALUE 0xb00073e0 /* @ECU_Address@COL_3rFaceDuctTempRaw_BypS@ */ Record_UBYTE 0 TMS_CM_uint8 0 255 /end CHARACTERISTIC
/begin CHARACTERISTIC COL_3rFaceDuctTempRaw_BypV "" VALUE 0xb00073e2 /* @ECU_Address@COL_3rFaceDuctTempRaw_BypV@ */ Record_UWORD 0 TMS_CM_uint16 0 65535 /end CHARACTERISTIC
/begin CHARACTERISTIC COL_3rFootDuctTempRaw_BypS "" VALUE 0xb00073e4 /* @ECU_Address@COL_3rFootDuctTempRaw_BypS@ */ Record_UBYTE 0 TMS_CM_uint8 0 255 /end CHARACTERISTIC
/begin CHARACTERISTIC COL_3rFootDuctTempRaw_BypV "" VALUE 0xb00073e6 /* @ECU_Address@COL_3rFootDuctTempRaw_BypV@ */ Record_UWORD 0 TMS_CM_uint16 0 65535 /end CHARACTERISTIC
/begin CHARACTERISTIC COL_3rModFlapMotVolFb_BypS "" VALUE 0xb00073e8 /* @ECU_Address@COL_3rModFlapMotVolFb_BypS@ */ Record_UBYTE 0 TMS_CM_uint8 0 255 /end CHARACTERISTIC
/begin CHARACTERISTIC COL_3rModFlapMotVolFb_BypV "" VALUE 0xb00073ea /* @ECU_Address@COL_3rModFlapMotVolFb_BypV@ */ Record_UWORD 0 TMS_CM_uint16 0 65535 /end CHARACTERISTIC
/begin CHARACTERISTIC COL_3rTempFlapVolFb_BypS "" VALUE 0xb00073ec /* @ECU_Address@COL_3rTempFlapVolFb_BypS@ */ Record_UBYTE 0 TMS_CM_uint8 0 255 /end CHARACTERISTIC
/begin CHARACTERISTIC COL_3rTempFlapVolFb_BypV "" VALUE 0xb00073ee /* @ECU_Address@COL_3rTempFlapVolFb_BypV@ */ Record_UWORD 0 TMS_CM_uint16 0 65535 /end CHARACTERISTIC
/begin CHARACTERISTIC COL_RrModMotCtr_BypS "" VALUE 0xb00073f0 /* @ECU_Address@COL_RrModMotCtr_BypS@ */ Record_UBYTE 0 TMS_CM_uint8 0 255 /end CHARACTERISTIC
/begin CHARACTERISTIC COL_RrModMotCtr_BypV "" VALUE 0xb00073f1 /* @ECU_Address@COL_RrModMotCtr_BypV@ */ Record_UBYTE 0 TMS_CM_uint8 0 255 /end CHARACTERISTIC
/begin MEASUREMENT CIL_3rModFlapMotCtr "" UBYTE TMS_CM_uint8 0 0 0 255 ECU_ADDRESS 0xb0056364 /* @ECU_Address@CIL_3rModFlapMotCtr@ */
 /begin IF_DATA XCP
  /begin DAQ_EVENT VARIABLE /begin DEFAULT_EVENT_LIST EVENT 0x0000 /end DEFAULT_EVENT_LIST /end DAQ_EVENT
 /end IF_DATA
/end MEASUREMENT
/begin MEASUREMENT CIL_3rTempFlapMotCtr "" UBYTE TMS_CM_uint8 0 0 0 255 ECU_ADDRESS 0xb0056365 /* @ECU_Address@CIL_3rTempFlapMotCtr@ */
 /begin IF_DATA XCP
  /begin DAQ_EVENT VARIABLE /begin DEFAULT_EVENT_LIST EVENT 0x0000 /end DEFAULT_EVENT_LIST /end DAQ_EVENT
 /end IF_DATA
/end MEASUREMENT
/begin MEASUREMENT CIL_ICanNmRxInd "" UBYTE TMS_CM_uint8 0 0 0 255 ECU_ADDRESS 0xb0056366 /* @ECU_Address@CIL_ICanNmRxInd@ */
 /begin IF_DATA XCP
  /begin DAQ_EVENT VARIABLE /begin DEFAULT_EVENT_LIST EVENT 0x0000 /end DEFAULT_EVENT_LIST /end DAQ_EVENT
 /end IF_DATA
/end MEASUREMENT
/begin MEASUREMENT CIL_RrEvapDuctTempSnsr "" FLOAT32_IEEE TMS_CM_single 0 0 -3.4E+38 3.4E+38 ECU_ADDRESS 0xb0056368 /* @ECU_Address@CIL_RrEvapDuctTempSnsr@ */
 /begin IF_DATA XCP
  /begin DAQ_EVENT VARIABLE /begin DEFAULT_EVENT_LIST EVENT 0x0000 /end DEFAULT_EVENT_LIST /end DAQ_EVENT
 /end IF_DATA
/end MEASUREMENT
/begin MEASUREMENT CIL_RrFaceDuctTempSnsr "" FLOAT32_IEEE TMS_CM_single 0 0 -3.4E+38 3.4E+38 ECU_ADDRESS 0xb005636c /* @ECU_Address@CIL_RrFaceDuctTempSnsr@ */
 /begin IF_DATA XCP
  /begin DAQ_EVENT VARIABLE /begin DEFAULT_EVENT_LIST EVENT 0x0000 /end DEFAULT_EVENT_LIST /end DAQ_EVENT
 /end IF_DATA
/end MEASUREMENT
/begin MEASUREMENT CIL_RrFootDuctTempSnsr "" FLOAT32_IEEE TMS_CM_single 0 0 -3.4E+38 3.4E+38 ECU_ADDRESS 0xb0056370 /* @ECU_Address@CIL_RrFootDuctTempSnsr@ */
 /begin IF_DATA XCP
  /begin DAQ_EVENT VARIABLE /begin DEFAULT_EVENT_LIST EVENT 0x0000 /end DEFAULT_EVENT_LIST /end DAQ_EVENT
 /end IF_DATA
/end MEASUREMENT
/begin MEASUREMENT CIL_RrModMotPosnFb "" FLOAT32_IEEE TMS_CM_single 0 0 -3.4E+38 3.4E+38 ECU_ADDRESS 0xb0056374 /* @ECU_Address@CIL_RrModMotPosnFb@ */
 /begin IF_DATA XCP
  /begin DAQ_EVENT VARIABLE /begin DEFAULT_EVENT_LIST EVENT 0x0000 /end DEFAULT_EVENT_LIST /end DAQ_EVENT
 /end IF_DATA
/end MEASUREMENT
/begin MEASUREMENT CIL_TMCCanComReq "" UBYTE TMS_CM_uint8 0 0 0 255 ECU_ADDRESS 0xb0056378 /* @ECU_Address@CIL_TMCCanComReq@ */
 /begin IF_DATA XCP
  /begin DAQ_EVENT VARIABLE /begin DEFAULT_EVENT_LIST EVENT 0x0000 /end DEFAULT_EVENT_LIST /end DAQ_EVENT
 /end IF_DATA
/end MEASUREMENT
/begin MEASUREMENT CIL_TZcuKL30DcV "" FLOAT32_IEEE TMS_CM_single 0 0 -3.4E+38 3.4E+38 ECU_ADDRESS 0xb005637c /* @ECU_Address@CIL_TZcuKL30DcV@ */
 /begin IF_DATA XCP
  /begin DAQ_EVENT VARIABLE /begin DEFAULT_EVENT_LIST EVENT 0x0000 /end DEFAULT_EVENT_LIST /end DAQ_EVENT
 /end IF_DATA
/end MEASUREMENT
/begin MEASUREMENT COL_3rTempFlapVolFb "" UWORD TMS_CM_uint16 0 0 0 65535 ECU_ADDRESS 0xb0056380 /* @ECU_Address@COL_3rTempFlapVolFb@ */
 /begin IF_DATA XCP
  /begin DAQ_EVENT VARIABLE /begin DEFAULT_EVENT_LIST EVENT 0x0000 /end DEFAULT_EVENT_LIST /end DAQ_EVENT
 /end IF_DATA
/end MEASUREMENT
/begin MEASUREMENT gdu16 "" UWORD TMS_CM_UINT16 0 0 0 65535 ECU_ADDRESS 0x0000 /* @ECU_Address@gdu16@ */
 /begin IF_DATA XCP
  /begin DAQ_EVENT VARIABLE /begin DEFAULT_EVENT_LIST EVENT 0x0000 /end DEFAULT_EVENT_LIST /end DAQ_EVENT
 /end IF_DATA
/end MEASUREMENT
/begin MEASUREMENT gdu8 "" UBYTE TMS_CM_UINT8 0 0 0 255 ECU_ADDRESS 0x0000 /* @ECU_Address@gdu8@ */
 /begin IF_DATA XCP
  /begin DAQ_EVENT VARIABLE /begin DEFAULT_EVENT_LIST EVENT 0x0000 /end DEFAULT_EVENT_LIST /end DAQ_EVENT
 /end IF_DATA
/end MEASUREMENT
/begin MEASUREMENT mA_u16 "" UWORD TMS_CM_UINT16 0 0 0 65535 ECU_ADDRESS 0x0000 /* @ECU_Address@mA_u16@ */
 /begin IF_DATA XCP
  /begin DAQ_EVENT VARIABLE /begin DEFAULT_EVENT_LIST EVENT 0x0000 /end DEFAULT_EVENT_LIST /end DAQ_EVENT
 /end IF_DATA
/end MEASUREMENT
/begin COMPU_METHOD TMS_CM_UINT16 "Q = V" IDENTICAL "%5.0" "" /end COMPU_METHOD
/begin COMPU_METHOD TMS_CM_UINT8 "Q = V" IDENTICAL "%3.0" "" /end COMPU_METHOD
/begin COMPU_METHOD TMS_CM_single "Q = V" IDENTICAL "%8.6" "" /end COMPU_METHOD
/begin COMPU_METHOD TMS_CM_uint16 "Q = V" IDENTICAL "%5.0" "" /end COMPU_METHOD
/begin COMPU_METHOD TMS_CM_uint8 "Q = V" IDENTICAL "%3.0" "" /end COMPU_METHOD
/begin RECORD_LAYOUT Record_FLOAT32_IEEE FNC_VALUES 1 FLOAT32_IEEE COLUMN_DIR DIRECT /end RECORD_LAYOUT
/begin RECORD_LAYOUT Record_UBYTE FNC_VALUES 1 UBYTE COLUMN_DIR DIRECT /end RECORD_LAYOUT
/begin RECORD_LAYOUT Record_UWORD FNC_VALUES 1 UWORD COLUMN_DIR DIRECT /end RECORD_LAYOUT
/begin GROUP TMS "TMS" ROOT /begin SUB_GROUP TMS_TMSTZCUAppCyclic10Hook_sys /end SUB_GROUP /begin REF_MEASUREMENT gdu16 gdu8 mA_u16 /end REF_MEASUREMENT /end GROUP
/begin GROUP TMS_TMSTZCUAppCyclic10Hook_sys "TMS/TMSTZCUAppCyclic10Hook_sys" /begin SUB_GROUP TMS_TMSTZCUAppCyclic10Hook_sys_Compare_To_Constant1 /end SUB_GROUP
 /begin REF_CHARACTERISTIC CIL_3rModFlapMotCtr_BypS CIL_3rModFlapMotCtr_BypV CIL_3rTempFlapMotCtr_BypS CIL_3rTempFlapMotCtr_BypV CIL_ICanNmRxInd_BypS CIL_ICanNmRxInd_BypV CIL_TMCCanComReq_BypS CIL_TMCCanComReq_BypV COL_3rEvapDuctTempRaw_BypS COL_3rEvapDuctTempRaw_BypV COL_3rFaceDuctTempRaw_BypS COL_3rFaceDuctTempRaw_BypV COL_3rFootDuctTempRaw_BypS COL_3rFootDuctTempRaw_BypV COL_3rModFlapMotVolFb_BypS COL_3rModFlapMotVolFb_BypV COL_3rTempFlapVolFb_BypS COL_3rTempFlapVolFb_BypV COL_RrModMotCtr_BypS COL_RrModMotCtr_BypV /end REF_CHARACTERISTIC
 /begin REF_MEASUREMENT CIL_3rModFlapMotCtr CIL_3rTempFlapMotCtr CIL_ICanNmRxInd CIL_RrEvapDuctTempSnsr CIL_RrFaceDuctTempSnsr CIL_RrFootDuctTempSnsr CIL_RrModMotPosnFb CIL_TMCCanComReq CIL_TZcuKL30DcV COL_3rTempFlapVolFb gdu16 gdu8 mA_u16 /end REF_MEASUREMENT
/end GROUP
/begin GROUP TMS_TMSTZCUAppCyclic10Hook_sys_Compare_To_Constant1 "TMS/TMSTZCUAppCyclic10Hook_sys/Compare\r\nTo Constant1" /begin REF_MEASUREMENT gdu8 /end REF_MEASUREMENT /end GROUP
/begin CHARACTERISTIC CalEn_DTC_0x97102A "" VALUE 0xb00072f0 /* @ECU_Address@CalEn_DTC_0xb00072f0@ */ Scalar_UBYTE 0 TZCUbody_DTC_CM_uint8 0 255 /end CHARACTERISTIC
/begin CHARACTERISTIC CalEn_DTC_0x971031 "" VALUE 0xb00072f1 /* @ECU_Address@CalEn_DTC_0xb00072f1@ */ Scalar_UBYTE 0 TZCUbody_DTC_CM_uint8 0 255 /end CHARACTERISTIC
/begin CHARACTERISTIC CalEn_DTC_0x971032 "" VALUE 0xb00072f2 /* @ECU_Address@CalEn_DTC_0xb00072f2@ */ Scalar_UBYTE 0 TZCUbody_DTC_CM_uint8 0 255 /end CHARACTERISTIC
/begin CHARACTERISTIC CalEn_DTC_0x971033 "" VALUE 0xb00072f3 /* @ECU_Address@CalEn_DTC_0xb00072f3@ */ Scalar_UBYTE 0 TZCUbody_DTC_CM_uint8 0 255 /end CHARACTERISTIC
/begin CHARACTERISTIC CalEn_DTC_0x971034 "" VALUE 0xb00072f4 /* @ECU_Address@CalEn_DTC_0xb00072f4@ */ Scalar_UBYTE 0 TZCUbody_DTC_CM_uint8 0 255 /end CHARACTERISTIC
/begin CHARACTERISTIC CalEn_DTC_0x97C555 "" VALUE 0xb00072f5 /* @ECU_Address@CalEn_DTC_0xb00072f5@ */ Scalar_UBYTE 0 TZCUbody_DTC_CM_uint8 0 255 /end CHARACTERISTIC
/begin COMPU_METHOD TZCUbody_DTC_CM_uint8 "Q = V" RAT_FUNC "%3.0" "" COEFFS 0 1 0 0 0 1 /end COMPU_METHOD
/begin GROUP TZCUbody_DTC "TZCUbody_DTC" ROOT /begin SUB_GROUP Root_TZCUbody_DTC_Main_sys /end SUB_GROUP /end GROUP
/begin GROUP Root_TZCUbody_DTC_Main_sys "TZCUbody_DTC/TZCUbody_DTC_Main_sys" /begin SUB_GROUP S2_TZCUBody_DTC_Main_sys /end SUB_GROUP /end GROUP
/begin GROUP S2_TZCUBody_DTC_Main_sys "TZCUbody_DTC/TZCUbody_DTC_Main_sys/TZCUBody_DTC_Main_sys"
 /begin REF_CHARACTERISTIC CalEn_DTC_0x97102A CalEn_DTC_0x971031 CalEn_DTC_0x971032 CalEn_DTC_0x971033 CalEn_DTC_0x971034 CalEn_DTC_0x97C555 /end REF_CHARACTERISTIC
/end GROUP
/end MODULE
/end PROJECT
